VERSION "created by canmatrix"

NS_ :

BS_:

BU_: FR GW

BO_ 307 ARS_RDI_376_383: 64 FR
 SG_ ARS_RDI_Range_Clu_376 : 7|12@0+ (0.0625,0) [0|255.9375] "m"  GW
 SG_ ARS_RDI_ElevationAng_Clu_377 : 109|7@0+ (0.005,-0.315) [-0.315|0.32] "rad"  GW
 SG_ ARS_RDI_SNR_Clu_377 : 118|7@0+ (0.5,0) [0|63.5] "dB"  GW
 SG_ ARS_RDI_Range_Clu_378 : 127|12@0+ (0.0625,0) [0|255.9375] "m"  GW
 SG_ ARS_RDI_VradRel_Clu_376 : 11|11@0+ (0.1,-120) [-120|84.7] "m/s"  GW
 SG_ ARS_RDI_VradRel_Clu_378 : 131|11@0+ (0.1,-120) [-120|84.7] "m/s"  GW
 SG_ ARS_RDI_RCS_Clu_378 : 136|9@0+ (0.2,-51.2) [-51.2|51] "dBsm"  GW
 SG_ ARS_RDI_AzimuthAng_Clu_378 : 159|10@0+ (0.002,-1.022) [-1.022|1.024] "rad"  GW
 SG_ ARS_RDI_ElevationAng_Clu_378 : 165|7@0+ (0.005,-0.315) [-0.315|0.32] "rad"  GW
 SG_ ARS_RDI_SNR_Clu_378 : 174|7@0+ (0.5,0) [0|63.5] "dB"  GW
 SG_ ARS_RDI_DynProp_Clu_378 : 183|2@0+ (1,0) [0|3] ""  GW
 SG_ ARS_RDI_Quality_Clu_378 : 181|2@0+ (1,0) [0|3] ""  GW
 SG_ ARS_RDI_DynProp_Clu_379 : 179|2@0+ (1,0) [0|3] ""  GW
 SG_ ARS_RDI_Quality_Clu_379 : 177|2@0+ (1,0) [0|3] ""  GW
 SG_ ARS_RDI_Range_Clu_379 : 191|12@0+ (0.0625,0) [0|255.9375] "m"  GW
 SG_ ARS_RDI_VradRel_Clu_379 : 195|11@0+ (0.1,-120) [-120|84.7] "m/s"  GW
 SG_ ARS_RDI_RCS_Clu_379 : 200|9@0+ (0.2,-51.2) [-51.2|51] "dBsm"  GW
 SG_ ARS_RDI_AzimuthAng_Clu_379 : 223|10@0+ (0.002,-1.022) [-1.022|1.024] "rad"  GW
 SG_ ARS_RDI_ElevationAng_Clu_379 : 229|7@0+ (0.005,-0.315) [-0.315|0.32] "rad"  GW
 SG_ ARS_RDI_SNR_Clu_379 : 238|7@0+ (0.5,0) [0|63.5] "dB"  GW
 SG_ ARS_RDI_RCS_Clu_376 : 16|9@0+ (0.2,-51.2) [-51.2|51] "dBsm"  GW
 SG_ ARS_RDI_Range_Clu_380 : 247|12@0+ (0.0625,0) [0|255.9375] "m"  GW
 SG_ ARS_RDI_VradRel_Clu_380 : 251|11@0+ (0.1,-120) [-120|84.7] "m/s"  GW
 SG_ ARS_RDI_RCS_Clu_380 : 256|9@0+ (0.2,-51.2) [-51.2|51] "dBsm"  GW
 SG_ ARS_RDI_AzimuthAng_Clu_380 : 279|10@0+ (0.002,-1.022) [-1.022|1.024] "rad"  GW
 SG_ ARS_RDI_ElevationAng_Clu_380 : 285|7@0+ (0.005,-0.315) [-0.315|0.32] "rad"  GW
 SG_ ARS_RDI_SNR_Clu_380 : 294|7@0+ (0.5,0) [0|63.5] "dB"  GW
 SG_ ARS_RDI_DynProp_Clu_380 : 303|2@0+ (1,0) [0|3] ""  GW
 SG_ ARS_RDI_Quality_Clu_380 : 301|2@0+ (1,0) [0|3] ""  GW
 SG_ ARS_RDI_DynProp_Clu_381 : 299|2@0+ (1,0) [0|3] ""  GW
 SG_ ARS_RDI_Quality_Clu_381 : 297|2@0+ (1,0) [0|3] ""  GW
 SG_ ARS_RDI_Range_Clu_381 : 311|12@0+ (0.0625,0) [0|255.9375] "m"  GW
 SG_ ARS_RDI_VradRel_Clu_381 : 315|11@0+ (0.1,-120) [-120|84.7] "m/s"  GW
 SG_ ARS_RDI_RCS_Clu_381 : 320|9@0+ (0.2,-51.2) [-51.2|51] "dBsm"  GW
 SG_ ARS_RDI_AzimuthAng_Clu_376 : 39|10@0+ (0.002,-1.022) [-1.022|1.024] "rad"  GW
 SG_ ARS_RDI_AzimuthAng_Clu_381 : 343|10@0+ (0.002,-1.022) [-1.022|1.024] "rad"  GW
 SG_ ARS_RDI_ElevationAng_Clu_381 : 349|7@0+ (0.005,-0.315) [-0.315|0.32] "rad"  GW
 SG_ ARS_RDI_SNR_Clu_381 : 358|7@0+ (0.5,0) [0|63.5] "dB"  GW
 SG_ ARS_RDI_Range_Clu_382 : 367|12@0+ (0.0625,0) [0|255.9375] "m"  GW
 SG_ ARS_RDI_VradRel_Clu_382 : 371|11@0+ (0.1,-120) [-120|84.7] "m/s"  GW
 SG_ ARS_RDI_RCS_Clu_382 : 376|9@0+ (0.2,-51.2) [-51.2|51] "dBsm"  GW
 SG_ ARS_RDI_AzimuthAng_Clu_382 : 399|10@0+ (0.002,-1.022) [-1.022|1.024] "rad"  GW
 SG_ ARS_RDI_ElevationAng_Clu_382 : 405|7@0+ (0.005,-0.315) [-0.315|0.32] "rad"  GW
 SG_ ARS_RDI_SNR_Clu_382 : 414|7@0+ (0.5,0) [0|63.5] "dB"  GW
 SG_ ARS_RDI_DynProp_Clu_382 : 423|2@0+ (1,0) [0|3] ""  GW
 SG_ ARS_RDI_Quality_Clu_382 : 421|2@0+ (1,0) [0|3] ""  GW
 SG_ ARS_RDI_DynProp_Clu_383 : 419|2@0+ (1,0) [0|3] ""  GW
 SG_ ARS_RDI_Quality_Clu_383 : 417|2@0+ (1,0) [0|3] ""  GW
 SG_ ARS_RDI_Range_Clu_383 : 431|12@0+ (0.0625,0) [0|255.9375] "m"  GW
 SG_ ARS_RDI_ElevationAng_Clu_376 : 45|7@0+ (0.005,-0.315) [-0.315|0.32] "rad"  GW
 SG_ ARS_RDI_VradRel_Clu_383 : 435|11@0+ (0.1,-120) [-120|84.7] "m/s"  GW
 SG_ ARS_RDI_RCS_Clu_383 : 440|9@0+ (0.2,-51.2) [-51.2|51] "dBsm"  GW
 SG_ ARS_RDI_AzimuthAng_Clu_383 : 463|10@0+ (0.002,-1.022) [-1.022|1.024] "rad"  GW
 SG_ ARS_RDI_ElevationAng_Clu_383 : 469|7@0+ (0.005,-0.315) [-0.315|0.32] "rad"  GW
 SG_ ARS_RDI_SNR_Clu_383 : 478|7@0+ (0.5,0) [0|63.5] "dB"  GW
 SG_ ARS_RDI_MsgCounter_Clu_376_383 : 495|8@0+ (1,0) [0|255] ""  GW
 SG_ ARS_RDI_CRC16_Checksum_Clu_376_3 : 503|16@0+ (1,0) [0|65535] ""  GW
 SG_ ARS_RDI_SNR_Clu_376 : 54|7@0+ (0.5,0) [0|63.5] "dB"  GW
 SG_ ARS_RDI_DynProp_Clu_376 : 63|2@0+ (1,0) [0|3] ""  GW
 SG_ ARS_RDI_Quality_Clu_376 : 61|2@0+ (1,0) [0|3] ""  GW
 SG_ ARS_RDI_DynProp_Clu_377 : 59|2@0+ (1,0) [0|3] ""  GW
 SG_ ARS_RDI_Quality_Clu_377 : 57|2@0+ (1,0) [0|3] ""  GW
 SG_ ARS_RDI_Range_Clu_377 : 71|12@0+ (0.0625,0) [0|255.9375] "m"  GW
 SG_ ARS_RDI_VradRel_Clu_377 : 75|11@0+ (0.1,-120) [-120|84.7] "m/s"  GW
 SG_ ARS_RDI_RCS_Clu_377 : 80|9@0+ (0.2,-51.2) [-51.2|51] "dBsm"  GW
 SG_ ARS_RDI_AzimuthAng_Clu_377 : 103|10@0+ (0.002,-1.022) [-1.022|1.024] "rad"  GW

BO_ 308 ARS_RDI_384_391: 64 FR
 SG_ ARS_RDI_Range_Clu_384 : 7|12@0+ (0.0625,0) [0|255.9375] "m"  GW
 SG_ ARS_RDI_ElevationAng_Clu_385 : 109|7@0+ (0.005,-0.315) [-0.315|0.32] "rad"  GW
 SG_ ARS_RDI_SNR_Clu_385 : 118|7@0+ (0.5,0) [0|63.5] "dB"  GW
 SG_ ARS_RDI_Range_Clu_386 : 127|12@0+ (0.0625,0) [0|255.9375] "m"  GW
 SG_ ARS_RDI_VradRel_Clu_384 : 11|11@0+ (0.1,-120) [-120|84.7] "m/s"  GW
 SG_ ARS_RDI_VradRel_Clu_386 : 131|11@0+ (0.1,-120) [-120|84.7] "m/s"  GW
 SG_ ARS_RDI_RCS_Clu_386 : 136|9@0+ (0.2,-51.2) [-51.2|51] "dBsm"  GW
 SG_ ARS_RDI_AzimuthAng_Clu_386 : 159|10@0+ (0.002,-1.022) [-1.022|1.024] "rad"  GW
 SG_ ARS_RDI_ElevationAng_Clu_386 : 165|7@0+ (0.005,-0.315) [-0.315|0.32] "rad"  GW
 SG_ ARS_RDI_SNR_Clu_386 : 174|7@0+ (0.5,0) [0|63.5] "dB"  GW
 SG_ ARS_RDI_DynProp_Clu_386 : 183|2@0+ (1,0) [0|3] ""  GW
 SG_ ARS_RDI_Quality_Clu_386 : 181|2@0+ (1,0) [0|3] ""  GW
 SG_ ARS_RDI_DynProp_Clu_387 : 179|2@0+ (1,0) [0|3] ""  GW
 SG_ ARS_RDI_Quality_Clu_387 : 177|2@0+ (1,0) [0|3] ""  GW
 SG_ ARS_RDI_Range_Clu_387 : 191|12@0+ (0.0625,0) [0|255.9375] "m"  GW
 SG_ ARS_RDI_VradRel_Clu_387 : 195|11@0+ (0.1,-120) [-120|84.7] "m/s"  GW
 SG_ ARS_RDI_RCS_Clu_387 : 200|9@0+ (0.2,-51.2) [-51.2|51] "dBsm"  GW
 SG_ ARS_RDI_AzimuthAng_Clu_387 : 223|10@0+ (0.002,-1.022) [-1.022|1.024] "rad"  GW
 SG_ ARS_RDI_ElevationAng_Clu_387 : 229|7@0+ (0.005,-0.315) [-0.315|0.32] "rad"  GW
 SG_ ARS_RDI_SNR_Clu_387 : 238|7@0+ (0.5,0) [0|63.5] "dB"  GW
 SG_ ARS_RDI_RCS_Clu_384 : 16|9@0+ (0.2,-51.2) [-51.2|51] "dBsm"  GW
 SG_ ARS_RDI_Range_Clu_388 : 247|12@0+ (0.0625,0) [0|255.9375] "m"  GW
 SG_ ARS_RDI_VradRel_Clu_388 : 251|11@0+ (0.1,-120) [-120|84.7] "m/s"  GW
 SG_ ARS_RDI_RCS_Clu_388 : 256|9@0+ (0.2,-51.2) [-51.2|51] "dBsm"  GW
 SG_ ARS_RDI_AzimuthAng_Clu_388 : 279|10@0+ (0.002,-1.022) [-1.022|1.024] "rad"  GW
 SG_ ARS_RDI_ElevationAng_Clu_388 : 285|7@0+ (0.005,-0.315) [-0.315|0.32] "rad"  GW
 SG_ ARS_RDI_SNR_Clu_388 : 294|7@0+ (0.5,0) [0|63.5] "dB"  GW
 SG_ ARS_RDI_DynProp_Clu_388 : 303|2@0+ (1,0) [0|3] ""  GW
 SG_ ARS_RDI_Quality_Clu_388 : 301|2@0+ (1,0) [0|3] ""  GW
 SG_ ARS_RDI_DynProp_Clu_389 : 299|2@0+ (1,0) [0|3] ""  GW
 SG_ ARS_RDI_Quality_Clu_389 : 297|2@0+ (1,0) [0|3] ""  GW
 SG_ ARS_RDI_Range_Clu_389 : 311|12@0+ (0.0625,0) [0|255.9375] "m"  GW
 SG_ ARS_RDI_VradRel_Clu_389 : 315|11@0+ (0.1,-120) [-120|84.7] "m/s"  GW
 SG_ ARS_RDI_RCS_Clu_389 : 320|9@0+ (0.2,-51.2) [-51.2|51] "dBsm"  GW
 SG_ ARS_RDI_AzimuthAng_Clu_384 : 39|10@0+ (0.002,-1.022) [-1.022|1.024] "rad"  GW
 SG_ ARS_RDI_AzimuthAng_Clu_389 : 343|10@0+ (0.002,-1.022) [-1.022|1.024] "rad"  GW
 SG_ ARS_RDI_ElevationAng_Clu_389 : 349|7@0+ (0.005,-0.315) [-0.315|0.32] "rad"  GW
 SG_ ARS_RDI_SNR_Clu_389 : 358|7@0+ (0.5,0) [0|63.5] "dB"  GW
 SG_ ARS_RDI_Range_Clu_390 : 367|12@0+ (0.0625,0) [0|255.9375] "m"  GW
 SG_ ARS_RDI_VradRel_Clu_390 : 371|11@0+ (0.1,-120) [-120|84.7] "m/s"  GW
 SG_ ARS_RDI_RCS_Clu_390 : 376|9@0+ (0.2,-51.2) [-51.2|51] "dBsm"  GW
 SG_ ARS_RDI_AzimuthAng_Clu_390 : 399|10@0+ (0.002,-1.022) [-1.022|1.024] "rad"  GW
 SG_ ARS_RDI_ElevationAng_Clu_390 : 405|7@0+ (0.005,-0.315) [-0.315|0.32] "rad"  GW
 SG_ ARS_RDI_SNR_Clu_390 : 414|7@0+ (0.5,0) [0|63.5] "dB"  GW
 SG_ ARS_RDI_DynProp_Clu_390 : 423|2@0+ (1,0) [0|3] ""  GW
 SG_ ARS_RDI_Quality_Clu_390 : 421|2@0+ (1,0) [0|3] ""  GW
 SG_ ARS_RDI_DynProp_Clu_391 : 419|2@0+ (1,0) [0|3] ""  GW
 SG_ ARS_RDI_Quality_Clu_391 : 417|2@0+ (1,0) [0|3] ""  GW
 SG_ ARS_RDI_Range_Clu_391 : 431|12@0+ (0.0625,0) [0|255.9375] "m"  GW
 SG_ ARS_RDI_ElevationAng_Clu_384 : 45|7@0+ (0.005,-0.315) [-0.315|0.32] "rad"  GW
 SG_ ARS_RDI_VradRel_Clu_391 : 435|11@0+ (0.1,-120) [-120|84.7] "m/s"  GW
 SG_ ARS_RDI_RCS_Clu_391 : 440|9@0+ (0.2,-51.2) [-51.2|51] "dBsm"  GW
 SG_ ARS_RDI_AzimuthAng_Clu_391 : 463|10@0+ (0.002,-1.022) [-1.022|1.024] "rad"  GW
 SG_ ARS_RDI_ElevationAng_Clu_391 : 469|7@0+ (0.005,-0.315) [-0.315|0.32] "rad"  GW
 SG_ ARS_RDI_SNR_Clu_391 : 478|7@0+ (0.5,0) [0|63.5] "dB"  GW
 SG_ ARS_RDI_MsgCounter_Clu_384_391 : 495|8@0+ (1,0) [0|255] ""  GW
 SG_ ARS_RDI_CRC16_Checksum_Clu_384_3 : 503|16@0+ (1,0) [0|65535] ""  GW
 SG_ ARS_RDI_SNR_Clu_384 : 54|7@0+ (0.5,0) [0|63.5] "dB"  GW
 SG_ ARS_RDI_DynProp_Clu_384 : 63|2@0+ (1,0) [0|3] ""  GW
 SG_ ARS_RDI_Quality_Clu_384 : 61|2@0+ (1,0) [0|3] ""  GW
 SG_ ARS_RDI_DynProp_Clu_385 : 59|2@0+ (1,0) [0|3] ""  GW
 SG_ ARS_RDI_Quality_Clu_385 : 57|2@0+ (1,0) [0|3] ""  GW
 SG_ ARS_RDI_Range_Clu_385 : 71|12@0+ (0.0625,0) [0|255.9375] "m"  GW
 SG_ ARS_RDI_VradRel_Clu_385 : 75|11@0+ (0.1,-120) [-120|84.7] "m/s"  GW
 SG_ ARS_RDI_RCS_Clu_385 : 80|9@0+ (0.2,-51.2) [-51.2|51] "dBsm"  GW
 SG_ ARS_RDI_AzimuthAng_Clu_385 : 103|10@0+ (0.002,-1.022) [-1.022|1.024] "rad"  GW

BO_ 309 ARS_RDI_392_399: 64 FR
 SG_ ARS_RDI_Range_Clu_392 : 7|12@0+ (0.0625,0) [0|255.9375] "m"  GW
 SG_ ARS_RDI_ElevationAng_Clu_393 : 109|7@0+ (0.005,-0.315) [-0.315|0.32] "rad"  GW
 SG_ ARS_RDI_SNR_Clu_393 : 118|7@0+ (0.5,0) [0|63.5] "dB"  GW
 SG_ ARS_RDI_Range_Clu_394 : 127|12@0+ (0.0625,0) [0|255.9375] "m"  GW
 SG_ ARS_RDI_VradRel_Clu_392 : 11|11@0+ (0.1,-120) [-120|84.7] "m/s"  GW
 SG_ ARS_RDI_VradRel_Clu_394 : 131|11@0+ (0.1,-120) [-120|84.7] "m/s"  GW
 SG_ ARS_RDI_RCS_Clu_394 : 136|9@0+ (0.2,-51.2) [-51.2|51] "dBsm"  GW
 SG_ ARS_RDI_AzimuthAng_Clu_394 : 159|10@0+ (0.002,-1.022) [-1.022|1.024] "rad"  GW
 SG_ ARS_RDI_ElevationAng_Clu_394 : 165|7@0+ (0.005,-0.315) [-0.315|0.32] "rad"  GW
 SG_ ARS_RDI_SNR_Clu_394 : 174|7@0+ (0.5,0) [0|63.5] "dB"  GW
 SG_ ARS_RDI_DynProp_Clu_394 : 183|2@0+ (1,0) [0|3] ""  GW
 SG_ ARS_RDI_Quality_Clu_394 : 181|2@0+ (1,0) [0|3] ""  GW
 SG_ ARS_RDI_DynProp_Clu_395 : 179|2@0+ (1,0) [0|3] ""  GW
 SG_ ARS_RDI_Quality_Clu_395 : 177|2@0+ (1,0) [0|3] ""  GW
 SG_ ARS_RDI_Range_Clu_395 : 191|12@0+ (0.0625,0) [0|255.9375] "m"  GW
 SG_ ARS_RDI_VradRel_Clu_395 : 195|11@0+ (0.1,-120) [-120|84.7] "m/s"  GW
 SG_ ARS_RDI_RCS_Clu_395 : 200|9@0+ (0.2,-51.2) [-51.2|51] "dBsm"  GW
 SG_ ARS_RDI_AzimuthAng_Clu_395 : 223|10@0+ (0.002,-1.022) [-1.022|1.024] "rad"  GW
 SG_ ARS_RDI_ElevationAng_Clu_395 : 229|7@0+ (0.005,-0.315) [-0.315|0.32] "rad"  GW
 SG_ ARS_RDI_SNR_Clu_395 : 238|7@0+ (0.5,0) [0|63.5] "dB"  GW
 SG_ ARS_RDI_RCS_Clu_392 : 16|9@0+ (0.2,-51.2) [-51.2|51] "dBsm"  GW
 SG_ ARS_RDI_Range_Clu_396 : 247|12@0+ (0.0625,0) [0|255.9375] "m"  GW
 SG_ ARS_RDI_VradRel_Clu_396 : 251|11@0+ (0.1,-120) [-120|84.7] "m/s"  GW
 SG_ ARS_RDI_RCS_Clu_396 : 256|9@0+ (0.2,-51.2) [-51.2|51] "dBsm"  GW
 SG_ ARS_RDI_AzimuthAng_Clu_396 : 279|10@0+ (0.002,-1.022) [-1.022|1.024] "rad"  GW
 SG_ ARS_RDI_ElevationAng_Clu_396 : 285|7@0+ (0.005,-0.315) [-0.315|0.32] "rad"  GW
 SG_ ARS_RDI_SNR_Clu_396 : 294|7@0+ (0.5,0) [0|63.5] "dB"  GW
 SG_ ARS_RDI_DynProp_Clu_396 : 303|2@0+ (1,0) [0|3] ""  GW
 SG_ ARS_RDI_Quality_Clu_396 : 301|2@0+ (1,0) [0|3] ""  GW
 SG_ ARS_RDI_DynProp_Clu_397 : 299|2@0+ (1,0) [0|3] ""  GW
 SG_ ARS_RDI_Quality_Clu_397 : 297|2@0+ (1,0) [0|3] ""  GW
 SG_ ARS_RDI_Range_Clu_397 : 311|12@0+ (0.0625,0) [0|255.9375] "m"  GW
 SG_ ARS_RDI_VradRel_Clu_397 : 315|11@0+ (0.1,-120) [-120|84.7] "m/s"  GW
 SG_ ARS_RDI_RCS_Clu_397 : 320|9@0+ (0.2,-51.2) [-51.2|51] "dBsm"  GW
 SG_ ARS_RDI_AzimuthAng_Clu_392 : 39|10@0+ (0.002,-1.022) [-1.022|1.024] "rad"  GW
 SG_ ARS_RDI_AzimuthAng_Clu_397 : 343|10@0+ (0.002,-1.022) [-1.022|1.024] "rad"  GW
 SG_ ARS_RDI_ElevationAng_Clu_397 : 349|7@0+ (0.005,-0.315) [-0.315|0.32] "rad"  GW
 SG_ ARS_RDI_SNR_Clu_397 : 358|7@0+ (0.5,0) [0|63.5] "dB"  GW
 SG_ ARS_RDI_Range_Clu_398 : 367|12@0+ (0.0625,0) [0|255.9375] "m"  GW
 SG_ ARS_RDI_VradRel_Clu_398 : 371|11@0+ (0.1,-120) [-120|84.7] "m/s"  GW
 SG_ ARS_RDI_RCS_Clu_398 : 376|9@0+ (0.2,-51.2) [-51.2|51] "dBsm"  GW
 SG_ ARS_RDI_AzimuthAng_Clu_398 : 399|10@0+ (0.002,-1.022) [-1.022|1.024] "rad"  GW
 SG_ ARS_RDI_ElevationAng_Clu_398 : 405|7@0+ (0.005,-0.315) [-0.315|0.32] "rad"  GW
 SG_ ARS_RDI_SNR_Clu_398 : 414|7@0+ (0.5,0) [0|63.5] "dB"  GW
 SG_ ARS_RDI_DynProp_Clu_398 : 423|2@0+ (1,0) [0|3] ""  GW
 SG_ ARS_RDI_Quality_Clu_398 : 421|2@0+ (1,0) [0|3] ""  GW
 SG_ ARS_RDI_DynProp_Clu_399 : 419|2@0+ (1,0) [0|3] ""  GW
 SG_ ARS_RDI_Quality_Clu_399 : 417|2@0+ (1,0) [0|3] ""  GW
 SG_ ARS_RDI_Range_Clu_399 : 431|12@0+ (0.0625,0) [0|255.9375] "m"  GW
 SG_ ARS_RDI_ElevationAng_Clu_392 : 45|7@0+ (0.005,-0.315) [-0.315|0.32] "rad"  GW
 SG_ ARS_RDI_VradRel_Clu_399 : 435|11@0+ (0.1,-120) [-120|84.7] "m/s"  GW
 SG_ ARS_RDI_RCS_Clu_399 : 440|9@0+ (0.2,-51.2) [-51.2|51] "dBsm"  GW
 SG_ ARS_RDI_AzimuthAng_Clu_399 : 463|10@0+ (0.002,-1.022) [-1.022|1.024] "rad"  GW
 SG_ ARS_RDI_ElevationAng_Clu_399 : 469|7@0+ (0.005,-0.315) [-0.315|0.32] "rad"  GW
 SG_ ARS_RDI_SNR_Clu_399 : 478|7@0+ (0.5,0) [0|63.5] "dB"  GW
 SG_ ARS_RDI_MsgCounter_Clu_392_399 : 495|8@0+ (1,0) [0|255] ""  GW
 SG_ ARS_RDI_CRC16_Checksum_Clu_392_3 : 503|16@0+ (1,0) [0|65535] ""  GW
 SG_ ARS_RDI_SNR_Clu_392 : 54|7@0+ (0.5,0) [0|63.5] "dB"  GW
 SG_ ARS_RDI_DynProp_Clu_392 : 63|2@0+ (1,0) [0|3] ""  GW
 SG_ ARS_RDI_Quality_Clu_392 : 61|2@0+ (1,0) [0|3] ""  GW
 SG_ ARS_RDI_DynProp_Clu_393 : 59|2@0+ (1,0) [0|3] ""  GW
 SG_ ARS_RDI_Quality_Clu_393 : 57|2@0+ (1,0) [0|3] ""  GW
 SG_ ARS_RDI_Range_Clu_393 : 71|12@0+ (0.0625,0) [0|255.9375] "m"  GW
 SG_ ARS_RDI_VradRel_Clu_393 : 75|11@0+ (0.1,-120) [-120|84.7] "m/s"  GW
 SG_ ARS_RDI_RCS_Clu_393 : 80|9@0+ (0.2,-51.2) [-51.2|51] "dBsm"  GW
 SG_ ARS_RDI_AzimuthAng_Clu_393 : 103|10@0+ (0.002,-1.022) [-1.022|1.024] "rad"  GW

BO_ 512 ARS_OD_Header: 32 FR
 SG_ ARS_OD_TimeStampGlobSec : 7|32@0+ (1,0) [0|4294967295] "s"  GW
 SG_ ARS_OD_CycleCounter : 119|16@0+ (1,0) [0|65535] ""  GW
 SG_ ARS_OD_NumOfObjects : 135|6@0+ (1,0) [0|63] ""  GW
 SG_ ARS_OD_TaskValidFlag : 129|1@0+ (1,0) [0|1] ""  GW
 SG_ ARS_OD_ExtendedCycleFlag : 128|1@0+ (1,0) [0|1] ""  GW
 SG_ ARS_OD_Latency : 143|11@0+ (0.1,30) [30|234.7] "ms"  GW
 SG_ ARS_OD_EgoVelocity : 148|11@0+ (0.05,-17) [-17|85.35] "m/s"  GW
 SG_ ARS_OD_EgoYawRate : 153|10@0+ (0.001,-0.511) [-0.511|0.512] "rad/s"  GW
 SG_ ARS_OD_EgoVelocityStd : 175|7@0+ (0.1,0) [0|12.7] "m/s"  GW
 SG_ ARS_OD_EgoAcceleration : 168|9@0+ (0.0625,-10) [-10|21.9375] "m/s^2"  GW
 SG_ ARS_OD_EgoCurvature : 191|10@0+ (0.001,-0.511) [-0.511|0.512] "1/m"  GW
 SG_ ARS_OD_MsgCounter_Header : 239|8@0+ (1,0) [0|255] ""  GW
 SG_ ARS_OD_CRC16_Checksum_Header : 247|16@0+ (1,0) [0|65535] ""  GW
 SG_ ARS_OD_TimeStampGlobNanoSec : 39|32@0+ (1,0) [0|4294967295] "ns"  GW
 SG_ ARS_OD_TimeStampLocal : 71|32@0+ (1,0) [0|4294967295] "us"  GW
 SG_ ARS_OD_MeasCounter : 103|16@0+ (1,0) [0|65535] ""  GW

BO_ 513 ARS_OD_00_01: 64 FR
 SG_ ARS_OD_DistX_Obj_00 : 7|12@0+ (0.0875,-100.0125) [-100.0125|258.3] "m"  GW
 SG_ ARS_OD_Classification_Obj_00 : 98|3@0+ (1,0) [0|7] ""  GW
 SG_ ARS_OD_AabsYStd_Obj_00 : 111|8@0+ (0.25,0) [0|63.75] "m/s^2"  GW
 SG_ ARS_OD_ClassConf_Obj_00 : 119|7@0+ (1,0) [0|127] "%"  GW
 SG_ ARS_OD_ProbOfExist_Obj_00 : 112|7@0+ (1,0) [0|127] "%"  GW
 SG_ ARS_OD_DynConf_Obj_00 : 121|7@0+ (1,0) [0|127] "%"  GW
 SG_ ARS_OD_VabsX_Obj_00 : 11|11@0+ (0.125,-128) [-128|127.875] "m/s"  GW
 SG_ ARS_OD_DynProp_Obj_00 : 130|3@0+ (1,0) [0|7] ""  GW
 SG_ ARS_OD_MirrorProb_Obj_00 : 143|7@0+ (1,0) [0|127] "%"  GW
 SG_ ARS_OD_Length_Obj_00 : 136|7@0+ (0.2,0) [0|25.4] "m"  GW
 SG_ ARS_OD_MaintenanceState_Obj_00 : 145|2@0+ (1,0) [0|3] ""  GW
 SG_ ARS_OD_Width_Obj_00 : 159|7@0+ (0.2,0) [0|25.4] "m"  GW
 SG_ ARS_OD_RCS_Obj_00 : 152|9@0+ (0.2,-51.2) [-51.2|51] "dBsm"  GW
 SG_ ARS_OD_Orientation_Obj_00 : 175|10@0+ (0.01,-5.11) [-5.11|5.12] "rad"  GW
 SG_ ARS_OD_YawRateAbs_Obj_00 : 181|10@0+ (0.001,-0.511) [-0.511|0.512] "rad/s"  GW
 SG_ ARS_OD_YawRateAbsStd_Obj_00 : 187|10@0+ (0.0001,0) [0|0.1023] "rad/s"  GW
 SG_ ARS_OD_RefPoint_Obj_00 : 193|2@0+ (1,0) [0|3] ""  GW
 SG_ ARS_OD_LifeCycle_Obj_00 : 207|16@0+ (1,0) [0|65535] ""  GW
 SG_ ARS_OD_DistX_Obj_01 : 223|12@0+ (0.0875,-100.0125) [-100.0125|258.3] "m"  GW
 SG_ ARS_OD_VabsX_Obj_01 : 227|11@0+ (0.125,-128) [-128|127.875] "m/s"  GW
 SG_ ARS_OD_AabsX_Obj_01 : 232|9@0+ (0.125,-31.875) [-31.875|32] "m/s^2"  GW
 SG_ ARS_OD_AabsX_Obj_00 : 16|9@0+ (0.125,-31.875) [-31.875|32] "m/s^2"  GW
 SG_ ARS_OD_DistY_Obj_01 : 255|12@0+ (0.0875,-179.1125) [-179.1125|179.2] "m"  GW
 SG_ ARS_OD_VabsY_Obj_01 : 259|11@0+ (0.125,-128) [-128|127.875] "m/s"  GW
 SG_ ARS_OD_AabsY_Obj_01 : 264|9@0+ (0.125,-31.875) [-31.875|32] "m/s^2"  GW
 SG_ ARS_OD_DistXStd_Obj_01 : 287|8@0+ (0.05,0) [0|12.75] "m"  GW
 SG_ ARS_OD_DistYStd_Obj_01 : 295|8@0+ (0.1,0) [0|25.5] "m"  GW
 SG_ ARS_OD_VabsXStd_Obj_01 : 303|7@0+ (0.1,0) [0|12.7] "m/s"  GW
 SG_ ARS_OD_VabsYStd_Obj_01 : 296|7@0+ (0.2,0) [0|25.4] "m/s"  GW
 SG_ ARS_OD_AabsXStd_Obj_01 : 305|7@0+ (0.25,0) [0|31.75] "m/s^2"  GW
 SG_ ARS_OD_Classification_Obj_01 : 314|3@0+ (1,0) [0|7] ""  GW
 SG_ ARS_OD_AabsYStd_Obj_01 : 327|8@0+ (0.25,0) [0|63.75] "m/s^2"  GW
 SG_ ARS_OD_ClassConf_Obj_01 : 335|7@0+ (1,0) [0|127] "%"  GW
 SG_ ARS_OD_DistY_Obj_00 : 39|12@0+ (0.0875,-179.1125) [-179.1125|179.2] "m"  GW
 SG_ ARS_OD_ProbOfExist_Obj_01 : 328|7@0+ (1,0) [0|127] "%"  GW
 SG_ ARS_OD_DynConf_Obj_01 : 337|7@0+ (1,0) [0|127] "%"  GW
 SG_ ARS_OD_DynProp_Obj_01 : 346|3@0+ (1,0) [0|7] ""  GW
 SG_ ARS_OD_MirrorProb_Obj_01 : 359|7@0+ (1,0) [0|127] "%"  GW
 SG_ ARS_OD_Length_Obj_01 : 352|7@0+ (0.2,0) [0|25.4] "m"  GW
 SG_ ARS_OD_MaintenanceState_Obj_01 : 361|2@0+ (1,0) [0|3] ""  GW
 SG_ ARS_OD_Width_Obj_01 : 375|7@0+ (0.2,0) [0|25.4] "m"  GW
 SG_ ARS_OD_RCS_Obj_01 : 368|9@0+ (0.2,-51.2) [-51.2|51] "dBsm"  GW
 SG_ ARS_OD_Orientation_Obj_01 : 391|10@0+ (0.01,-5.11) [-5.11|5.12] "rad"  GW
 SG_ ARS_OD_YawRateAbs_Obj_01 : 397|10@0+ (0.001,-0.511) [-0.511|0.512] "rad/s"  GW
 SG_ ARS_OD_YawRateAbsStd_Obj_01 : 403|10@0+ (0.0001,0) [0|0.1023] "rad/s"  GW
 SG_ ARS_OD_RefPoint_Obj_01 : 409|2@0+ (1,0) [0|3] ""  GW
 SG_ ARS_OD_LifeCycle_Obj_01 : 423|16@0+ (1,0) [0|65535] ""  GW
 SG_ ARS_OD_OrientationStd_Obj_00 : 439|4@0+ (0.002,0) [0|0.03] "rad"  GW
 SG_ ARS_OD_OrientationStd_Obj_01 : 435|4@0+ (0.002,0) [0|0.03] "rad"  GW
 SG_ ARS_OD_ObstacleProb_Obj_00 : 447|7@0+ (1,0) [0|127] "%"  GW
 SG_ ARS_OD_MicroDopplerFlag_00 : 440|1@0+ (1,0) [0|1] ""  GW
 SG_ ARS_OD_ObstacleProb_Obj_01 : 455|7@0+ (1,0) [0|127] "%"  GW
 SG_ ARS_OD_VabsY_Obj_00 : 43|11@0+ (0.125,-128) [-128|127.875] "m/s"  GW
 SG_ ARS_OD_MicroDopplerFlag_01 : 448|1@0+ (1,0) [0|1] ""  GW
 SG_ ARS_OD_ID_00 : 463|8@0+ (1,0) [0|255] ""  GW
 SG_ ARS_OD_ID_01 : 471|8@0+ (1,0) [0|255] ""  GW
 SG_ ARS_OD_MsgCounter_Obj_00_01 : 495|8@0+ (1,0) [0|255] ""  GW
 SG_ ARS_OD_CRC16_Checksum_Obj_00_01 : 503|16@0+ (1,0) [0|65535] ""  GW
 SG_ ARS_OD_AabsY_Obj_00 : 48|9@0+ (0.125,-31.875) [-31.875|32] "m/s^2"  GW
 SG_ ARS_OD_DistXStd_Obj_00 : 71|8@0+ (0.05,0) [0|12.75] "m"  GW
 SG_ ARS_OD_DistYStd_Obj_00 : 79|8@0+ (0.1,0) [0|25.5] "m"  GW
 SG_ ARS_OD_VabsXStd_Obj_00 : 87|7@0+ (0.1,0) [0|12.7] "m/s"  GW
 SG_ ARS_OD_VabsYStd_Obj_00 : 80|7@0+ (0.2,0) [0|25.4] "m/s"  GW
 SG_ ARS_OD_AabsXStd_Obj_00 : 89|7@0+ (0.25,0) [0|31.75] "m/s^2"  GW

BO_ 514 ARS_OD_02_03: 64 FR
 SG_ ARS_OD_DistX_Obj_02 : 7|12@0+ (0.0875,-100.0125) [-100.0125|258.3] "m"  GW
 SG_ ARS_OD_Classification_Obj_02 : 98|3@0+ (1,0) [0|7] ""  GW
 SG_ ARS_OD_AabsYStd_Obj_02 : 111|8@0+ (0.25,0) [0|63.75] "m/s^2"  GW
 SG_ ARS_OD_ClassConf_Obj_02 : 119|7@0+ (1,0) [0|127] "%"  GW
 SG_ ARS_OD_ProbOfExist_Obj_02 : 112|7@0+ (1,0) [0|127] "%"  GW
 SG_ ARS_OD_DynConf_Obj_02 : 121|7@0+ (1,0) [0|127] "%"  GW
 SG_ ARS_OD_VabsX_Obj_02 : 11|11@0+ (0.125,-128) [-128|127.875] "m/s"  GW
 SG_ ARS_OD_DynProp_Obj_02 : 130|3@0+ (1,0) [0|7] ""  GW
 SG_ ARS_OD_MirrorProb_Obj_02 : 143|7@0+ (1,0) [0|127] "%"  GW
 SG_ ARS_OD_Length_Obj_02 : 136|7@0+ (0.2,0) [0|25.4] "m"  GW
 SG_ ARS_OD_MaintenanceState_Obj_02 : 145|2@0+ (1,0) [0|3] ""  GW
 SG_ ARS_OD_Width_Obj_02 : 159|7@0+ (0.2,0) [0|25.4] "m"  GW
 SG_ ARS_OD_RCS_Obj_02 : 152|9@0+ (0.2,-51.2) [-51.2|51] "dBsm"  GW
 SG_ ARS_OD_Orientation_Obj_02 : 175|10@0+ (0.01,-5.11) [-5.11|5.12] "rad"  GW
 SG_ ARS_OD_YawRateAbs_Obj_02 : 181|10@0+ (0.001,-0.511) [-0.511|0.512] "rad/s"  GW
 SG_ ARS_OD_YawRateAbsStd_Obj_02 : 187|10@0+ (0.0001,0) [0|0.1023] "rad/s"  GW
 SG_ ARS_OD_RefPoint_Obj_02 : 193|2@0+ (1,0) [0|3] ""  GW
 SG_ ARS_OD_LifeCycle_Obj_02 : 207|16@0+ (1,0) [0|65535] ""  GW
 SG_ ARS_OD_DistX_Obj_03 : 223|12@0+ (0.0875,-100.0125) [-100.0125|258.3] "m"  GW
 SG_ ARS_OD_VabsX_Obj_03 : 227|11@0+ (0.125,-128) [-128|127.875] "m/s"  GW
 SG_ ARS_OD_AabsX_Obj_03 : 232|9@0+ (0.125,-31.875) [-31.875|32] "m/s^2"  GW
 SG_ ARS_OD_AabsX_Obj_02 : 16|9@0+ (0.125,-31.875) [-31.875|32] "m/s^2"  GW
 SG_ ARS_OD_DistY_Obj_03 : 255|12@0+ (0.0875,-179.1125) [-179.1125|179.2] "m"  GW
 SG_ ARS_OD_VabsY_Obj_03 : 259|11@0+ (0.125,-128) [-128|127.875] "m/s"  GW
 SG_ ARS_OD_AabsY_Obj_03 : 264|9@0+ (0.125,-31.875) [-31.875|32] "m/s^2"  GW
 SG_ ARS_OD_DistXStd_Obj_03 : 287|8@0+ (0.05,0) [0|12.75] "m"  GW
 SG_ ARS_OD_DistYStd_Obj_03 : 295|8@0+ (0.1,0) [0|25.5] "m"  GW
 SG_ ARS_OD_VabsXStd_Obj_03 : 303|7@0+ (0.1,0) [0|12.7] "m/s"  GW
 SG_ ARS_OD_VabsYStd_Obj_03 : 296|7@0+ (0.2,0) [0|25.4] "m/s"  GW
 SG_ ARS_OD_AabsXStd_Obj_03 : 305|7@0+ (0.25,0) [0|31.75] "m/s^2"  GW
 SG_ ARS_OD_Classification_Obj_03 : 314|3@0+ (1,0) [0|7] ""  GW
 SG_ ARS_OD_AabsYStd_Obj_03 : 327|8@0+ (0.25,0) [0|63.75] "m/s^2"  GW
 SG_ ARS_OD_ClassConf_Obj_03 : 335|7@0+ (1,0) [0|127] "%"  GW
 SG_ ARS_OD_DistY_Obj_02 : 39|12@0+ (0.0875,-179.1125) [-179.1125|179.2] "m"  GW
 SG_ ARS_OD_ProbOfExist_Obj_03 : 328|7@0+ (1,0) [0|127] "%"  GW
 SG_ ARS_OD_DynConf_Obj_03 : 337|7@0+ (1,0) [0|127] "%"  GW
 SG_ ARS_OD_DynProp_Obj_03 : 346|3@0+ (1,0) [0|7] ""  GW
 SG_ ARS_OD_MirrorProb_Obj_03 : 359|7@0+ (1,0) [0|127] "%"  GW
 SG_ ARS_OD_Length_Obj_03 : 352|7@0+ (0.2,0) [0|25.4] "m"  GW
 SG_ ARS_OD_MaintenanceState_Obj_03 : 361|2@0+ (1,0) [0|3] ""  GW
 SG_ ARS_OD_Width_Obj_03 : 375|7@0+ (0.2,0) [0|25.4] "m"  GW
 SG_ ARS_OD_RCS_Obj_03 : 368|9@0+ (0.2,-51.2) [-51.2|51] "dBsm"  GW
 SG_ ARS_OD_Orientation_Obj_03 : 391|10@0+ (0.01,-5.11) [-5.11|5.12] "rad"  GW
 SG_ ARS_OD_YawRateAbs_Obj_03 : 397|10@0+ (0.001,-0.511) [-0.511|0.512] "rad/s"  GW
 SG_ ARS_OD_YawRateAbsStd_Obj_03 : 403|10@0+ (0.0001,0) [0|0.1023] "rad/s"  GW
 SG_ ARS_OD_RefPoint_Obj_03 : 409|2@0+ (1,0) [0|3] ""  GW
 SG_ ARS_OD_LifeCycle_Obj_03 : 423|16@0+ (1,0) [0|65535] ""  GW
 SG_ ARS_OD_OrientationStd_Obj_02 : 439|4@0+ (0.002,0) [0|0.03] "rad"  GW
 SG_ ARS_OD_OrientationStd_Obj_03 : 435|4@0+ (0.002,0) [0|0.03] "rad"  GW
 SG_ ARS_OD_ObstacleProb_Obj_02 : 447|7@0+ (1,0) [0|127] "%"  GW
 SG_ ARS_OD_MicroDopplerFlag_02 : 440|1@0+ (1,0) [0|1] ""  GW
 SG_ ARS_OD_ObstacleProb_Obj_03 : 455|7@0+ (1,0) [0|127] "%"  GW
 SG_ ARS_OD_VabsY_Obj_02 : 43|11@0+ (0.125,-128) [-128|127.875] "m/s"  GW
 SG_ ARS_OD_MicroDopplerFlag_03 : 448|1@0+ (1,0) [0|1] ""  GW
 SG_ ARS_OD_ID_02 : 463|8@0+ (1,0) [0|255] ""  GW
 SG_ ARS_OD_ID_03 : 471|8@0+ (1,0) [0|255] ""  GW
 SG_ ARS_OD_MsgCounter_Obj_02_03 : 495|8@0+ (1,0) [0|255] ""  GW
 SG_ ARS_OD_CRC16_Checksum_Obj_02_03 : 503|16@0+ (1,0) [0|65535] ""  GW
 SG_ ARS_OD_AabsY_Obj_02 : 48|9@0+ (0.125,-31.875) [-31.875|32] "m/s^2"  GW
 SG_ ARS_OD_DistXStd_Obj_02 : 71|8@0+ (0.05,0) [0|12.75] "m"  GW
 SG_ ARS_OD_DistYStd_Obj_02 : 79|8@0+ (0.1,0) [0|25.5] "m"  GW
 SG_ ARS_OD_VabsXStd_Obj_02 : 87|7@0+ (0.1,0) [0|12.7] "m/s"  GW
 SG_ ARS_OD_VabsYStd_Obj_02 : 80|7@0+ (0.2,0) [0|25.4] "m/s"  GW
 SG_ ARS_OD_AabsXStd_Obj_02 : 89|7@0+ (0.25,0) [0|31.75] "m/s^2"  GW

BO_ 515 ARS_OD_04_05: 64 FR
 SG_ ARS_OD_DistX_Obj_04 : 7|12@0+ (0.0875,-100.0125) [-100.0125|258.3] "m"  GW
 SG_ ARS_OD_Classification_Obj_04 : 98|3@0+ (1,0) [0|7] ""  GW
 SG_ ARS_OD_AabsYStd_Obj_04 : 111|8@0+ (0.25,0) [0|63.75] "m/s^2"  GW
 SG_ ARS_OD_ClassConf_Obj_04 : 119|7@0+ (1,0) [0|127] "%"  GW
 SG_ ARS_OD_ProbOfExist_Obj_04 : 112|7@0+ (1,0) [0|127] "%"  GW
 SG_ ARS_OD_DynConf_Obj_04 : 121|7@0+ (1,0) [0|127] "%"  GW
 SG_ ARS_OD_VabsX_Obj_04 : 11|11@0+ (0.125,-128) [-128|127.875] "m/s"  GW
 SG_ ARS_OD_DynProp_Obj_04 : 130|3@0+ (1,0) [0|7] ""  GW
 SG_ ARS_OD_MirrorProb_Obj_04 : 143|7@0+ (1,0) [0|127] "%"  GW
 SG_ ARS_OD_Length_Obj_04 : 136|7@0+ (0.2,0) [0|25.4] "m"  GW
 SG_ ARS_OD_MaintenanceState_Obj_04 : 145|2@0+ (1,0) [0|3] ""  GW
 SG_ ARS_OD_Width_Obj_04 : 159|7@0+ (0.2,0) [0|25.4] "m"  GW
 SG_ ARS_OD_RCS_Obj_04 : 152|9@0+ (0.2,-51.2) [-51.2|51] "dBsm"  GW
 SG_ ARS_OD_Orientation_Obj_04 : 175|10@0+ (0.01,-5.11) [-5.11|5.12] "rad"  GW
 SG_ ARS_OD_YawRateAbs_Obj_04 : 181|10@0+ (0.001,-0.511) [-0.511|0.512] "rad/s"  GW
 SG_ ARS_OD_YawRateAbsStd_Obj_04 : 187|10@0+ (0.0001,0) [0|0.1023] "rad/s"  GW
 SG_ ARS_OD_RefPoint_Obj_04 : 193|2@0+ (1,0) [0|3] ""  GW
 SG_ ARS_OD_LifeCycle_Obj_04 : 207|16@0+ (1,0) [0|65535] ""  GW
 SG_ ARS_OD_DistX_Obj_05 : 223|12@0+ (0.0875,-100.0125) [-100.0125|258.3] "m"  GW
 SG_ ARS_OD_VabsX_Obj_05 : 227|11@0+ (0.125,-128) [-128|127.875] "m/s"  GW
 SG_ ARS_OD_AabsX_Obj_05 : 232|9@0+ (0.125,-31.875) [-31.875|32] "m/s^2"  GW
 SG_ ARS_OD_AabsX_Obj_04 : 16|9@0+ (0.125,-31.875) [-31.875|32] "m/s^2"  GW
 SG_ ARS_OD_DistY_Obj_05 : 255|12@0+ (0.0875,-179.1125) [-179.1125|179.2] "m"  GW
 SG_ ARS_OD_VabsY_Obj_05 : 259|11@0+ (0.125,-128) [-128|127.875] "m/s"  GW
 SG_ ARS_OD_AabsY_Obj_05 : 264|9@0+ (0.125,-31.875) [-31.875|32] "m/s^2"  GW
 SG_ ARS_OD_DistXStd_Obj_05 : 287|8@0+ (0.05,0) [0|12.75] "m"  GW
 SG_ ARS_OD_DistYStd_Obj_05 : 295|8@0+ (0.1,0) [0|25.5] "m"  GW
 SG_ ARS_OD_VabsXStd_Obj_05 : 303|7@0+ (0.1,0) [0|12.7] "m/s"  GW
 SG_ ARS_OD_VabsYStd_Obj_05 : 296|7@0+ (0.2,0) [0|25.4] "m/s"  GW
 SG_ ARS_OD_AabsXStd_Obj_05 : 305|7@0+ (0.25,0) [0|31.75] "m/s^2"  GW
 SG_ ARS_OD_Classification_Obj_05 : 314|3@0+ (1,0) [0|7] ""  GW
 SG_ ARS_OD_AabsYStd_Obj_05 : 327|8@0+ (0.25,0) [0|63.75] "m/s^2"  GW
 SG_ ARS_OD_ClassConf_Obj_05 : 335|7@0+ (1,0) [0|127] "%"  GW
 SG_ ARS_OD_DistY_Obj_04 : 39|12@0+ (0.0875,-179.1125) [-179.1125|179.2] "m"  GW
 SG_ ARS_OD_ProbOfExist_Obj_05 : 328|7@0+ (1,0) [0|127] "%"  GW
 SG_ ARS_OD_DynConf_Obj_05 : 337|7@0+ (1,0) [0|127] "%"  GW
 SG_ ARS_OD_DynProp_Obj_05 : 346|3@0+ (1,0) [0|7] ""  GW
 SG_ ARS_OD_MirrorProb_Obj_05 : 359|7@0+ (1,0) [0|127] "%"  GW
 SG_ ARS_OD_Length_Obj_05 : 352|7@0+ (0.2,0) [0|25.4] "m"  GW
 SG_ ARS_OD_MaintenanceState_Obj_05 : 361|2@0+ (1,0) [0|3] ""  GW
 SG_ ARS_OD_Width_Obj_05 : 375|7@0+ (0.2,0) [0|25.4] "m"  GW
 SG_ ARS_OD_RCS_Obj_05 : 368|9@0+ (0.2,-51.2) [-51.2|51] "dBsm"  GW
 SG_ ARS_OD_Orientation_Obj_05 : 391|10@0+ (0.01,-5.11) [-5.11|5.12] "rad"  GW
 SG_ ARS_OD_YawRateAbs_Obj_05 : 397|10@0+ (0.001,-0.511) [-0.511|0.512] "rad/s"  GW
 SG_ ARS_OD_YawRateAbsStd_Obj_05 : 403|10@0+ (0.0001,0) [0|0.1023] "rad/s"  GW
 SG_ ARS_OD_RefPoint_Obj_05 : 409|2@0+ (1,0) [0|3] ""  GW
 SG_ ARS_OD_LifeCycle_Obj_05 : 423|16@0+ (1,0) [0|65535] ""  GW
 SG_ ARS_OD_OrientationStd_Obj_04 : 439|4@0+ (0.002,0) [0|0.03] "rad"  GW
 SG_ ARS_OD_OrientationStd_Obj_05 : 435|4@0+ (0.002,0) [0|0.03] "rad"  GW
 SG_ ARS_OD_ObstacleProb_Obj_04 : 447|7@0+ (1,0) [0|127] "%"  GW
 SG_ ARS_OD_MicroDopplerFlag_04 : 440|1@0+ (1,0) [0|1] ""  GW
 SG_ ARS_OD_ObstacleProb_Obj_05 : 455|7@0+ (1,0) [0|127] "%"  GW
 SG_ ARS_OD_VabsY_Obj_04 : 43|11@0+ (0.125,-128) [-128|127.875] "m/s"  GW
 SG_ ARS_OD_MicroDopplerFlag_05 : 448|1@0+ (1,0) [0|1] ""  GW
 SG_ ARS_OD_ID_04 : 463|8@0+ (1,0) [0|255] ""  GW
 SG_ ARS_OD_ID_05 : 471|8@0+ (1,0) [0|255] ""  GW
 SG_ ARS_OD_MsgCounter_Obj_04_05 : 495|8@0+ (1,0) [0|255] ""  GW
 SG_ ARS_OD_CRC16_Checksum_Obj_04_05 : 503|16@0+ (1,0) [0|65535] ""  GW
 SG_ ARS_OD_AabsY_Obj_04 : 48|9@0+ (0.125,-31.875) [-31.875|32] "m/s^2"  GW
 SG_ ARS_OD_DistXStd_Obj_04 : 71|8@0+ (0.05,0) [0|12.75] "m"  GW
 SG_ ARS_OD_DistYStd_Obj_04 : 79|8@0+ (0.1,0) [0|25.5] "m"  GW
 SG_ ARS_OD_VabsXStd_Obj_04 : 87|7@0+ (0.1,0) [0|12.7] "m/s"  GW
 SG_ ARS_OD_VabsYStd_Obj_04 : 80|7@0+ (0.2,0) [0|25.4] "m/s"  GW
 SG_ ARS_OD_AabsXStd_Obj_04 : 89|7@0+ (0.25,0) [0|31.75] "m/s^2"  GW

BO_ 516 ARS_OD_06_07: 64 FR
 SG_ ARS_OD_DistX_Obj_06 : 7|12@0+ (0.0875,-100.0125) [-100.0125|258.3] "m"  GW
 SG_ ARS_OD_Classification_Obj_06 : 98|3@0+ (1,0) [0|7] ""  GW
 SG_ ARS_OD_AabsYStd_Obj_06 : 111|8@0+ (0.25,0) [0|63.75] "m/s^2"  GW
 SG_ ARS_OD_ClassConf_Obj_06 : 119|7@0+ (1,0) [0|127] "%"  GW
 SG_ ARS_OD_ProbOfExist_Obj_06 : 112|7@0+ (1,0) [0|127] "%"  GW
 SG_ ARS_OD_DynConf_Obj_06 : 121|7@0+ (1,0) [0|127] "%"  GW
 SG_ ARS_OD_VabsX_Obj_06 : 11|11@0+ (0.125,-128) [-128|127.875] "m/s"  GW
 SG_ ARS_OD_DynProp_Obj_06 : 130|3@0+ (1,0) [0|7] ""  GW
 SG_ ARS_OD_MirrorProb_Obj_06 : 143|7@0+ (1,0) [0|127] "%"  GW
 SG_ ARS_OD_Length_Obj_06 : 136|7@0+ (0.2,0) [0|25.4] "m"  GW
 SG_ ARS_OD_MaintenanceState_Obj_06 : 145|2@0+ (1,0) [0|3] ""  GW
 SG_ ARS_OD_Width_Obj_06 : 159|7@0+ (0.2,0) [0|25.4] "m"  GW
 SG_ ARS_OD_RCS_Obj_06 : 152|9@0+ (0.2,-51.2) [-51.2|51] "dBsm"  GW
 SG_ ARS_OD_Orientation_Obj_06 : 175|10@0+ (0.01,-5.11) [-5.11|5.12] "rad"  GW
 SG_ ARS_OD_YawRateAbs_Obj_06 : 181|10@0+ (0.001,-0.511) [-0.511|0.512] "rad/s"  GW
 SG_ ARS_OD_YawRateAbsStd_Obj_06 : 187|10@0+ (0.0001,0) [0|0.1023] "rad/s"  GW
 SG_ ARS_OD_RefPoint_Obj_06 : 193|2@0+ (1,0) [0|3] ""  GW
 SG_ ARS_OD_LifeCycle_Obj_06 : 207|16@0+ (1,0) [0|65535] ""  GW
 SG_ ARS_OD_DistX_Obj_07 : 223|12@0+ (0.0875,-100.0125) [-100.0125|258.3] "m"  GW
 SG_ ARS_OD_VabsX_Obj_07 : 227|11@0+ (0.125,-128) [-128|127.875] "m/s"  GW
 SG_ ARS_OD_AabsX_Obj_07 : 232|9@0+ (0.125,-31.875) [-31.875|32] "m/s^2"  GW
 SG_ ARS_OD_AabsX_Obj_06 : 16|9@0+ (0.125,-31.875) [-31.875|32] "m/s^2"  GW
 SG_ ARS_OD_DistY_Obj_07 : 255|12@0+ (0.0875,-179.1125) [-179.1125|179.2] "m"  GW
 SG_ ARS_OD_VabsY_Obj_07 : 259|11@0+ (0.125,-128) [-128|127.875] "m/s"  GW
 SG_ ARS_OD_AabsY_Obj_07 : 264|9@0+ (0.125,-31.875) [-31.875|32] "m/s^2"  GW
 SG_ ARS_OD_DistXStd_Obj_07 : 287|8@0+ (0.05,0) [0|12.75] "m"  GW
 SG_ ARS_OD_DistYStd_Obj_07 : 295|8@0+ (0.1,0) [0|25.5] "m"  GW
 SG_ ARS_OD_VabsXStd_Obj_07 : 303|7@0+ (0.1,0) [0|12.7] "m/s"  GW
 SG_ ARS_OD_VabsYStd_Obj_07 : 296|7@0+ (0.2,0) [0|25.4] "m/s"  GW
 SG_ ARS_OD_AabsXStd_Obj_07 : 305|7@0+ (0.25,0) [0|31.75] "m/s^2"  GW
 SG_ ARS_OD_Classification_Obj_07 : 314|3@0+ (1,0) [0|7] ""  GW
 SG_ ARS_OD_AabsYStd_Obj_07 : 327|8@0+ (0.25,0) [0|63.75] "m/s^2"  GW
 SG_ ARS_OD_ClassConf_Obj_07 : 335|7@0+ (1,0) [0|127] "%"  GW
 SG_ ARS_OD_DistY_Obj_06 : 39|12@0+ (0.0875,-179.1125) [-179.1125|179.2] "m"  GW
 SG_ ARS_OD_ProbOfExist_Obj_07 : 328|7@0+ (1,0) [0|127] "%"  GW
 SG_ ARS_OD_DynConf_Obj_07 : 337|7@0+ (1,0) [0|127] "%"  GW
 SG_ ARS_OD_DynProp_Obj_07 : 346|3@0+ (1,0) [0|7] ""  GW
 SG_ ARS_OD_MirrorProb_Obj_07 : 359|7@0+ (1,0) [0|127] "%"  GW
 SG_ ARS_OD_Length_Obj_07 : 352|7@0+ (0.2,0) [0|25.4] "m"  GW
 SG_ ARS_OD_MaintenanceState_Obj_07 : 361|2@0+ (1,0) [0|3] ""  GW
 SG_ ARS_OD_Width_Obj_07 : 375|7@0+ (0.2,0) [0|25.4] "m"  GW
 SG_ ARS_OD_RCS_Obj_07 : 368|9@0+ (0.2,-51.2) [-51.2|51] "dBsm"  GW
 SG_ ARS_OD_Orientation_Obj_07 : 391|10@0+ (0.01,-5.11) [-5.11|5.12] "rad"  GW
 SG_ ARS_OD_YawRateAbs_Obj_07 : 397|10@0+ (0.001,-0.511) [-0.511|0.512] "rad/s"  GW
 SG_ ARS_OD_YawRateAbsStd_Obj_07 : 403|10@0+ (0.0001,0) [0|0.1023] "rad/s"  GW
 SG_ ARS_OD_RefPoint_Obj_07 : 409|2@0+ (1,0) [0|3] ""  GW
 SG_ ARS_OD_LifeCycle_Obj_07 : 423|16@0+ (1,0) [0|65535] ""  GW
 SG_ ARS_OD_OrientationStd_Obj_06 : 439|4@0+ (0.002,0) [0|0.03] "rad"  GW
 SG_ ARS_OD_OrientationStd_Obj_07 : 435|4@0+ (0.002,0) [0|0.03] "rad"  GW
 SG_ ARS_OD_ObstacleProb_Obj_06 : 447|7@0+ (1,0) [0|127] "%"  GW
 SG_ ARS_OD_MicroDopplerFlag_06 : 440|1@0+ (1,0) [0|1] ""  GW
 SG_ ARS_OD_ObstacleProb_Obj_07 : 455|7@0+ (1,0) [0|127] "%"  GW
 SG_ ARS_OD_VabsY_Obj_06 : 43|11@0+ (0.125,-128) [-128|127.875] "m/s"  GW
 SG_ ARS_OD_MicroDopplerFlag_07 : 448|1@0+ (1,0) [0|1] ""  GW
 SG_ ARS_OD_ID_06 : 463|8@0+ (1,0) [0|255] ""  GW
 SG_ ARS_OD_ID_07 : 471|8@0+ (1,0) [0|255] ""  GW
 SG_ ARS_OD_MsgCounter_Obj_06_07 : 495|8@0+ (1,0) [0|255] ""  GW
 SG_ ARS_OD_CRC16_Checksum_Obj_06_07 : 503|16@0+ (1,0) [0|65535] ""  GW
 SG_ ARS_OD_AabsY_Obj_06 : 48|9@0+ (0.125,-31.875) [-31.875|32] "m/s^2"  GW
 SG_ ARS_OD_DistXStd_Obj_06 : 71|8@0+ (0.05,0) [0|12.75] "m"  GW
 SG_ ARS_OD_DistYStd_Obj_06 : 79|8@0+ (0.1,0) [0|25.5] "m"  GW
 SG_ ARS_OD_VabsXStd_Obj_06 : 87|7@0+ (0.1,0) [0|12.7] "m/s"  GW
 SG_ ARS_OD_VabsYStd_Obj_06 : 80|7@0+ (0.2,0) [0|25.4] "m/s"  GW
 SG_ ARS_OD_AabsXStd_Obj_06 : 89|7@0+ (0.25,0) [0|31.75] "m/s^2"  GW

BO_ 517 ARS_OD_08_09: 64 FR
 SG_ ARS_OD_DistX_Obj_08 : 7|12@0+ (0.0875,-100.0125) [-100.0125|258.3] "m"  GW
 SG_ ARS_OD_Classification_Obj_08 : 98|3@0+ (1,0) [0|7] ""  GW
 SG_ ARS_OD_AabsYStd_Obj_08 : 111|8@0+ (0.25,0) [0|63.75] "m/s^2"  GW
 SG_ ARS_OD_ClassConf_Obj_08 : 119|7@0+ (1,0) [0|127] "%"  GW
 SG_ ARS_OD_ProbOfExist_Obj_08 : 112|7@0+ (1,0) [0|127] "%"  GW
 SG_ ARS_OD_DynConf_Obj_08 : 121|7@0+ (1,0) [0|127] "%"  GW
 SG_ ARS_OD_VabsX_Obj_08 : 11|11@0+ (0.125,-128) [-128|127.875] "m/s"  GW
 SG_ ARS_OD_DynProp_Obj_08 : 130|3@0+ (1,0) [0|7] ""  GW
 SG_ ARS_OD_MirrorProb_Obj_08 : 143|7@0+ (1,0) [0|127] "%"  GW
 SG_ ARS_OD_Length_Obj_08 : 136|7@0+ (0.2,0) [0|25.4] "m"  GW
 SG_ ARS_OD_MaintenanceState_Obj_08 : 145|2@0+ (1,0) [0|3] ""  GW
 SG_ ARS_OD_Width_Obj_08 : 159|7@0+ (0.2,0) [0|25.4] "m"  GW
 SG_ ARS_OD_RCS_Obj_08 : 152|9@0+ (0.2,-51.2) [-51.2|51] "dBsm"  GW
 SG_ ARS_OD_Orientation_Obj_08 : 175|10@0+ (0.01,-5.11) [-5.11|5.12] "rad"  GW
 SG_ ARS_OD_YawRateAbs_Obj_08 : 181|10@0+ (0.001,-0.511) [-0.511|0.512] "rad/s"  GW
 SG_ ARS_OD_YawRateAbsStd_Obj_08 : 187|10@0+ (0.0001,0) [0|0.1023] "rad/s"  GW
 SG_ ARS_OD_RefPoint_Obj_08 : 193|2@0+ (1,0) [0|3] ""  GW
 SG_ ARS_OD_LifeCycle_Obj_08 : 207|16@0+ (1,0) [0|65535] ""  GW
 SG_ ARS_OD_DistX_Obj_09 : 223|12@0+ (0.0875,-100.0125) [-100.0125|258.3] "m"  GW
 SG_ ARS_OD_VabsX_Obj_09 : 227|11@0+ (0.125,-128) [-128|127.875] "m/s"  GW
 SG_ ARS_OD_AabsX_Obj_09 : 232|9@0+ (0.125,-31.875) [-31.875|32] "m/s^2"  GW
 SG_ ARS_OD_AabsX_Obj_08 : 16|9@0+ (0.125,-31.875) [-31.875|32] "m/s^2"  GW
 SG_ ARS_OD_DistY_Obj_09 : 255|12@0+ (0.0875,-179.1125) [-179.1125|179.2] "m"  GW
 SG_ ARS_OD_VabsY_Obj_09 : 259|11@0+ (0.125,-128) [-128|127.875] "m/s"  GW
 SG_ ARS_OD_AabsY_Obj_09 : 264|9@0+ (0.125,-31.875) [-31.875|32] "m/s^2"  GW
 SG_ ARS_OD_DistXStd_Obj_09 : 287|8@0+ (0.05,0) [0|12.75] "m"  GW
 SG_ ARS_OD_DistYStd_Obj_09 : 295|8@0+ (0.1,0) [0|25.5] "m"  GW
 SG_ ARS_OD_VabsXStd_Obj_09 : 303|7@0+ (0.1,0) [0|12.7] "m/s"  GW
 SG_ ARS_OD_VabsYStd_Obj_09 : 296|7@0+ (0.2,0) [0|25.4] "m/s"  GW
 SG_ ARS_OD_AabsXStd_Obj_09 : 305|7@0+ (0.25,0) [0|31.75] "m/s^2"  GW
 SG_ ARS_OD_Classification_Obj_09 : 314|3@0+ (1,0) [0|7] ""  GW
 SG_ ARS_OD_AabsYStd_Obj_09 : 327|8@0+ (0.25,0) [0|63.75] "m/s^2"  GW
 SG_ ARS_OD_ClassConf_Obj_09 : 335|7@0+ (1,0) [0|127] "%"  GW
 SG_ ARS_OD_DistY_Obj_08 : 39|12@0+ (0.0875,-179.1125) [-179.1125|179.2] "m"  GW
 SG_ ARS_OD_ProbOfExist_Obj_09 : 328|7@0+ (1,0) [0|127] "%"  GW
 SG_ ARS_OD_DynConf_Obj_09 : 337|7@0+ (1,0) [0|127] "%"  GW
 SG_ ARS_OD_DynProp_Obj_09 : 346|3@0+ (1,0) [0|7] ""  GW
 SG_ ARS_OD_MirrorProb_Obj_09 : 359|7@0+ (1,0) [0|127] "%"  GW
 SG_ ARS_OD_Length_Obj_09 : 352|7@0+ (0.2,0) [0|25.4] "m"  GW
 SG_ ARS_OD_MaintenanceState_Obj_09 : 361|2@0+ (1,0) [0|3] ""  GW
 SG_ ARS_OD_Width_Obj_09 : 375|7@0+ (0.2,0) [0|25.4] "m"  GW
 SG_ ARS_OD_RCS_Obj_09 : 368|9@0+ (0.2,-51.2) [-51.2|51] "dBsm"  GW
 SG_ ARS_OD_Orientation_Obj_09 : 391|10@0+ (0.01,-5.11) [-5.11|5.12] "rad"  GW
 SG_ ARS_OD_YawRateAbs_Obj_09 : 397|10@0+ (0.001,-0.511) [-0.511|0.512] "rad/s"  GW
 SG_ ARS_OD_YawRateAbsStd_Obj_09 : 403|10@0+ (0.0001,0) [0|0.1023] "rad/s"  GW
 SG_ ARS_OD_RefPoint_Obj_09 : 409|2@0+ (1,0) [0|3] ""  GW
 SG_ ARS_OD_LifeCycle_Obj_09 : 423|16@0+ (1,0) [0|65535] ""  GW
 SG_ ARS_OD_OrientationStd_Obj_08 : 439|4@0+ (0.002,0) [0|0.03] "rad"  GW
 SG_ ARS_OD_OrientationStd_Obj_09 : 435|4@0+ (0.002,0) [0|0.03] "rad"  GW
 SG_ ARS_OD_ObstacleProb_Obj_08 : 447|7@0+ (1,0) [0|127] "%"  GW
 SG_ ARS_OD_MicroDopplerFlag_08 : 440|1@0+ (1,0) [0|1] ""  GW
 SG_ ARS_OD_ObstacleProb_Obj_09 : 455|7@0+ (1,0) [0|127] "%"  GW
 SG_ ARS_OD_VabsY_Obj_08 : 43|11@0+ (0.125,-128) [-128|127.875] "m/s"  GW
 SG_ ARS_OD_MicroDopplerFlag_09 : 448|1@0+ (1,0) [0|1] ""  GW
 SG_ ARS_OD_ID_08 : 463|8@0+ (1,0) [0|255] ""  GW
 SG_ ARS_OD_ID_09 : 471|8@0+ (1,0) [0|255] ""  GW
 SG_ ARS_OD_MsgCounter_Obj_08_09 : 495|8@0+ (1,0) [0|255] ""  GW
 SG_ ARS_OD_CRC16_Checksum_Obj_08_09 : 503|16@0+ (1,0) [0|65535] ""  GW
 SG_ ARS_OD_AabsY_Obj_08 : 48|9@0+ (0.125,-31.875) [-31.875|32] "m/s^2"  GW
 SG_ ARS_OD_DistXStd_Obj_08 : 71|8@0+ (0.05,0) [0|12.75] "m"  GW
 SG_ ARS_OD_DistYStd_Obj_08 : 79|8@0+ (0.1,0) [0|25.5] "m"  GW
 SG_ ARS_OD_VabsXStd_Obj_08 : 87|7@0+ (0.1,0) [0|12.7] "m/s"  GW
 SG_ ARS_OD_VabsYStd_Obj_08 : 80|7@0+ (0.2,0) [0|25.4] "m/s"  GW
 SG_ ARS_OD_AabsXStd_Obj_08 : 89|7@0+ (0.25,0) [0|31.75] "m/s^2"  GW

BO_ 518 ARS_OD_10_11: 64 FR
 SG_ ARS_OD_DistX_Obj_10 : 7|12@0+ (0.0875,-100.0125) [-100.0125|258.3] "m"  GW
 SG_ ARS_OD_Classification_Obj_10 : 98|3@0+ (1,0) [0|7] ""  GW
 SG_ ARS_OD_AabsYStd_Obj_10 : 111|8@0+ (0.25,0) [0|63.75] "m/s^2"  GW
 SG_ ARS_OD_ClassConf_Obj_10 : 119|7@0+ (1,0) [0|127] "%"  GW
 SG_ ARS_OD_ProbOfExist_Obj_10 : 112|7@0+ (1,0) [0|127] "%"  GW
 SG_ ARS_OD_DynConf_Obj_10 : 121|7@0+ (1,0) [0|127] "%"  GW
 SG_ ARS_OD_VabsX_Obj_10 : 11|11@0+ (0.125,-128) [-128|127.875] "m/s"  GW
 SG_ ARS_OD_DynProp_Obj_10 : 130|3@0+ (1,0) [0|7] ""  GW
 SG_ ARS_OD_MirrorProb_Obj_10 : 143|7@0+ (1,0) [0|127] "%"  GW
 SG_ ARS_OD_Length_Obj_10 : 136|7@0+ (0.2,0) [0|25.4] "m"  GW
 SG_ ARS_OD_MaintenanceState_Obj_10 : 145|2@0+ (1,0) [0|3] ""  GW
 SG_ ARS_OD_Width_Obj_10 : 159|7@0+ (0.2,0) [0|25.4] "m"  GW
 SG_ ARS_OD_RCS_Obj_10 : 152|9@0+ (0.2,-51.2) [-51.2|51] "dBsm"  GW
 SG_ ARS_OD_Orientation_Obj_10 : 175|10@0+ (0.01,-5.11) [-5.11|5.12] "rad"  GW
 SG_ ARS_OD_YawRateAbs_Obj_10 : 181|10@0+ (0.001,-0.511) [-0.511|0.512] "rad/s"  GW
 SG_ ARS_OD_YawRateAbsStd_Obj_10 : 187|10@0+ (0.0001,0) [0|0.1023] "rad/s"  GW
 SG_ ARS_OD_RefPoint_Obj_10 : 193|2@0+ (1,0) [0|3] ""  GW
 SG_ ARS_OD_LifeCycle_Obj_10 : 207|16@0+ (1,0) [0|65535] ""  GW
 SG_ ARS_OD_DistX_Obj_11 : 223|12@0+ (0.0875,-100.0125) [-100.0125|258.3] "m"  GW
 SG_ ARS_OD_VabsX_Obj_11 : 227|11@0+ (0.125,-128) [-128|127.875] "m/s"  GW
 SG_ ARS_OD_AabsX_Obj_11 : 232|9@0+ (0.125,-31.875) [-31.875|32] "m/s^2"  GW
 SG_ ARS_OD_AabsX_Obj_10 : 16|9@0+ (0.125,-31.875) [-31.875|32] "m/s^2"  GW
 SG_ ARS_OD_DistY_Obj_11 : 255|12@0+ (0.0875,-179.1125) [-179.1125|179.2] "m"  GW
 SG_ ARS_OD_VabsY_Obj_11 : 259|11@0+ (0.125,-128) [-128|127.875] "m/s"  GW
 SG_ ARS_OD_AabsY_Obj_11 : 264|9@0+ (0.125,-31.875) [-31.875|32] "m/s^2"  GW
 SG_ ARS_OD_DistXStd_Obj_11 : 287|8@0+ (0.05,0) [0|12.75] "m"  GW
 SG_ ARS_OD_DistYStd_Obj_11 : 295|8@0+ (0.1,0) [0|25.5] "m"  GW
 SG_ ARS_OD_VabsXStd_Obj_11 : 303|7@0+ (0.1,0) [0|12.7] "m/s"  GW
 SG_ ARS_OD_VabsYStd_Obj_11 : 296|7@0+ (0.2,0) [0|25.4] "m/s"  GW
 SG_ ARS_OD_AabsXStd_Obj_11 : 305|7@0+ (0.25,0) [0|31.75] "m/s^2"  GW
 SG_ ARS_OD_Classification_Obj_11 : 314|3@0+ (1,0) [0|7] ""  GW
 SG_ ARS_OD_AabsYStd_Obj_11 : 327|8@0+ (0.25,0) [0|63.75] "m/s^2"  GW
 SG_ ARS_OD_ClassConf_Obj_11 : 335|7@0+ (1,0) [0|127] "%"  GW
 SG_ ARS_OD_DistY_Obj_10 : 39|12@0+ (0.0875,-179.1125) [-179.1125|179.2] "m"  GW
 SG_ ARS_OD_ProbOfExist_Obj_11 : 328|7@0+ (1,0) [0|127] "%"  GW
 SG_ ARS_OD_DynConf_Obj_11 : 337|7@0+ (1,0) [0|127] "%"  GW
 SG_ ARS_OD_DynProp_Obj_11 : 346|3@0+ (1,0) [0|7] ""  GW
 SG_ ARS_OD_MirrorProb_Obj_11 : 359|7@0+ (1,0) [0|127] "%"  GW
 SG_ ARS_OD_Length_Obj_11 : 352|7@0+ (0.2,0) [0|25.4] "m"  GW
 SG_ ARS_OD_MaintenanceState_Obj_11 : 361|2@0+ (1,0) [0|3] ""  GW
 SG_ ARS_OD_Width_Obj_11 : 375|7@0+ (0.2,0) [0|25.4] "m"  GW
 SG_ ARS_OD_RCS_Obj_11 : 368|9@0+ (0.2,-51.2) [-51.2|51] "dBsm"  GW
 SG_ ARS_OD_Orientation_Obj_11 : 391|10@0+ (0.01,-5.11) [-5.11|5.12] "rad"  GW
 SG_ ARS_OD_YawRateAbs_Obj_11 : 397|10@0+ (0.001,-0.511) [-0.511|0.512] "rad/s"  GW
 SG_ ARS_OD_YawRateAbsStd_Obj_11 : 403|10@0+ (0.0001,0) [0|0.1023] "rad/s"  GW
 SG_ ARS_OD_RefPoint_Obj_11 : 409|2@0+ (1,0) [0|3] ""  GW
 SG_ ARS_OD_LifeCycle_Obj_11 : 423|16@0+ (1,0) [0|65535] ""  GW
 SG_ ARS_OD_OrientationStd_Obj_10 : 439|4@0+ (0.002,0) [0|0.03] "rad"  GW
 SG_ ARS_OD_OrientationStd_Obj_11 : 435|4@0+ (0.002,0) [0|0.03] "rad"  GW
 SG_ ARS_OD_ObstacleProb_Obj_10 : 447|7@0+ (1,0) [0|127] "%"  GW
 SG_ ARS_OD_MicroDopplerFlag_10 : 440|1@0+ (1,0) [0|1] ""  GW
 SG_ ARS_OD_ObstacleProb_Obj_11 : 455|7@0+ (1,0) [0|127] "%"  GW
 SG_ ARS_OD_VabsY_Obj_10 : 43|11@0+ (0.125,-128) [-128|127.875] "m/s"  GW
 SG_ ARS_OD_MicroDopplerFlag_11 : 448|1@0+ (1,0) [0|1] ""  GW
 SG_ ARS_OD_ID_10 : 463|8@0+ (1,0) [0|255] ""  GW
 SG_ ARS_OD_ID_11 : 471|8@0+ (1,0) [0|255] ""  GW
 SG_ ARS_OD_MsgCounter_Obj_10_11 : 495|8@0+ (1,0) [0|255] ""  GW
 SG_ ARS_OD_CRC16_Checksum_Obj_10_11 : 503|16@0+ (1,0) [0|65535] ""  GW
 SG_ ARS_OD_AabsY_Obj_10 : 48|9@0+ (0.125,-31.875) [-31.875|32] "m/s^2"  GW
 SG_ ARS_OD_DistXStd_Obj_10 : 71|8@0+ (0.05,0) [0|12.75] "m"  GW
 SG_ ARS_OD_DistYStd_Obj_10 : 79|8@0+ (0.1,0) [0|25.5] "m"  GW
 SG_ ARS_OD_VabsXStd_Obj_10 : 87|7@0+ (0.1,0) [0|12.7] "m/s"  GW
 SG_ ARS_OD_VabsYStd_Obj_10 : 80|7@0+ (0.2,0) [0|25.4] "m/s"  GW
 SG_ ARS_OD_AabsXStd_Obj_10 : 89|7@0+ (0.25,0) [0|31.75] "m/s^2"  GW

BO_ 519 ARS_OD_12_13: 64 FR
 SG_ ARS_OD_DistX_Obj_12 : 7|12@0+ (0.0875,-100.0125) [-100.0125|258.3] "m"  GW
 SG_ ARS_OD_Classification_Obj_12 : 98|3@0+ (1,0) [0|7] ""  GW
 SG_ ARS_OD_AabsYStd_Obj_12 : 111|8@0+ (0.25,0) [0|63.75] "m/s^2"  GW
 SG_ ARS_OD_ClassConf_Obj_12 : 119|7@0+ (1,0) [0|127] "%"  GW
 SG_ ARS_OD_ProbOfExist_Obj_12 : 112|7@0+ (1,0) [0|127] "%"  GW
 SG_ ARS_OD_DynConf_Obj_12 : 121|7@0+ (1,0) [0|127] "%"  GW
 SG_ ARS_OD_VabsX_Obj_12 : 11|11@0+ (0.125,-128) [-128|127.875] "m/s"  GW
 SG_ ARS_OD_DynProp_Obj_12 : 130|3@0+ (1,0) [0|7] ""  GW
 SG_ ARS_OD_MirrorProb_Obj_12 : 143|7@0+ (1,0) [0|127] "%"  GW
 SG_ ARS_OD_Length_Obj_12 : 136|7@0+ (0.2,0) [0|25.4] "m"  GW
 SG_ ARS_OD_MaintenanceState_Obj_12 : 145|2@0+ (1,0) [0|3] ""  GW
 SG_ ARS_OD_Width_Obj_12 : 159|7@0+ (0.2,0) [0|25.4] "m"  GW
 SG_ ARS_OD_RCS_Obj_12 : 152|9@0+ (0.2,-51.2) [-51.2|51] "dBsm"  GW
 SG_ ARS_OD_Orientation_Obj_12 : 175|10@0+ (0.01,-5.11) [-5.11|5.12] "rad"  GW
 SG_ ARS_OD_YawRateAbs_Obj_12 : 181|10@0+ (0.001,-0.511) [-0.511|0.512] "rad/s"  GW
 SG_ ARS_OD_YawRateAbsStd_Obj_12 : 187|10@0+ (0.0001,0) [0|0.1023] "rad/s"  GW
 SG_ ARS_OD_RefPoint_Obj_12 : 193|2@0+ (1,0) [0|3] ""  GW
 SG_ ARS_OD_LifeCycle_Obj_12 : 207|16@0+ (1,0) [0|65535] ""  GW
 SG_ ARS_OD_DistX_Obj_13 : 223|12@0+ (0.0875,-100.0125) [-100.0125|258.3] "m"  GW
 SG_ ARS_OD_VabsX_Obj_13 : 227|11@0+ (0.125,-128) [-128|127.875] "m/s"  GW
 SG_ ARS_OD_AabsX_Obj_13 : 232|9@0+ (0.125,-31.875) [-31.875|32] "m/s^2"  GW
 SG_ ARS_OD_AabsX_Obj_12 : 16|9@0+ (0.125,-31.875) [-31.875|32] "m/s^2"  GW
 SG_ ARS_OD_DistY_Obj_13 : 255|12@0+ (0.0875,-179.1125) [-179.1125|179.2] "m"  GW
 SG_ ARS_OD_VabsY_Obj_13 : 259|11@0+ (0.125,-128) [-128|127.875] "m/s"  GW
 SG_ ARS_OD_AabsY_Obj_13 : 264|9@0+ (0.125,-31.875) [-31.875|32] "m/s^2"  GW
 SG_ ARS_OD_DistXStd_Obj_13 : 287|8@0+ (0.05,0) [0|12.75] "m"  GW
 SG_ ARS_OD_DistYStd_Obj_13 : 295|8@0+ (0.1,0) [0|25.5] "m"  GW
 SG_ ARS_OD_VabsXStd_Obj_13 : 303|7@0+ (0.1,0) [0|12.7] "m/s"  GW
 SG_ ARS_OD_VabsYStd_Obj_13 : 296|7@0+ (0.2,0) [0|25.4] "m/s"  GW
 SG_ ARS_OD_AabsXStd_Obj_13 : 305|7@0+ (0.25,0) [0|31.75] "m/s^2"  GW
 SG_ ARS_OD_Classification_Obj_13 : 314|3@0+ (1,0) [0|7] ""  GW
 SG_ ARS_OD_AabsYStd_Obj_13 : 327|8@0+ (0.25,0) [0|63.75] "m/s^2"  GW
 SG_ ARS_OD_ClassConf_Obj_13 : 335|7@0+ (1,0) [0|127] "%"  GW
 SG_ ARS_OD_DistY_Obj_12 : 39|12@0+ (0.0875,-179.1125) [-179.1125|179.2] "m"  GW
 SG_ ARS_OD_ProbOfExist_Obj_13 : 328|7@0+ (1,0) [0|127] "%"  GW
 SG_ ARS_OD_DynConf_Obj_13 : 337|7@0+ (1,0) [0|127] "%"  GW
 SG_ ARS_OD_DynProp_Obj_13 : 346|3@0+ (1,0) [0|7] ""  GW
 SG_ ARS_OD_MirrorProb_Obj_13 : 359|7@0+ (1,0) [0|127] "%"  GW
 SG_ ARS_OD_Length_Obj_13 : 352|7@0+ (0.2,0) [0|25.4] "m"  GW
 SG_ ARS_OD_MaintenanceState_Obj_13 : 361|2@0+ (1,0) [0|3] ""  GW
 SG_ ARS_OD_Width_Obj_13 : 375|7@0+ (0.2,0) [0|25.4] "m"  GW
 SG_ ARS_OD_RCS_Obj_13 : 368|9@0+ (0.2,-51.2) [-51.2|51] "dBsm"  GW
 SG_ ARS_OD_Orientation_Obj_13 : 391|10@0+ (0.01,-5.11) [-5.11|5.12] "rad"  GW
 SG_ ARS_OD_YawRateAbs_Obj_13 : 397|10@0+ (0.001,-0.511) [-0.511|0.512] "rad/s"  GW
 SG_ ARS_OD_YawRateAbsStd_Obj_13 : 403|10@0+ (0.0001,0) [0|0.1023] "rad/s"  GW
 SG_ ARS_OD_RefPoint_Obj_13 : 409|2@0+ (1,0) [0|3] ""  GW
 SG_ ARS_OD_LifeCycle_Obj_13 : 423|16@0+ (1,0) [0|65535] ""  GW
 SG_ ARS_OD_OrientationStd_Obj_12 : 439|4@0+ (0.002,0) [0|0.03] "rad"  GW
 SG_ ARS_OD_OrientationStd_Obj_13 : 435|4@0+ (0.002,0) [0|0.03] "rad"  GW
 SG_ ARS_OD_ObstacleProb_Obj_12 : 447|7@0+ (1,0) [0|127] "%"  GW
 SG_ ARS_OD_MicroDopplerFlag_12 : 440|1@0+ (1,0) [0|1] ""  GW
 SG_ ARS_OD_ObstacleProb_Obj_13 : 455|7@0+ (1,0) [0|127] "%"  GW
 SG_ ARS_OD_VabsY_Obj_12 : 43|11@0+ (0.125,-128) [-128|127.875] "m/s"  GW
 SG_ ARS_OD_MicroDopplerFlag_13 : 448|1@0+ (1,0) [0|1] ""  GW
 SG_ ARS_OD_ID_12 : 463|8@0+ (1,0) [0|255] ""  GW
 SG_ ARS_OD_ID_13 : 471|8@0+ (1,0) [0|255] ""  GW
 SG_ ARS_OD_MsgCounter_Obj_12_13 : 495|8@0+ (1,0) [0|255] ""  GW
 SG_ ARS_OD_CRC16_Checksum_Obj_12_13 : 503|16@0+ (1,0) [0|65535] ""  GW
 SG_ ARS_OD_AabsY_Obj_12 : 48|9@0+ (0.125,-31.875) [-31.875|32] "m/s^2"  GW
 SG_ ARS_OD_DistXStd_Obj_12 : 71|8@0+ (0.05,0) [0|12.75] "m"  GW
 SG_ ARS_OD_DistYStd_Obj_12 : 79|8@0+ (0.1,0) [0|25.5] "m"  GW
 SG_ ARS_OD_VabsXStd_Obj_12 : 87|7@0+ (0.1,0) [0|12.7] "m/s"  GW
 SG_ ARS_OD_VabsYStd_Obj_12 : 80|7@0+ (0.2,0) [0|25.4] "m/s"  GW
 SG_ ARS_OD_AabsXStd_Obj_12 : 89|7@0+ (0.25,0) [0|31.75] "m/s^2"  GW

BO_ 520 ARS_OD_14_15: 64 FR
 SG_ ARS_OD_DistX_Obj_14 : 7|12@0+ (0.0875,-100.0125) [-100.0125|258.3] "m"  GW
 SG_ ARS_OD_Classification_Obj_14 : 98|3@0+ (1,0) [0|7] ""  GW
 SG_ ARS_OD_AabsYStd_Obj_14 : 111|8@0+ (0.25,0) [0|63.75] "m/s^2"  GW
 SG_ ARS_OD_ClassConf_Obj_14 : 119|7@0+ (1,0) [0|127] "%"  GW
 SG_ ARS_OD_ProbOfExist_Obj_14 : 112|7@0+ (1,0) [0|127] "%"  GW
 SG_ ARS_OD_DynConf_Obj_14 : 121|7@0+ (1,0) [0|127] "%"  GW
 SG_ ARS_OD_VabsX_Obj_14 : 11|11@0+ (0.125,-128) [-128|127.875] "m/s"  GW
 SG_ ARS_OD_DynProp_Obj_14 : 130|3@0+ (1,0) [0|7] ""  GW
 SG_ ARS_OD_MirrorProb_Obj_14 : 143|7@0+ (1,0) [0|127] "%"  GW
 SG_ ARS_OD_Length_Obj_14 : 136|7@0+ (0.2,0) [0|25.4] "m"  GW
 SG_ ARS_OD_MaintenanceState_Obj_14 : 145|2@0+ (1,0) [0|3] ""  GW
 SG_ ARS_OD_Width_Obj_14 : 159|7@0+ (0.2,0) [0|25.4] "m"  GW
 SG_ ARS_OD_RCS_Obj_14 : 152|9@0+ (0.2,-51.2) [-51.2|51] "dBsm"  GW
 SG_ ARS_OD_Orientation_Obj_14 : 175|10@0+ (0.01,-5.11) [-5.11|5.12] "rad"  GW
 SG_ ARS_OD_YawRateAbs_Obj_14 : 181|10@0+ (0.001,-0.511) [-0.511|0.512] "rad/s"  GW
 SG_ ARS_OD_YawRateAbsStd_Obj_14 : 187|10@0+ (0.0001,0) [0|0.1023] "rad/s"  GW
 SG_ ARS_OD_RefPoint_Obj_14 : 193|2@0+ (1,0) [0|3] ""  GW
 SG_ ARS_OD_LifeCycle_Obj_14 : 207|16@0+ (1,0) [0|65535] ""  GW
 SG_ ARS_OD_DistX_Obj_15 : 223|12@0+ (0.0875,-100.0125) [-100.0125|258.3] "m"  GW
 SG_ ARS_OD_VabsX_Obj_15 : 227|11@0+ (0.125,-128) [-128|127.875] "m/s"  GW
 SG_ ARS_OD_AabsX_Obj_15 : 232|9@0+ (0.125,-31.875) [-31.875|32] "m/s^2"  GW
 SG_ ARS_OD_AabsX_Obj_14 : 16|9@0+ (0.125,-31.875) [-31.875|32] "m/s^2"  GW
 SG_ ARS_OD_DistY_Obj_15 : 255|12@0+ (0.0875,-179.1125) [-179.1125|179.2] "m"  GW
 SG_ ARS_OD_VabsY_Obj_15 : 259|11@0+ (0.125,-128) [-128|127.875] "m/s"  GW
 SG_ ARS_OD_AabsY_Obj_15 : 264|9@0+ (0.125,-31.875) [-31.875|32] "m/s^2"  GW
 SG_ ARS_OD_DistXStd_Obj_15 : 287|8@0+ (0.05,0) [0|12.75] "m"  GW
 SG_ ARS_OD_DistYStd_Obj_15 : 295|8@0+ (0.1,0) [0|25.5] "m"  GW
 SG_ ARS_OD_VabsXStd_Obj_15 : 303|7@0+ (0.1,0) [0|12.7] "m/s"  GW
 SG_ ARS_OD_VabsYStd_Obj_15 : 296|7@0+ (0.2,0) [0|25.4] "m/s"  GW
 SG_ ARS_OD_AabsXStd_Obj_15 : 305|7@0+ (0.25,0) [0|31.75] "m/s^2"  GW
 SG_ ARS_OD_Classification_Obj_15 : 314|3@0+ (1,0) [0|7] ""  GW
 SG_ ARS_OD_AabsYStd_Obj_15 : 327|8@0+ (0.25,0) [0|63.75] "m/s^2"  GW
 SG_ ARS_OD_ClassConf_Obj_15 : 335|7@0+ (1,0) [0|127] "%"  GW
 SG_ ARS_OD_DistY_Obj_14 : 39|12@0+ (0.0875,-179.1125) [-179.1125|179.2] "m"  GW
 SG_ ARS_OD_ProbOfExist_Obj_15 : 328|7@0+ (1,0) [0|127] "%"  GW
 SG_ ARS_OD_DynConf_Obj_15 : 337|7@0+ (1,0) [0|127] "%"  GW
 SG_ ARS_OD_DynProp_Obj_15 : 346|3@0+ (1,0) [0|7] ""  GW
 SG_ ARS_OD_MirrorProb_Obj_15 : 359|7@0+ (1,0) [0|127] "%"  GW
 SG_ ARS_OD_Length_Obj_15 : 352|7@0+ (0.2,0) [0|25.4] "m"  GW
 SG_ ARS_OD_MaintenanceState_Obj_15 : 361|2@0+ (1,0) [0|3] ""  GW
 SG_ ARS_OD_Width_Obj_15 : 375|7@0+ (0.2,0) [0|25.4] "m"  GW
 SG_ ARS_OD_RCS_Obj_15 : 368|9@0+ (0.2,-51.2) [-51.2|51] "dBsm"  GW
 SG_ ARS_OD_Orientation_Obj_15 : 391|10@0+ (0.01,-5.11) [-5.11|5.12] "rad"  GW
 SG_ ARS_OD_YawRateAbs_Obj_15 : 397|10@0+ (0.001,-0.511) [-0.511|0.512] "rad/s"  GW
 SG_ ARS_OD_YawRateAbsStd_Obj_15 : 403|10@0+ (0.0001,0) [0|0.1023] "rad/s"  GW
 SG_ ARS_OD_RefPoint_Obj_15 : 409|2@0+ (1,0) [0|3] ""  GW
 SG_ ARS_OD_LifeCycle_Obj_15 : 423|16@0+ (1,0) [0|65535] ""  GW
 SG_ ARS_OD_OrientationStd_Obj_14 : 439|4@0+ (0.002,0) [0|0.03] "rad"  GW
 SG_ ARS_OD_OrientationStd_Obj_15 : 435|4@0+ (0.002,0) [0|0.03] "rad"  GW
 SG_ ARS_OD_ObstacleProb_Obj_14 : 447|7@0+ (1,0) [0|127] "%"  GW
 SG_ ARS_OD_MicroDopplerFlag_14 : 440|1@0+ (1,0) [0|1] ""  GW
 SG_ ARS_OD_ObstacleProb_Obj_15 : 455|7@0+ (1,0) [0|127] "%"  GW
 SG_ ARS_OD_VabsY_Obj_14 : 43|11@0+ (0.125,-128) [-128|127.875] "m/s"  GW
 SG_ ARS_OD_MicroDopplerFlag_15 : 448|1@0+ (1,0) [0|1] ""  GW
 SG_ ARS_OD_ID_14 : 463|8@0+ (1,0) [0|255] ""  GW
 SG_ ARS_OD_ID_15 : 471|8@0+ (1,0) [0|255] ""  GW
 SG_ ARS_OD_MsgCounter_Obj_14_15 : 495|8@0+ (1,0) [0|255] ""  GW
 SG_ ARS_OD_CRC16_Checksum_Obj_14_15 : 503|16@0+ (1,0) [0|65535] ""  GW
 SG_ ARS_OD_AabsY_Obj_14 : 48|9@0+ (0.125,-31.875) [-31.875|32] "m/s^2"  GW
 SG_ ARS_OD_DistXStd_Obj_14 : 71|8@0+ (0.05,0) [0|12.75] "m"  GW
 SG_ ARS_OD_DistYStd_Obj_14 : 79|8@0+ (0.1,0) [0|25.5] "m"  GW
 SG_ ARS_OD_VabsXStd_Obj_14 : 87|7@0+ (0.1,0) [0|12.7] "m/s"  GW
 SG_ ARS_OD_VabsYStd_Obj_14 : 80|7@0+ (0.2,0) [0|25.4] "m/s"  GW
 SG_ ARS_OD_AabsXStd_Obj_14 : 89|7@0+ (0.25,0) [0|31.75] "m/s^2"  GW

BO_ 521 ARS_OD_16_17: 64 FR
 SG_ ARS_OD_DistX_Obj_16 : 7|12@0+ (0.0875,-100.0125) [-100.0125|258.3] "m"  GW
 SG_ ARS_OD_Classification_Obj_16 : 98|3@0+ (1,0) [0|7] ""  GW
 SG_ ARS_OD_AabsYStd_Obj_16 : 111|8@0+ (0.25,0) [0|63.75] "m/s^2"  GW
 SG_ ARS_OD_ClassConf_Obj_16 : 119|7@0+ (1,0) [0|127] "%"  GW
 SG_ ARS_OD_ProbOfExist_Obj_16 : 112|7@0+ (1,0) [0|127] "%"  GW
 SG_ ARS_OD_DynConf_Obj_16 : 121|7@0+ (1,0) [0|127] "%"  GW
 SG_ ARS_OD_VabsX_Obj_16 : 11|11@0+ (0.125,-128) [-128|127.875] "m/s"  GW
 SG_ ARS_OD_DynProp_Obj_16 : 130|3@0+ (1,0) [0|7] ""  GW
 SG_ ARS_OD_MirrorProb_Obj_16 : 143|7@0+ (1,0) [0|127] "%"  GW
 SG_ ARS_OD_Length_Obj_16 : 136|7@0+ (0.2,0) [0|25.4] "m"  GW
 SG_ ARS_OD_MaintenanceState_Obj_16 : 145|2@0+ (1,0) [0|3] ""  GW
 SG_ ARS_OD_Width_Obj_16 : 159|7@0+ (0.2,0) [0|25.4] "m"  GW
 SG_ ARS_OD_RCS_Obj_16 : 152|9@0+ (0.2,-51.2) [-51.2|51] "dBsm"  GW
 SG_ ARS_OD_Orientation_Obj_16 : 175|10@0+ (0.01,-5.11) [-5.11|5.12] "rad"  GW
 SG_ ARS_OD_YawRateAbs_Obj_16 : 181|10@0+ (0.001,-0.511) [-0.511|0.512] "rad/s"  GW
 SG_ ARS_OD_YawRateAbsStd_Obj_16 : 187|10@0+ (0.0001,0) [0|0.1023] "rad/s"  GW
 SG_ ARS_OD_RefPoint_Obj_16 : 193|2@0+ (1,0) [0|3] ""  GW
 SG_ ARS_OD_LifeCycle_Obj_16 : 207|16@0+ (1,0) [0|65535] ""  GW
 SG_ ARS_OD_DistX_Obj_17 : 223|12@0+ (0.0875,-100.0125) [-100.0125|258.3] "m"  GW
 SG_ ARS_OD_VabsX_Obj_17 : 227|11@0+ (0.125,-128) [-128|127.875] "m/s"  GW
 SG_ ARS_OD_AabsX_Obj_17 : 232|9@0+ (0.125,-31.875) [-31.875|32] "m/s^2"  GW
 SG_ ARS_OD_AabsX_Obj_16 : 16|9@0+ (0.125,-31.875) [-31.875|32] "m/s^2"  GW
 SG_ ARS_OD_DistY_Obj_17 : 255|12@0+ (0.0875,-179.1125) [-179.1125|179.2] "m"  GW
 SG_ ARS_OD_VabsY_Obj_17 : 259|11@0+ (0.125,-128) [-128|127.875] "m/s"  GW
 SG_ ARS_OD_AabsY_Obj_17 : 264|9@0+ (0.125,-31.875) [-31.875|32] "m/s^2"  GW
 SG_ ARS_OD_DistXStd_Obj_17 : 287|8@0+ (0.05,0) [0|12.75] "m"  GW
 SG_ ARS_OD_DistYStd_Obj_17 : 295|8@0+ (0.1,0) [0|25.5] "m"  GW
 SG_ ARS_OD_VabsXStd_Obj_17 : 303|7@0+ (0.1,0) [0|12.7] "m/s"  GW
 SG_ ARS_OD_VabsYStd_Obj_17 : 296|7@0+ (0.2,0) [0|25.4] "m/s"  GW
 SG_ ARS_OD_AabsXStd_Obj_17 : 305|7@0+ (0.25,0) [0|31.75] "m/s^2"  GW
 SG_ ARS_OD_Classification_Obj_17 : 314|3@0+ (1,0) [0|7] ""  GW
 SG_ ARS_OD_AabsYStd_Obj_17 : 327|8@0+ (0.25,0) [0|63.75] "m/s^2"  GW
 SG_ ARS_OD_ClassConf_Obj_17 : 335|7@0+ (1,0) [0|127] "%"  GW
 SG_ ARS_OD_DistY_Obj_16 : 39|12@0+ (0.0875,-179.1125) [-179.1125|179.2] "m"  GW
 SG_ ARS_OD_ProbOfExist_Obj_17 : 328|7@0+ (1,0) [0|127] "%"  GW
 SG_ ARS_OD_DynConf_Obj_17 : 337|7@0+ (1,0) [0|127] "%"  GW
 SG_ ARS_OD_DynProp_Obj_17 : 346|3@0+ (1,0) [0|7] ""  GW
 SG_ ARS_OD_MirrorProb_Obj_17 : 359|7@0+ (1,0) [0|127] "%"  GW
 SG_ ARS_OD_Length_Obj_17 : 352|7@0+ (0.2,0) [0|25.4] "m"  GW
 SG_ ARS_OD_MaintenanceState_Obj_17 : 361|2@0+ (1,0) [0|3] ""  GW
 SG_ ARS_OD_Width_Obj_17 : 375|7@0+ (0.2,0) [0|25.4] "m"  GW
 SG_ ARS_OD_RCS_Obj_17 : 368|9@0+ (0.2,-51.2) [-51.2|51] "dBsm"  GW
 SG_ ARS_OD_Orientation_Obj_17 : 391|10@0+ (0.01,-5.11) [-5.11|5.12] "rad"  GW
 SG_ ARS_OD_YawRateAbs_Obj_17 : 397|10@0+ (0.001,-0.511) [-0.511|0.512] "rad/s"  GW
 SG_ ARS_OD_YawRateAbsStd_Obj_17 : 403|10@0+ (0.0001,0) [0|0.1023] "rad/s"  GW
 SG_ ARS_OD_RefPoint_Obj_17 : 409|2@0+ (1,0) [0|3] ""  GW
 SG_ ARS_OD_LifeCycle_Obj_17 : 423|16@0+ (1,0) [0|65535] ""  GW
 SG_ ARS_OD_OrientationStd_Obj_16 : 439|4@0+ (0.002,0) [0|0.03] "rad"  GW
 SG_ ARS_OD_OrientationStd_Obj_17 : 435|4@0+ (0.002,0) [0|0.03] "rad"  GW
 SG_ ARS_OD_ObstacleProb_Obj_16 : 447|7@0+ (1,0) [0|127] "%"  GW
 SG_ ARS_OD_MicroDopplerFlag_16 : 440|1@0+ (1,0) [0|1] ""  GW
 SG_ ARS_OD_ObstacleProb_Obj_17 : 455|7@0+ (1,0) [0|127] "%"  GW
 SG_ ARS_OD_VabsY_Obj_16 : 43|11@0+ (0.125,-128) [-128|127.875] "m/s"  GW
 SG_ ARS_OD_MicroDopplerFlag_17 : 448|1@0+ (1,0) [0|1] ""  GW
 SG_ ARS_OD_ID_16 : 463|8@0+ (1,0) [0|255] ""  GW
 SG_ ARS_OD_ID_17 : 471|8@0+ (1,0) [0|255] ""  GW
 SG_ ARS_OD_MsgCounter_Obj_16_17 : 495|8@0+ (1,0) [0|255] ""  GW
 SG_ ARS_OD_CRC16_Checksum_Obj_16_17 : 503|16@0+ (1,0) [0|65535] ""  GW
 SG_ ARS_OD_AabsY_Obj_16 : 48|9@0+ (0.125,-31.875) [-31.875|32] "m/s^2"  GW
 SG_ ARS_OD_DistXStd_Obj_16 : 71|8@0+ (0.05,0) [0|12.75] "m"  GW
 SG_ ARS_OD_DistYStd_Obj_16 : 79|8@0+ (0.1,0) [0|25.5] "m"  GW
 SG_ ARS_OD_VabsXStd_Obj_16 : 87|7@0+ (0.1,0) [0|12.7] "m/s"  GW
 SG_ ARS_OD_VabsYStd_Obj_16 : 80|7@0+ (0.2,0) [0|25.4] "m/s"  GW
 SG_ ARS_OD_AabsXStd_Obj_16 : 89|7@0+ (0.25,0) [0|31.75] "m/s^2"  GW

BO_ 522 ARS_OD_18_19: 64 FR
 SG_ ARS_OD_DistX_Obj_18 : 7|12@0+ (0.0875,-100.0125) [-100.0125|258.3] "m"  GW
 SG_ ARS_OD_Classification_Obj_18 : 98|3@0+ (1,0) [0|7] ""  GW
 SG_ ARS_OD_AabsYStd_Obj_18 : 111|8@0+ (0.25,0) [0|63.75] "m/s^2"  GW
 SG_ ARS_OD_ClassConf_Obj_18 : 119|7@0+ (1,0) [0|127] "%"  GW
 SG_ ARS_OD_ProbOfExist_Obj_18 : 112|7@0+ (1,0) [0|127] "%"  GW
 SG_ ARS_OD_DynConf_Obj_18 : 121|7@0+ (1,0) [0|127] "%"  GW
 SG_ ARS_OD_VabsX_Obj_18 : 11|11@0+ (0.125,-128) [-128|127.875] "m/s"  GW
 SG_ ARS_OD_DynProp_Obj_18 : 130|3@0+ (1,0) [0|7] ""  GW
 SG_ ARS_OD_MirrorProb_Obj_18 : 143|7@0+ (1,0) [0|127] "%"  GW
 SG_ ARS_OD_Length_Obj_18 : 136|7@0+ (0.2,0) [0|25.4] "m"  GW
 SG_ ARS_OD_MaintenanceState_Obj_18 : 145|2@0+ (1,0) [0|3] ""  GW
 SG_ ARS_OD_Width_Obj_18 : 159|7@0+ (0.2,0) [0|25.4] "m"  GW
 SG_ ARS_OD_RCS_Obj_18 : 152|9@0+ (0.2,-51.2) [-51.2|51] "dBsm"  GW
 SG_ ARS_OD_Orientation_Obj_18 : 175|10@0+ (0.01,-5.11) [-5.11|5.12] "rad"  GW
 SG_ ARS_OD_YawRateAbs_Obj_18 : 181|10@0+ (0.001,-0.511) [-0.511|0.512] "rad/s"  GW
 SG_ ARS_OD_YawRateAbsStd_Obj_18 : 187|10@0+ (0.0001,0) [0|0.1023] "rad/s"  GW
 SG_ ARS_OD_RefPoint_Obj_18 : 193|2@0+ (1,0) [0|3] ""  GW
 SG_ ARS_OD_LifeCycle_Obj_18 : 207|16@0+ (1,0) [0|65535] ""  GW
 SG_ ARS_OD_DistX_Obj_19 : 223|12@0+ (0.0875,-100.0125) [-100.0125|258.3] "m"  GW
 SG_ ARS_OD_VabsX_Obj_19 : 227|11@0+ (0.125,-128) [-128|127.875] "m/s"  GW
 SG_ ARS_OD_AabsX_Obj_19 : 232|9@0+ (0.125,-31.875) [-31.875|32] "m/s^2"  GW
 SG_ ARS_OD_AabsX_Obj_18 : 16|9@0+ (0.125,-31.875) [-31.875|32] "m/s^2"  GW
 SG_ ARS_OD_DistY_Obj_19 : 255|12@0+ (0.0875,-179.1125) [-179.1125|179.2] "m"  GW
 SG_ ARS_OD_VabsY_Obj_19 : 259|11@0+ (0.125,-128) [-128|127.875] "m/s"  GW
 SG_ ARS_OD_AabsY_Obj_19 : 264|9@0+ (0.125,-31.875) [-31.875|32] "m/s^2"  GW
 SG_ ARS_OD_DistXStd_Obj_19 : 287|8@0+ (0.05,0) [0|12.75] "m"  GW
 SG_ ARS_OD_DistYStd_Obj_19 : 295|8@0+ (0.1,0) [0|25.5] "m"  GW
 SG_ ARS_OD_VabsXStd_Obj_19 : 303|7@0+ (0.1,0) [0|12.7] "m/s"  GW
 SG_ ARS_OD_VabsYStd_Obj_19 : 296|7@0+ (0.2,0) [0|25.4] "m/s"  GW
 SG_ ARS_OD_AabsXStd_Obj_19 : 305|7@0+ (0.25,0) [0|31.75] "m/s^2"  GW
 SG_ ARS_OD_Classification_Obj_19 : 314|3@0+ (1,0) [0|7] ""  GW
 SG_ ARS_OD_AabsYStd_Obj_19 : 327|8@0+ (0.25,0) [0|63.75] "m/s^2"  GW
 SG_ ARS_OD_ClassConf_Obj_19 : 335|7@0+ (1,0) [0|127] "%"  GW
 SG_ ARS_OD_DistY_Obj_18 : 39|12@0+ (0.0875,-179.1125) [-179.1125|179.2] "m"  GW
 SG_ ARS_OD_ProbOfExist_Obj_19 : 328|7@0+ (1,0) [0|127] "%"  GW
 SG_ ARS_OD_DynConf_Obj_19 : 337|7@0+ (1,0) [0|127] "%"  GW
 SG_ ARS_OD_DynProp_Obj_19 : 346|3@0+ (1,0) [0|7] ""  GW
 SG_ ARS_OD_MirrorProb_Obj_19 : 359|7@0+ (1,0) [0|127] "%"  GW
 SG_ ARS_OD_Length_Obj_19 : 352|7@0+ (0.2,0) [0|25.4] "m"  GW
 SG_ ARS_OD_MaintenanceState_Obj_19 : 361|2@0+ (1,0) [0|3] ""  GW
 SG_ ARS_OD_Width_Obj_19 : 375|7@0+ (0.2,0) [0|25.4] "m"  GW
 SG_ ARS_OD_RCS_Obj_19 : 368|9@0+ (0.2,-51.2) [-51.2|51] "dBsm"  GW
 SG_ ARS_OD_Orientation_Obj_19 : 391|10@0+ (0.01,-5.11) [-5.11|5.12] "rad"  GW
 SG_ ARS_OD_YawRateAbs_Obj_19 : 397|10@0+ (0.001,-0.511) [-0.511|0.512] "rad/s"  GW
 SG_ ARS_OD_YawRateAbsStd_Obj_19 : 403|10@0+ (0.0001,0) [0|0.1023] "rad/s"  GW
 SG_ ARS_OD_RefPoint_Obj_19 : 409|2@0+ (1,0) [0|3] ""  GW
 SG_ ARS_OD_LifeCycle_Obj_19 : 423|16@0+ (1,0) [0|65535] ""  GW
 SG_ ARS_OD_OrientationStd_Obj_18 : 439|4@0+ (0.002,0) [0|0.03] "rad"  GW
 SG_ ARS_OD_OrientationStd_Obj_19 : 435|4@0+ (0.002,0) [0|0.03] "rad"  GW
 SG_ ARS_OD_ObstacleProb_Obj_18 : 447|7@0+ (1,0) [0|127] "%"  GW
 SG_ ARS_OD_MicroDopplerFlag_18 : 440|1@0+ (1,0) [0|1] ""  GW
 SG_ ARS_OD_ObstacleProb_Obj_19 : 455|7@0+ (1,0) [0|127] "%"  GW
 SG_ ARS_OD_VabsY_Obj_18 : 43|11@0+ (0.125,-128) [-128|127.875] "m/s"  GW
 SG_ ARS_OD_MicroDopplerFlag_19 : 448|1@0+ (1,0) [0|1] ""  GW
 SG_ ARS_OD_ID_18 : 463|8@0+ (1,0) [0|255] ""  GW
 SG_ ARS_OD_ID_19 : 471|8@0+ (1,0) [0|255] ""  GW
 SG_ ARS_OD_MsgCounter_Obj_18_19 : 495|8@0+ (1,0) [0|255] ""  GW
 SG_ ARS_OD_CRC16_Checksum_Obj_18_19 : 503|16@0+ (1,0) [0|65535] ""  GW
 SG_ ARS_OD_AabsY_Obj_18 : 48|9@0+ (0.125,-31.875) [-31.875|32] "m/s^2"  GW
 SG_ ARS_OD_DistXStd_Obj_18 : 71|8@0+ (0.05,0) [0|12.75] "m"  GW
 SG_ ARS_OD_DistYStd_Obj_18 : 79|8@0+ (0.1,0) [0|25.5] "m"  GW
 SG_ ARS_OD_VabsXStd_Obj_18 : 87|7@0+ (0.1,0) [0|12.7] "m/s"  GW
 SG_ ARS_OD_VabsYStd_Obj_18 : 80|7@0+ (0.2,0) [0|25.4] "m/s"  GW
 SG_ ARS_OD_AabsXStd_Obj_18 : 89|7@0+ (0.25,0) [0|31.75] "m/s^2"  GW

BO_ 523 ARS_OD_20_21: 64 FR
 SG_ ARS_OD_DistX_Obj_20 : 7|12@0+ (0.0875,-100.0125) [-100.0125|258.3] "m"  GW
 SG_ ARS_OD_Classification_Obj_20 : 98|3@0+ (1,0) [0|7] ""  GW
 SG_ ARS_OD_AabsYStd_Obj_20 : 111|8@0+ (0.25,0) [0|63.75] "m/s^2"  GW
 SG_ ARS_OD_ClassConf_Obj_20 : 119|7@0+ (1,0) [0|127] "%"  GW
 SG_ ARS_OD_ProbOfExist_Obj_20 : 112|7@0+ (1,0) [0|127] "%"  GW
 SG_ ARS_OD_DynConf_Obj_20 : 121|7@0+ (1,0) [0|127] "%"  GW
 SG_ ARS_OD_VabsX_Obj_20 : 11|11@0+ (0.125,-128) [-128|127.875] "m/s"  GW
 SG_ ARS_OD_DynProp_Obj_20 : 130|3@0+ (1,0) [0|7] ""  GW
 SG_ ARS_OD_MirrorProb_Obj_20 : 143|7@0+ (1,0) [0|127] "%"  GW
 SG_ ARS_OD_Length_Obj_20 : 136|7@0+ (0.2,0) [0|25.4] "m"  GW
 SG_ ARS_OD_MaintenanceState_Obj_20 : 145|2@0+ (1,0) [0|3] ""  GW
 SG_ ARS_OD_Width_Obj_20 : 159|7@0+ (0.2,0) [0|25.4] "m"  GW
 SG_ ARS_OD_RCS_Obj_20 : 152|9@0+ (0.2,-51.2) [-51.2|51] "dBsm"  GW
 SG_ ARS_OD_Orientation_Obj_20 : 175|10@0+ (0.01,-5.11) [-5.11|5.12] "rad"  GW
 SG_ ARS_OD_YawRateAbs_Obj_20 : 181|10@0+ (0.001,-0.511) [-0.511|0.512] "rad/s"  GW
 SG_ ARS_OD_YawRateAbsStd_Obj_20 : 187|10@0+ (0.0001,0) [0|0.1023] "rad/s"  GW
 SG_ ARS_OD_RefPoint_Obj_20 : 193|2@0+ (1,0) [0|3] ""  GW
 SG_ ARS_OD_LifeCycle_Obj_20 : 207|16@0+ (1,0) [0|65535] ""  GW
 SG_ ARS_OD_DistX_Obj_21 : 223|12@0+ (0.0875,-100.0125) [-100.0125|258.3] "m"  GW
 SG_ ARS_OD_VabsX_Obj_21 : 227|11@0+ (0.125,-128) [-128|127.875] "m/s"  GW
 SG_ ARS_OD_AabsX_Obj_21 : 232|9@0+ (0.125,-31.875) [-31.875|32] "m/s^2"  GW
 SG_ ARS_OD_AabsX_Obj_20 : 16|9@0+ (0.125,-31.875) [-31.875|32] "m/s^2"  GW
 SG_ ARS_OD_DistY_Obj_21 : 255|12@0+ (0.0875,-179.1125) [-179.1125|179.2] "m"  GW
 SG_ ARS_OD_VabsY_Obj_21 : 259|11@0+ (0.125,-128) [-128|127.875] "m/s"  GW
 SG_ ARS_OD_AabsY_Obj_21 : 264|9@0+ (0.125,-31.875) [-31.875|32] "m/s^2"  GW
 SG_ ARS_OD_DistXStd_Obj_21 : 287|8@0+ (0.05,0) [0|12.75] "m"  GW
 SG_ ARS_OD_DistYStd_Obj_21 : 295|8@0+ (0.1,0) [0|25.5] "m"  GW
 SG_ ARS_OD_VabsXStd_Obj_21 : 303|7@0+ (0.1,0) [0|12.7] "m/s"  GW
 SG_ ARS_OD_VabsYStd_Obj_21 : 296|7@0+ (0.2,0) [0|25.4] "m/s"  GW
 SG_ ARS_OD_AabsXStd_Obj_21 : 305|7@0+ (0.25,0) [0|31.75] "m/s^2"  GW
 SG_ ARS_OD_Classification_Obj_21 : 314|3@0+ (1,0) [0|7] ""  GW
 SG_ ARS_OD_AabsYStd_Obj_21 : 327|8@0+ (0.25,0) [0|63.75] "m/s^2"  GW
 SG_ ARS_OD_ClassConf_Obj_21 : 335|7@0+ (1,0) [0|127] "%"  GW
 SG_ ARS_OD_DistY_Obj_20 : 39|12@0+ (0.0875,-179.1125) [-179.1125|179.2] "m"  GW
 SG_ ARS_OD_ProbOfExist_Obj_21 : 328|7@0+ (1,0) [0|127] "%"  GW
 SG_ ARS_OD_DynConf_Obj_21 : 337|7@0+ (1,0) [0|127] "%"  GW
 SG_ ARS_OD_DynProp_Obj_21 : 346|3@0+ (1,0) [0|7] ""  GW
 SG_ ARS_OD_MirrorProb_Obj_21 : 359|7@0+ (1,0) [0|127] "%"  GW
 SG_ ARS_OD_Length_Obj_21 : 352|7@0+ (0.2,0) [0|25.4] "m"  GW
 SG_ ARS_OD_MaintenanceState_Obj_21 : 361|2@0+ (1,0) [0|3] ""  GW
 SG_ ARS_OD_Width_Obj_21 : 375|7@0+ (0.2,0) [0|25.4] "m"  GW
 SG_ ARS_OD_RCS_Obj_21 : 368|9@0+ (0.2,-51.2) [-51.2|51] "dBsm"  GW
 SG_ ARS_OD_Orientation_Obj_21 : 391|10@0+ (0.01,-5.11) [-5.11|5.12] "rad"  GW
 SG_ ARS_OD_YawRateAbs_Obj_21 : 397|10@0+ (0.001,-0.511) [-0.511|0.512] "rad/s"  GW
 SG_ ARS_OD_YawRateAbsStd_Obj_21 : 403|10@0+ (0.0001,0) [0|0.1023] "rad/s"  GW
 SG_ ARS_OD_RefPoint_Obj_21 : 409|2@0+ (1,0) [0|3] ""  GW
 SG_ ARS_OD_LifeCycle_Obj_21 : 423|16@0+ (1,0) [0|65535] ""  GW
 SG_ ARS_OD_OrientationStd_Obj_20 : 439|4@0+ (0.002,0) [0|0.03] "rad"  GW
 SG_ ARS_OD_OrientationStd_Obj_21 : 435|4@0+ (0.002,0) [0|0.03] "rad"  GW
 SG_ ARS_OD_ObstacleProb_Obj_20 : 447|7@0+ (1,0) [0|127] "%"  GW
 SG_ ARS_OD_MicroDopplerFlag_20 : 440|1@0+ (1,0) [0|1] ""  GW
 SG_ ARS_OD_ObstacleProb_Obj_21 : 455|7@0+ (1,0) [0|127] "%"  GW
 SG_ ARS_OD_VabsY_Obj_20 : 43|11@0+ (0.125,-128) [-128|127.875] "m/s"  GW
 SG_ ARS_OD_MicroDopplerFlag_21 : 448|1@0+ (1,0) [0|1] ""  GW
 SG_ ARS_OD_ID_20 : 463|8@0+ (1,0) [0|255] ""  GW
 SG_ ARS_OD_ID_21 : 471|8@0+ (1,0) [0|255] ""  GW
 SG_ ARS_OD_MsgCounter_Obj_20_21 : 495|8@0+ (1,0) [0|255] ""  GW
 SG_ ARS_OD_CRC16_Checksum_Obj_20_21 : 503|16@0+ (1,0) [0|65535] ""  GW
 SG_ ARS_OD_AabsY_Obj_20 : 48|9@0+ (0.125,-31.875) [-31.875|32] "m/s^2"  GW
 SG_ ARS_OD_DistXStd_Obj_20 : 71|8@0+ (0.05,0) [0|12.75] "m"  GW
 SG_ ARS_OD_DistYStd_Obj_20 : 79|8@0+ (0.1,0) [0|25.5] "m"  GW
 SG_ ARS_OD_VabsXStd_Obj_20 : 87|7@0+ (0.1,0) [0|12.7] "m/s"  GW
 SG_ ARS_OD_VabsYStd_Obj_20 : 80|7@0+ (0.2,0) [0|25.4] "m/s"  GW
 SG_ ARS_OD_AabsXStd_Obj_20 : 89|7@0+ (0.25,0) [0|31.75] "m/s^2"  GW

BO_ 524 ARS_OD_22_23: 64 FR
 SG_ ARS_OD_DistX_Obj_22 : 7|12@0+ (0.0875,-100.0125) [-100.0125|258.3] "m"  GW
 SG_ ARS_OD_Classification_Obj_22 : 98|3@0+ (1,0) [0|7] ""  GW
 SG_ ARS_OD_AabsYStd_Obj_22 : 111|8@0+ (0.25,0) [0|63.75] "m/s^2"  GW
 SG_ ARS_OD_ClassConf_Obj_22 : 119|7@0+ (1,0) [0|127] "%"  GW
 SG_ ARS_OD_ProbOfExist_Obj_22 : 112|7@0+ (1,0) [0|127] "%"  GW
 SG_ ARS_OD_DynConf_Obj_22 : 121|7@0+ (1,0) [0|127] "%"  GW
 SG_ ARS_OD_VabsX_Obj_22 : 11|11@0+ (0.125,-128) [-128|127.875] "m/s"  GW
 SG_ ARS_OD_DynProp_Obj_22 : 130|3@0+ (1,0) [0|7] ""  GW
 SG_ ARS_OD_MirrorProb_Obj_22 : 143|7@0+ (1,0) [0|127] "%"  GW
 SG_ ARS_OD_Length_Obj_22 : 136|7@0+ (0.2,0) [0|25.4] "m"  GW
 SG_ ARS_OD_MaintenanceState_Obj_22 : 145|2@0+ (1,0) [0|3] ""  GW
 SG_ ARS_OD_Width_Obj_22 : 159|7@0+ (0.2,0) [0|25.4] "m"  GW
 SG_ ARS_OD_RCS_Obj_22 : 152|9@0+ (0.2,-51.2) [-51.2|51] "dBsm"  GW
 SG_ ARS_OD_Orientation_Obj_22 : 175|10@0+ (0.01,-5.11) [-5.11|5.12] "rad"  GW
 SG_ ARS_OD_YawRateAbs_Obj_22 : 181|10@0+ (0.001,-0.511) [-0.511|0.512] "rad/s"  GW
 SG_ ARS_OD_YawRateAbsStd_Obj_22 : 187|10@0+ (0.0001,0) [0|0.1023] "rad/s"  GW
 SG_ ARS_OD_RefPoint_Obj_22 : 193|2@0+ (1,0) [0|3] ""  GW
 SG_ ARS_OD_LifeCycle_Obj_22 : 207|16@0+ (1,0) [0|65535] ""  GW
 SG_ ARS_OD_DistX_Obj_23 : 223|12@0+ (0.0875,-100.0125) [-100.0125|258.3] "m"  GW
 SG_ ARS_OD_VabsX_Obj_23 : 227|11@0+ (0.125,-128) [-128|127.875] "m/s"  GW
 SG_ ARS_OD_AabsX_Obj_23 : 232|9@0+ (0.125,-31.875) [-31.875|32] "m/s^2"  GW
 SG_ ARS_OD_AabsX_Obj_22 : 16|9@0+ (0.125,-31.875) [-31.875|32] "m/s^2"  GW
 SG_ ARS_OD_DistY_Obj_23 : 255|12@0+ (0.0875,-179.1125) [-179.1125|179.2] "m"  GW
 SG_ ARS_OD_VabsY_Obj_23 : 259|11@0+ (0.125,-128) [-128|127.875] "m/s"  GW
 SG_ ARS_OD_AabsY_Obj_23 : 264|9@0+ (0.125,-31.875) [-31.875|32] "m/s^2"  GW
 SG_ ARS_OD_DistXStd_Obj_23 : 287|8@0+ (0.05,0) [0|12.75] "m"  GW
 SG_ ARS_OD_DistYStd_Obj_23 : 295|8@0+ (0.1,0) [0|25.5] "m"  GW
 SG_ ARS_OD_VabsXStd_Obj_23 : 303|7@0+ (0.1,0) [0|12.7] "m/s"  GW
 SG_ ARS_OD_VabsYStd_Obj_23 : 296|7@0+ (0.2,0) [0|25.4] "m/s"  GW
 SG_ ARS_OD_AabsXStd_Obj_23 : 305|7@0+ (0.25,0) [0|31.75] "m/s^2"  GW
 SG_ ARS_OD_Classification_Obj_23 : 314|3@0+ (1,0) [0|7] ""  GW
 SG_ ARS_OD_AabsYStd_Obj_23 : 327|8@0+ (0.25,0) [0|63.75] "m/s^2"  GW
 SG_ ARS_OD_ClassConf_Obj_23 : 335|7@0+ (1,0) [0|127] "%"  GW
 SG_ ARS_OD_DistY_Obj_22 : 39|12@0+ (0.0875,-179.1125) [-179.1125|179.2] "m"  GW
 SG_ ARS_OD_ProbOfExist_Obj_23 : 328|7@0+ (1,0) [0|127] "%"  GW
 SG_ ARS_OD_DynConf_Obj_23 : 337|7@0+ (1,0) [0|127] "%"  GW
 SG_ ARS_OD_DynProp_Obj_23 : 346|3@0+ (1,0) [0|7] ""  GW
 SG_ ARS_OD_MirrorProb_Obj_23 : 359|7@0+ (1,0) [0|127] "%"  GW
 SG_ ARS_OD_Length_Obj_23 : 352|7@0+ (0.2,0) [0|25.4] "m"  GW
 SG_ ARS_OD_MaintenanceState_Obj_23 : 361|2@0+ (1,0) [0|3] ""  GW
 SG_ ARS_OD_Width_Obj_23 : 375|7@0+ (0.2,0) [0|25.4] "m"  GW
 SG_ ARS_OD_RCS_Obj_23 : 368|9@0+ (0.2,-51.2) [-51.2|51] "dBsm"  GW
 SG_ ARS_OD_Orientation_Obj_23 : 391|10@0+ (0.01,-5.11) [-5.11|5.12] "rad"  GW
 SG_ ARS_OD_YawRateAbs_Obj_23 : 397|10@0+ (0.001,-0.511) [-0.511|0.512] "rad/s"  GW
 SG_ ARS_OD_YawRateAbsStd_Obj_23 : 403|10@0+ (0.0001,0) [0|0.1023] "rad/s"  GW
 SG_ ARS_OD_RefPoint_Obj_23 : 409|2@0+ (1,0) [0|3] ""  GW
 SG_ ARS_OD_LifeCycle_Obj_23 : 423|16@0+ (1,0) [0|65535] ""  GW
 SG_ ARS_OD_OrientationStd_Obj_22 : 439|4@0+ (0.002,0) [0|0.03] "rad"  GW
 SG_ ARS_OD_OrientationStd_Obj_23 : 435|4@0+ (0.002,0) [0|0.03] "rad"  GW
 SG_ ARS_OD_ObstacleProb_Obj_22 : 447|7@0+ (1,0) [0|127] "%"  GW
 SG_ ARS_OD_MicroDopplerFlag_22 : 440|1@0+ (1,0) [0|1] ""  GW
 SG_ ARS_OD_ObstacleProb_Obj_23 : 455|7@0+ (1,0) [0|127] "%"  GW
 SG_ ARS_OD_VabsY_Obj_22 : 43|11@0+ (0.125,-128) [-128|127.875] "m/s"  GW
 SG_ ARS_OD_MicroDopplerFlag_23 : 448|1@0+ (1,0) [0|1] ""  GW
 SG_ ARS_OD_ID_22 : 463|8@0+ (1,0) [0|255] ""  GW
 SG_ ARS_OD_ID_23 : 471|8@0+ (1,0) [0|255] ""  GW
 SG_ ARS_OD_MsgCounter_Obj_22_23 : 495|8@0+ (1,0) [0|255] ""  GW
 SG_ ARS_OD_CRC16_Checksum_Obj_22_23 : 503|16@0+ (1,0) [0|65535] ""  GW
 SG_ ARS_OD_AabsY_Obj_22 : 48|9@0+ (0.125,-31.875) [-31.875|32] "m/s^2"  GW
 SG_ ARS_OD_DistXStd_Obj_22 : 71|8@0+ (0.05,0) [0|12.75] "m"  GW
 SG_ ARS_OD_DistYStd_Obj_22 : 79|8@0+ (0.1,0) [0|25.5] "m"  GW
 SG_ ARS_OD_VabsXStd_Obj_22 : 87|7@0+ (0.1,0) [0|12.7] "m/s"  GW
 SG_ ARS_OD_VabsYStd_Obj_22 : 80|7@0+ (0.2,0) [0|25.4] "m/s"  GW
 SG_ ARS_OD_AabsXStd_Obj_22 : 89|7@0+ (0.25,0) [0|31.75] "m/s^2"  GW

BO_ 525 ARS_OD_24_25: 64 FR
 SG_ ARS_OD_DistX_Obj_24 : 7|12@0+ (0.0875,-100.0125) [-100.0125|258.3] "m"  GW
 SG_ ARS_OD_Classification_Obj_24 : 98|3@0+ (1,0) [0|7] ""  GW
 SG_ ARS_OD_AabsYStd_Obj_24 : 111|8@0+ (0.25,0) [0|63.75] "m/s^2"  GW
 SG_ ARS_OD_ClassConf_Obj_24 : 119|7@0+ (1,0) [0|127] "%"  GW
 SG_ ARS_OD_ProbOfExist_Obj_24 : 112|7@0+ (1,0) [0|127] "%"  GW
 SG_ ARS_OD_DynConf_Obj_24 : 121|7@0+ (1,0) [0|127] "%"  GW
 SG_ ARS_OD_VabsX_Obj_24 : 11|11@0+ (0.125,-128) [-128|127.875] "m/s"  GW
 SG_ ARS_OD_DynProp_Obj_24 : 130|3@0+ (1,0) [0|7] ""  GW
 SG_ ARS_OD_MirrorProb_Obj_24 : 143|7@0+ (1,0) [0|127] "%"  GW
 SG_ ARS_OD_Length_Obj_24 : 136|7@0+ (0.2,0) [0|25.4] "m"  GW
 SG_ ARS_OD_MaintenanceState_Obj_24 : 145|2@0+ (1,0) [0|3] ""  GW
 SG_ ARS_OD_Width_Obj_24 : 159|7@0+ (0.2,0) [0|25.4] "m"  GW
 SG_ ARS_OD_RCS_Obj_24 : 152|9@0+ (0.2,-51.2) [-51.2|51] "dBsm"  GW
 SG_ ARS_OD_Orientation_Obj_24 : 175|10@0+ (0.01,-5.11) [-5.11|5.12] "rad"  GW
 SG_ ARS_OD_YawRateAbs_Obj_24 : 181|10@0+ (0.001,-0.511) [-0.511|0.512] "rad/s"  GW
 SG_ ARS_OD_YawRateAbsStd_Obj_24 : 187|10@0+ (0.0001,0) [0|0.1023] "rad/s"  GW
 SG_ ARS_OD_RefPoint_Obj_24 : 193|2@0+ (1,0) [0|3] ""  GW
 SG_ ARS_OD_LifeCycle_Obj_24 : 207|16@0+ (1,0) [0|65535] ""  GW
 SG_ ARS_OD_DistX_Obj_25 : 223|12@0+ (0.0875,-100.0125) [-100.0125|258.3] "m"  GW
 SG_ ARS_OD_VabsX_Obj_25 : 227|11@0+ (0.125,-128) [-128|127.875] "m/s"  GW
 SG_ ARS_OD_AabsX_Obj_25 : 232|9@0+ (0.125,-31.875) [-31.875|32] "m/s^2"  GW
 SG_ ARS_OD_AabsX_Obj_24 : 16|9@0+ (0.125,-31.875) [-31.875|32] "m/s^2"  GW
 SG_ ARS_OD_DistY_Obj_25 : 255|12@0+ (0.0875,-179.1125) [-179.1125|179.2] "m"  GW
 SG_ ARS_OD_VabsY_Obj_25 : 259|11@0+ (0.125,-128) [-128|127.875] "m/s"  GW
 SG_ ARS_OD_AabsY_Obj_25 : 264|9@0+ (0.125,-31.875) [-31.875|32] "m/s^2"  GW
 SG_ ARS_OD_DistXStd_Obj_25 : 287|8@0+ (0.05,0) [0|12.75] "m"  GW
 SG_ ARS_OD_DistYStd_Obj_25 : 295|8@0+ (0.1,0) [0|25.5] "m"  GW
 SG_ ARS_OD_VabsXStd_Obj_25 : 303|7@0+ (0.1,0) [0|12.7] "m/s"  GW
 SG_ ARS_OD_VabsYStd_Obj_25 : 296|7@0+ (0.2,0) [0|25.4] "m/s"  GW
 SG_ ARS_OD_AabsXStd_Obj_25 : 305|7@0+ (0.25,0) [0|31.75] "m/s^2"  GW
 SG_ ARS_OD_Classification_Obj_25 : 314|3@0+ (1,0) [0|7] ""  GW
 SG_ ARS_OD_AabsYStd_Obj_25 : 327|8@0+ (0.25,0) [0|63.75] "m/s^2"  GW
 SG_ ARS_OD_ClassConf_Obj_25 : 335|7@0+ (1,0) [0|127] "%"  GW
 SG_ ARS_OD_DistY_Obj_24 : 39|12@0+ (0.0875,-179.1125) [-179.1125|179.2] "m"  GW
 SG_ ARS_OD_ProbOfExist_Obj_25 : 328|7@0+ (1,0) [0|127] "%"  GW
 SG_ ARS_OD_DynConf_Obj_25 : 337|7@0+ (1,0) [0|127] "%"  GW
 SG_ ARS_OD_DynProp_Obj_25 : 346|3@0+ (1,0) [0|7] ""  GW
 SG_ ARS_OD_MirrorProb_Obj_25 : 359|7@0+ (1,0) [0|127] "%"  GW
 SG_ ARS_OD_Length_Obj_25 : 352|7@0+ (0.2,0) [0|25.4] "m"  GW
 SG_ ARS_OD_MaintenanceState_Obj_25 : 361|2@0+ (1,0) [0|3] ""  GW
 SG_ ARS_OD_Width_Obj_25 : 375|7@0+ (0.2,0) [0|25.4] "m"  GW
 SG_ ARS_OD_RCS_Obj_25 : 368|9@0+ (0.2,-51.2) [-51.2|51] "dBsm"  GW
 SG_ ARS_OD_Orientation_Obj_25 : 391|10@0+ (0.01,-5.11) [-5.11|5.12] "rad"  GW
 SG_ ARS_OD_YawRateAbs_Obj_25 : 397|10@0+ (0.001,-0.511) [-0.511|0.512] "rad/s"  GW
 SG_ ARS_OD_YawRateAbsStd_Obj_25 : 403|10@0+ (0.0001,0) [0|0.1023] "rad/s"  GW
 SG_ ARS_OD_RefPoint_Obj_25 : 409|2@0+ (1,0) [0|3] ""  GW
 SG_ ARS_OD_LifeCycle_Obj_25 : 423|16@0+ (1,0) [0|65535] ""  GW
 SG_ ARS_OD_OrientationStd_Obj_24 : 439|4@0+ (0.002,0) [0|0.03] "rad"  GW
 SG_ ARS_OD_OrientationStd_Obj_25 : 435|4@0+ (0.002,0) [0|0.03] "rad"  GW
 SG_ ARS_OD_ObstacleProb_Obj_24 : 447|7@0+ (1,0) [0|127] "%"  GW
 SG_ ARS_OD_MicroDopplerFlag_24 : 440|1@0+ (1,0) [0|1] ""  GW
 SG_ ARS_OD_ObstacleProb_Obj_25 : 455|7@0+ (1,0) [0|127] "%"  GW
 SG_ ARS_OD_VabsY_Obj_24 : 43|11@0+ (0.125,-128) [-128|127.875] "m/s"  GW
 SG_ ARS_OD_MicroDopplerFlag_25 : 448|1@0+ (1,0) [0|1] ""  GW
 SG_ ARS_OD_ID_24 : 463|8@0+ (1,0) [0|255] ""  GW
 SG_ ARS_OD_ID_25 : 471|8@0+ (1,0) [0|255] ""  GW
 SG_ ARS_OD_MsgCounter_Obj_24_25 : 495|8@0+ (1,0) [0|255] ""  GW
 SG_ ARS_OD_CRC16_Checksum_Obj_24_25 : 503|16@0+ (1,0) [0|65535] ""  GW
 SG_ ARS_OD_AabsY_Obj_24 : 48|9@0+ (0.125,-31.875) [-31.875|32] "m/s^2"  GW
 SG_ ARS_OD_DistXStd_Obj_24 : 71|8@0+ (0.05,0) [0|12.75] "m"  GW
 SG_ ARS_OD_DistYStd_Obj_24 : 79|8@0+ (0.1,0) [0|25.5] "m"  GW
 SG_ ARS_OD_VabsXStd_Obj_24 : 87|7@0+ (0.1,0) [0|12.7] "m/s"  GW
 SG_ ARS_OD_VabsYStd_Obj_24 : 80|7@0+ (0.2,0) [0|25.4] "m/s"  GW
 SG_ ARS_OD_AabsXStd_Obj_24 : 89|7@0+ (0.25,0) [0|31.75] "m/s^2"  GW

BO_ 526 ARS_OD_26_27: 64 FR
 SG_ ARS_OD_DistX_Obj_26 : 7|12@0+ (0.0875,-100.0125) [-100.0125|258.3] "m"  GW
 SG_ ARS_OD_Classification_Obj_26 : 98|3@0+ (1,0) [0|7] ""  GW
 SG_ ARS_OD_AabsYStd_Obj_26 : 111|8@0+ (0.25,0) [0|63.75] "m/s^2"  GW
 SG_ ARS_OD_ClassConf_Obj_26 : 119|7@0+ (1,0) [0|127] "%"  GW
 SG_ ARS_OD_ProbOfExist_Obj_26 : 112|7@0+ (1,0) [0|127] "%"  GW
 SG_ ARS_OD_DynConf_Obj_26 : 121|7@0+ (1,0) [0|127] "%"  GW
 SG_ ARS_OD_VabsX_Obj_26 : 11|11@0+ (0.125,-128) [-128|127.875] "m/s"  GW
 SG_ ARS_OD_DynProp_Obj_26 : 130|3@0+ (1,0) [0|7] ""  GW
 SG_ ARS_OD_MirrorProb_Obj_26 : 143|7@0+ (1,0) [0|127] "%"  GW
 SG_ ARS_OD_Length_Obj_26 : 136|7@0+ (0.2,0) [0|25.4] "m"  GW
 SG_ ARS_OD_MaintenanceState_Obj_26 : 145|2@0+ (1,0) [0|3] ""  GW
 SG_ ARS_OD_Width_Obj_26 : 159|7@0+ (0.2,0) [0|25.4] "m"  GW
 SG_ ARS_OD_RCS_Obj_26 : 152|9@0+ (0.2,-51.2) [-51.2|51] "dBsm"  GW
 SG_ ARS_OD_Orientation_Obj_26 : 175|10@0+ (0.01,-5.11) [-5.11|5.12] "rad"  GW
 SG_ ARS_OD_YawRateAbs_Obj_26 : 181|10@0+ (0.001,-0.511) [-0.511|0.512] "rad/s"  GW
 SG_ ARS_OD_YawRateAbsStd_Obj_26 : 187|10@0+ (0.0001,0) [0|0.1023] "rad/s"  GW
 SG_ ARS_OD_RefPoint_Obj_26 : 193|2@0+ (1,0) [0|3] ""  GW
 SG_ ARS_OD_LifeCycle_Obj_26 : 207|16@0+ (1,0) [0|65535] ""  GW
 SG_ ARS_OD_DistX_Obj_27 : 223|12@0+ (0.0875,-100.0125) [-100.0125|258.3] "m"  GW
 SG_ ARS_OD_VabsX_Obj_27 : 227|11@0+ (0.125,-128) [-128|127.875] "m/s"  GW
 SG_ ARS_OD_AabsX_Obj_27 : 232|9@0+ (0.125,-31.875) [-31.875|32] "m/s^2"  GW
 SG_ ARS_OD_AabsX_Obj_26 : 16|9@0+ (0.125,-31.875) [-31.875|32] "m/s^2"  GW
 SG_ ARS_OD_DistY_Obj_27 : 255|12@0+ (0.0875,-179.1125) [-179.1125|179.2] "m"  GW
 SG_ ARS_OD_VabsY_Obj_27 : 259|11@0+ (0.125,-128) [-128|127.875] "m/s"  GW
 SG_ ARS_OD_AabsY_Obj_27 : 264|9@0+ (0.125,-31.875) [-31.875|32] "m/s^2"  GW
 SG_ ARS_OD_DistXStd_Obj_27 : 287|8@0+ (0.05,0) [0|12.75] "m"  GW
 SG_ ARS_OD_DistYStd_Obj_27 : 295|8@0+ (0.1,0) [0|25.5] "m"  GW
 SG_ ARS_OD_VabsXStd_Obj_27 : 303|7@0+ (0.1,0) [0|12.7] "m/s"  GW
 SG_ ARS_OD_VabsYStd_Obj_27 : 296|7@0+ (0.2,0) [0|25.4] "m/s"  GW
 SG_ ARS_OD_AabsXStd_Obj_27 : 305|7@0+ (0.25,0) [0|31.75] "m/s^2"  GW
 SG_ ARS_OD_Classification_Obj_27 : 314|3@0+ (1,0) [0|7] ""  GW
 SG_ ARS_OD_AabsYStd_Obj_27 : 327|8@0+ (0.25,0) [0|63.75] "m/s^2"  GW
 SG_ ARS_OD_ClassConf_Obj_27 : 335|7@0+ (1,0) [0|127] "%"  GW
 SG_ ARS_OD_DistY_Obj_26 : 39|12@0+ (0.0875,-179.1125) [-179.1125|179.2] "m"  GW
 SG_ ARS_OD_ProbOfExist_Obj_27 : 328|7@0+ (1,0) [0|127] "%"  GW
 SG_ ARS_OD_DynConf_Obj_27 : 337|7@0+ (1,0) [0|127] "%"  GW
 SG_ ARS_OD_DynProp_Obj_27 : 346|3@0+ (1,0) [0|7] ""  GW
 SG_ ARS_OD_MirrorProb_Obj_27 : 359|7@0+ (1,0) [0|127] "%"  GW
 SG_ ARS_OD_Length_Obj_27 : 352|7@0+ (0.2,0) [0|25.4] "m"  GW
 SG_ ARS_OD_MaintenanceState_Obj_27 : 361|2@0+ (1,0) [0|3] ""  GW
 SG_ ARS_OD_Width_Obj_27 : 375|7@0+ (0.2,0) [0|25.4] "m"  GW
 SG_ ARS_OD_RCS_Obj_27 : 368|9@0+ (0.2,-51.2) [-51.2|51] "dBsm"  GW
 SG_ ARS_OD_Orientation_Obj_27 : 391|10@0+ (0.01,-5.11) [-5.11|5.12] "rad"  GW
 SG_ ARS_OD_YawRateAbs_Obj_27 : 397|10@0+ (0.001,-0.511) [-0.511|0.512] "rad/s"  GW
 SG_ ARS_OD_YawRateAbsStd_Obj_27 : 403|10@0+ (0.0001,0) [0|0.1023] "rad/s"  GW
 SG_ ARS_OD_RefPoint_Obj_27 : 409|2@0+ (1,0) [0|3] ""  GW
 SG_ ARS_OD_LifeCycle_Obj_27 : 423|16@0+ (1,0) [0|65535] ""  GW
 SG_ ARS_OD_OrientationStd_Obj_26 : 439|4@0+ (0.002,0) [0|0.03] "rad"  GW
 SG_ ARS_OD_OrientationStd_Obj_27 : 435|4@0+ (0.002,0) [0|0.03] "rad"  GW
 SG_ ARS_OD_ObstacleProb_Obj_26 : 447|7@0+ (1,0) [0|127] "%"  GW
 SG_ ARS_OD_MicroDopplerFlag_26 : 440|1@0+ (1,0) [0|1] ""  GW
 SG_ ARS_OD_ObstacleProb_Obj_27 : 455|7@0+ (1,0) [0|127] "%"  GW
 SG_ ARS_OD_VabsY_Obj_26 : 43|11@0+ (0.125,-128) [-128|127.875] "m/s"  GW
 SG_ ARS_OD_MicroDopplerFlag_27 : 448|1@0+ (1,0) [0|1] ""  GW
 SG_ ARS_OD_ID_26 : 463|8@0+ (1,0) [0|255] ""  GW
 SG_ ARS_OD_ID_27 : 471|8@0+ (1,0) [0|255] ""  GW
 SG_ ARS_OD_MsgCounter_Obj_26_27 : 495|8@0+ (1,0) [0|255] ""  GW
 SG_ ARS_OD_CRC16_Checksum_Obj_26_27 : 503|16@0+ (1,0) [0|65535] ""  GW
 SG_ ARS_OD_AabsY_Obj_26 : 48|9@0+ (0.125,-31.875) [-31.875|32] "m/s^2"  GW
 SG_ ARS_OD_DistXStd_Obj_26 : 71|8@0+ (0.05,0) [0|12.75] "m"  GW
 SG_ ARS_OD_DistYStd_Obj_26 : 79|8@0+ (0.1,0) [0|25.5] "m"  GW
 SG_ ARS_OD_VabsXStd_Obj_26 : 87|7@0+ (0.1,0) [0|12.7] "m/s"  GW
 SG_ ARS_OD_VabsYStd_Obj_26 : 80|7@0+ (0.2,0) [0|25.4] "m/s"  GW
 SG_ ARS_OD_AabsXStd_Obj_26 : 89|7@0+ (0.25,0) [0|31.75] "m/s^2"  GW

CM_ SG_ 512 ARS_OD_TimeStampGlobSec "Synchronized global timestamp when OD-task corresponding RF task is done (second part)
?????,OD?????RF????????(???)";
CM_ SG_ 512 ARS_OD_CycleCounter "Internal coutner that increments if OD task executes once
??OD?????";
CM_ SG_ 512 ARS_OD_NumOfObjects "Number of objects
????";
CM_ SG_ 512 ARS_OD_TaskValidFlag "Flag indicates OD task is valid
OD????????";
CM_ SG_ 512 ARS_OD_ExtendedCycleFlag "Flag indicates OD task takes two cycles time to execute
???????(?RDI????????????)";
CM_ SG_ 512 ARS_OD_Latency "Time difference between RF task and OD task (signal processing time)
RF???OD??????(??????)";
CM_ SG_ 512 ARS_OD_EgoVelocity "Ego velocity filtered by Radar Algorithm
????????????";
CM_ SG_ 512 ARS_OD_EgoYawRate "Ego yaw rate filtered by Radar Algorithm
???????????????";
CM_ SG_ 512 ARS_OD_EgoVelocityStd "Ego velocity standard deviation filtered by Radar Algorithm
???????????????";
CM_ SG_ 512 ARS_OD_EgoAcceleration "Ego acceleration filtered by Radar Algorithm
?????????????";
CM_ SG_ 512 ARS_OD_EgoCurvature "Ego curvature filtered by Radar Algorithm
??????????????";
CM_ SG_ 512 ARS_OD_TimeStampGlobNanoSec "Synchronized global timestamp when OD-task corresponding RF task is done  (nannosecond part)
?????,OD?????RF????????(????)";
CM_ SG_ 512 ARS_OD_TimeStampLocal "Unsynchronized local timestamp when OD-task corresponding RF task is done
??????,OD?????RF??????????";
CM_ SG_ 512 ARS_OD_MeasCounter "Internal counter that increments if RF task executes once
??RF?????";
CM_ SG_ 513 ARS_OD_DistX_Obj_00 "Longitudinal distance of object_00
00????????";
CM_ SG_ 513 ARS_OD_Classification_Obj_00 "Classification of object_00
00??????";
CM_ SG_ 513 ARS_OD_AabsYStd_Obj_00 "Lateral absolution acceleration standard deviation of object_00
00????????????????";
CM_ SG_ 513 ARS_OD_ClassConf_Obj_00 "Classification confidence of object_00
00?????????";
CM_ SG_ 513 ARS_OD_ProbOfExist_Obj_00 "Existence probability of object_00
00????????";
CM_ SG_ 513 ARS_OD_DynConf_Obj_00 "Dynamic property confidence of object_00
00???????????";
CM_ SG_ 513 ARS_OD_VabsX_Obj_00 "Longitudinal absolution velocity over ground of object_00
00????????????";
CM_ SG_ 513 ARS_OD_DynProp_Obj_00 "Dynamic property of object_00
00????????";
CM_ SG_ 513 ARS_OD_MirrorProb_Obj_00 "Mirror probability of object_00
00????????";
CM_ SG_ 513 ARS_OD_Length_Obj_00 "Length of object_00
00??????";
CM_ SG_ 513 ARS_OD_MaintenanceState_Obj_00 "Maintenance state of object_00
00????????";
CM_ SG_ 513 ARS_OD_Width_Obj_00 "Width of object_00
00??????";
CM_ SG_ 513 ARS_OD_RCS_Obj_00 "RCS of object_00
00?????????";
CM_ SG_ 513 ARS_OD_Orientation_Obj_00 "Orientation of object_00
00???????";
CM_ SG_ 513 ARS_OD_YawRateAbs_Obj_00 "Yaw rate of object_00
00?????????";
CM_ SG_ 513 ARS_OD_YawRateAbsStd_Obj_00 "Yaw rate standard deviation of object_00
00????????????";
CM_ SG_ 513 ARS_OD_RefPoint_Obj_00 "Reference point of object_00
00???????";
CM_ SG_ 513 ARS_OD_LifeCycle_Obj_00 "Life cycle of object_00
00????????";
CM_ SG_ 513 ARS_OD_AabsX_Obj_00 "Longitudinal absolution acceleration over ground of object_00
00?????????????";
CM_ SG_ 513 ARS_OD_DistY_Obj_00 "Lateral distance of object_00
00????????";
CM_ SG_ 513 ARS_OD_OrientationStd_Obj_00 "Orientation standard deviation of object_00
00??????????";
CM_ SG_ 513 ARS_OD_ObstacleProb_Obj_00 "Obstacle probability of object_00
00?????????";
CM_ SG_ 513 ARS_OD_MicroDopplerFlag_00 "Micro-Doppler flag of object_00
00???????????";
CM_ SG_ 513 ARS_OD_VabsY_Obj_00 "Lateral absolution velocity over ground of object_00
00????????????";
CM_ SG_ 513 ARS_OD_AabsY_Obj_00 "Lateral absolution acceleration over ground of object_00
00?????????????";
CM_ SG_ 513 ARS_OD_DistXStd_Obj_00 "Longitudinal distance standard deviation of object_00
00???????????";
CM_ SG_ 513 ARS_OD_DistYStd_Obj_00 "Lateral distance standard deviation of object_00
00???????????";
CM_ SG_ 513 ARS_OD_VabsXStd_Obj_00 "Longitudinal absolution velocity standard deviation of object_00
00???????????????";
CM_ SG_ 513 ARS_OD_VabsYStd_Obj_00 "Lateral absolution velocity standard deviation of object_00
00???????????????";
CM_ SG_ 513 ARS_OD_AabsXStd_Obj_00 "Longitudinal absolution acceleration standard deviation of object_00
00????????????????";
CM_ SG_ 514 ARS_OD_DistX_Obj_02 "111";
CM_ SG_ 514 ARS_OD_Classification_Obj_02 "Classification of object_02
00??????";
CM_ SG_ 514 ARS_OD_AabsYStd_Obj_02 "Lateral absolution acceleration standard deviation of object_02
00????????????????";
CM_ SG_ 514 ARS_OD_ClassConf_Obj_02 "Classification confidence of object_02
00?????????";
CM_ SG_ 514 ARS_OD_ProbOfExist_Obj_02 "Existence probability of object_02
00????????";
CM_ SG_ 514 ARS_OD_DynConf_Obj_02 "Dynamic property confidence of object_02
00???????????";
CM_ SG_ 514 ARS_OD_VabsX_Obj_02 "Longitudinal absolution velocity over ground of object_02
00????????????";
CM_ SG_ 514 ARS_OD_DynProp_Obj_02 "Dynamic property of object_02
00????????";
CM_ SG_ 514 ARS_OD_MirrorProb_Obj_02 "Mirror probability of object_02
00????????";
CM_ SG_ 514 ARS_OD_Length_Obj_02 "Length of object_02
00??????";
CM_ SG_ 514 ARS_OD_MaintenanceState_Obj_02 "Maintenance state of object_02
00????????";
CM_ SG_ 514 ARS_OD_Width_Obj_02 "Width of object_02
00??????";
CM_ SG_ 514 ARS_OD_RCS_Obj_02 "RCS of object_02
00?????????";
CM_ SG_ 514 ARS_OD_Orientation_Obj_02 "Orientation of object_02
00???????";
CM_ SG_ 514 ARS_OD_YawRateAbs_Obj_02 "Yaw rate of object_02
00?????????";
CM_ SG_ 514 ARS_OD_YawRateAbsStd_Obj_02 "Yaw rate standard deviation of object_02
00????????????";
CM_ SG_ 514 ARS_OD_RefPoint_Obj_02 "Reference point of object_02
00???????";
CM_ SG_ 514 ARS_OD_LifeCycle_Obj_02 "Life cycle of object_02
00????????";
CM_ SG_ 514 ARS_OD_AabsX_Obj_02 "Longitudinal absolution acceleration over ground of object_02
00?????????????";
CM_ SG_ 514 ARS_OD_DistY_Obj_02 "Lateral distance of object_02
00????????";
CM_ SG_ 514 ARS_OD_OrientationStd_Obj_02 "Orientation standard deviation of object_02
00??????????";
CM_ SG_ 514 ARS_OD_ObstacleProb_Obj_02 "Obstacle probability of object_02
00?????????";
CM_ SG_ 514 ARS_OD_MicroDopplerFlag_02 "Micro-Doppler flag of object_02
00???????????";
CM_ SG_ 514 ARS_OD_VabsY_Obj_02 "Lateral absolution velocity over ground of object_02
00????????????";
CM_ SG_ 514 ARS_OD_AabsY_Obj_02 "Lateral absolution acceleration over ground of object_02
00?????????????";
CM_ SG_ 514 ARS_OD_DistXStd_Obj_02 "Longitudinal distance standard deviation of object_02
00???????????";
CM_ SG_ 514 ARS_OD_DistYStd_Obj_02 "Lateral distance standard deviation of object_02
00???????????";
CM_ SG_ 514 ARS_OD_VabsXStd_Obj_02 "Longitudinal absolution velocity standard deviation of object_02
00???????????????";
CM_ SG_ 514 ARS_OD_VabsYStd_Obj_02 "Lateral absolution velocity standard deviation of object_02
00???????????????";
CM_ SG_ 514 ARS_OD_AabsXStd_Obj_02 "Longitudinal absolution acceleration standard deviation of object_02
00????????????????";
CM_ SG_ 515 ARS_OD_DistX_Obj_04 "Longitudinal distance of object_04
00????????";
CM_ SG_ 515 ARS_OD_Classification_Obj_04 "Classification of object_04
00??????";
CM_ SG_ 515 ARS_OD_AabsYStd_Obj_04 "Lateral absolution acceleration standard deviation of object_04
00????????????????";
CM_ SG_ 515 ARS_OD_ClassConf_Obj_04 "Classification confidence of object_04
00?????????";
CM_ SG_ 515 ARS_OD_ProbOfExist_Obj_04 "Existence probability of object_04
00????????";
CM_ SG_ 515 ARS_OD_DynConf_Obj_04 "Dynamic property confidence of object_04
00???????????";
CM_ SG_ 515 ARS_OD_VabsX_Obj_04 "Longitudinal absolution velocity over ground of object_04
00????????????";
CM_ SG_ 515 ARS_OD_DynProp_Obj_04 "Dynamic property of object_04
00????????";
CM_ SG_ 515 ARS_OD_MirrorProb_Obj_04 "Mirror probability of object_04
00????????";
CM_ SG_ 515 ARS_OD_Length_Obj_04 "Length of object_04
00??????";
CM_ SG_ 515 ARS_OD_MaintenanceState_Obj_04 "Maintenance state of object_04
00????????";
CM_ SG_ 515 ARS_OD_Width_Obj_04 "Width of object_04
00??????";
CM_ SG_ 515 ARS_OD_RCS_Obj_04 "RCS of object_04
00?????????";
CM_ SG_ 515 ARS_OD_Orientation_Obj_04 "Orientation of object_04
00???????";
CM_ SG_ 515 ARS_OD_YawRateAbs_Obj_04 "Yaw rate of object_04
00?????????";
CM_ SG_ 515 ARS_OD_YawRateAbsStd_Obj_04 "Yaw rate standard deviation of object_04
00????????????";
CM_ SG_ 515 ARS_OD_RefPoint_Obj_04 "Reference point of object_04
00???????";
CM_ SG_ 515 ARS_OD_LifeCycle_Obj_04 "Life cycle of object_04
00????????";
CM_ SG_ 515 ARS_OD_AabsX_Obj_04 "Longitudinal absolution acceleration over ground of object_04
00?????????????";
CM_ SG_ 515 ARS_OD_DistY_Obj_04 "Lateral distance of object_04
00????????";
CM_ SG_ 515 ARS_OD_OrientationStd_Obj_04 "Orientation standard deviation of object_04
00??????????";
CM_ SG_ 515 ARS_OD_ObstacleProb_Obj_04 "Obstacle probability of object_04
00?????????";
CM_ SG_ 515 ARS_OD_MicroDopplerFlag_04 "Micro-Doppler flag of object_04
00???????????";
CM_ SG_ 515 ARS_OD_VabsY_Obj_04 "Lateral absolution velocity over ground of object_04
00????????????";
CM_ SG_ 515 ARS_OD_AabsY_Obj_04 "Lateral absolution acceleration over ground of object_04
00?????????????";
CM_ SG_ 515 ARS_OD_DistXStd_Obj_04 "Longitudinal distance standard deviation of object_04
00???????????";
CM_ SG_ 515 ARS_OD_DistYStd_Obj_04 "Lateral distance standard deviation of object_04
00???????????";
CM_ SG_ 515 ARS_OD_VabsXStd_Obj_04 "Longitudinal absolution velocity standard deviation of object_04
00???????????????";
CM_ SG_ 515 ARS_OD_VabsYStd_Obj_04 "Lateral absolution velocity standard deviation of object_04
00???????????????";
CM_ SG_ 515 ARS_OD_AabsXStd_Obj_04 "Longitudinal absolution acceleration standard deviation of object_04
00????????????????";
CM_ SG_ 516 ARS_OD_DistX_Obj_06 "Longitudinal distance of object_06
00????????";
CM_ SG_ 516 ARS_OD_Classification_Obj_06 "Classification of object_06
00??????";
CM_ SG_ 516 ARS_OD_AabsYStd_Obj_06 "Lateral absolution acceleration standard deviation of object_06
00????????????????";
CM_ SG_ 516 ARS_OD_ClassConf_Obj_06 "Classification confidence of object_06
00?????????";
CM_ SG_ 516 ARS_OD_ProbOfExist_Obj_06 "Existence probability of object_06
00????????";
CM_ SG_ 516 ARS_OD_DynConf_Obj_06 "Dynamic property confidence of object_06
00???????????";
CM_ SG_ 516 ARS_OD_VabsX_Obj_06 "Longitudinal absolution velocity over ground of object_06
00????????????";
CM_ SG_ 516 ARS_OD_DynProp_Obj_06 "Dynamic property of object_06
00????????";
CM_ SG_ 516 ARS_OD_MirrorProb_Obj_06 "Mirror probability of object_06
00????????";
CM_ SG_ 516 ARS_OD_Length_Obj_06 "Length of object_06
00??????";
CM_ SG_ 516 ARS_OD_MaintenanceState_Obj_06 "Maintenance state of object_06
00????????";
CM_ SG_ 516 ARS_OD_Width_Obj_06 "Width of object_06
00??????";
CM_ SG_ 516 ARS_OD_RCS_Obj_06 "RCS of object_06
00?????????";
CM_ SG_ 516 ARS_OD_Orientation_Obj_06 "Orientation of object_06
00???????";
CM_ SG_ 516 ARS_OD_YawRateAbs_Obj_06 "Yaw rate of object_06
00?????????";
CM_ SG_ 516 ARS_OD_YawRateAbsStd_Obj_06 "Yaw rate standard deviation of object_06
00????????????";
CM_ SG_ 516 ARS_OD_RefPoint_Obj_06 "Reference point of object_06
00???????";
CM_ SG_ 516 ARS_OD_LifeCycle_Obj_06 "Life cycle of object_06
00????????";
CM_ SG_ 516 ARS_OD_AabsX_Obj_06 "Longitudinal absolution acceleration over ground of object_06
00?????????????";
CM_ SG_ 516 ARS_OD_DistY_Obj_06 "Lateral distance of object_06
00????????";
CM_ SG_ 516 ARS_OD_OrientationStd_Obj_06 "Orientation standard deviation of object_06
00??????????";
CM_ SG_ 516 ARS_OD_ObstacleProb_Obj_06 "Obstacle probability of object_06
00?????????";
CM_ SG_ 516 ARS_OD_MicroDopplerFlag_06 "Micro-Doppler flag of object_06
00???????????";
CM_ SG_ 516 ARS_OD_VabsY_Obj_06 "Lateral absolution velocity over ground of object_06
00????????????";
CM_ SG_ 516 ARS_OD_AabsY_Obj_06 "Lateral absolution acceleration over ground of object_06
00?????????????";
CM_ SG_ 516 ARS_OD_DistXStd_Obj_06 "Longitudinal distance standard deviation of object_06
00???????????";
CM_ SG_ 516 ARS_OD_DistYStd_Obj_06 "Lateral distance standard deviation of object_06
00???????????";
CM_ SG_ 516 ARS_OD_VabsXStd_Obj_06 "Longitudinal absolution velocity standard deviation of object_06
00???????????????";
CM_ SG_ 516 ARS_OD_VabsYStd_Obj_06 "Lateral absolution velocity standard deviation of object_06
00???????????????";
CM_ SG_ 516 ARS_OD_AabsXStd_Obj_06 "Longitudinal absolution acceleration standard deviation of object_06
00????????????????";
CM_ SG_ 517 ARS_OD_DistX_Obj_08 "Longitudinal distance of object_08
00????????";
CM_ SG_ 517 ARS_OD_Classification_Obj_08 "Classification of object_08
00??????";
CM_ SG_ 517 ARS_OD_AabsYStd_Obj_08 "Lateral absolution acceleration standard deviation of object_08
00????????????????";
CM_ SG_ 517 ARS_OD_ClassConf_Obj_08 "Classification confidence of object_08
00?????????";
CM_ SG_ 517 ARS_OD_ProbOfExist_Obj_08 "Existence probability of object_08
00????????";
CM_ SG_ 517 ARS_OD_DynConf_Obj_08 "Dynamic property confidence of object_08
00???????????";
CM_ SG_ 517 ARS_OD_VabsX_Obj_08 "Longitudinal absolution velocity over ground of object_08
00????????????";
CM_ SG_ 517 ARS_OD_DynProp_Obj_08 "Dynamic property of object_08
00????????";
CM_ SG_ 517 ARS_OD_MirrorProb_Obj_08 "Mirror probability of object_08
00????????";
CM_ SG_ 517 ARS_OD_Length_Obj_08 "Length of object_08
00??????";
CM_ SG_ 517 ARS_OD_MaintenanceState_Obj_08 "Maintenance state of object_08
00????????";
CM_ SG_ 517 ARS_OD_Width_Obj_08 "Width of object_08
00??????";
CM_ SG_ 517 ARS_OD_RCS_Obj_08 "RCS of object_08
00?????????";
CM_ SG_ 517 ARS_OD_Orientation_Obj_08 "Orientation of object_08
00???????";
CM_ SG_ 517 ARS_OD_YawRateAbs_Obj_08 "Yaw rate of object_08
00?????????";
CM_ SG_ 517 ARS_OD_YawRateAbsStd_Obj_08 "Yaw rate standard deviation of object_08
00????????????";
CM_ SG_ 517 ARS_OD_RefPoint_Obj_08 "Reference point of object_08
00???????";
CM_ SG_ 517 ARS_OD_LifeCycle_Obj_08 "Life cycle of object_08
00????????";
CM_ SG_ 517 ARS_OD_AabsX_Obj_08 "Longitudinal absolution acceleration over ground of object_08
00?????????????";
CM_ SG_ 517 ARS_OD_DistY_Obj_08 "Lateral distance of object_08
00????????";
CM_ SG_ 517 ARS_OD_OrientationStd_Obj_08 "Orientation standard deviation of object_08
00??????????";
CM_ SG_ 517 ARS_OD_ObstacleProb_Obj_08 "Obstacle probability of object_08
00?????????";
CM_ SG_ 517 ARS_OD_MicroDopplerFlag_08 "Micro-Doppler flag of object_08
00???????????";
CM_ SG_ 517 ARS_OD_VabsY_Obj_08 "Lateral absolution velocity over ground of object_08
00????????????";
CM_ SG_ 517 ARS_OD_AabsY_Obj_08 "Lateral absolution acceleration over ground of object_08
00?????????????";
CM_ SG_ 517 ARS_OD_DistXStd_Obj_08 "Longitudinal distance standard deviation of object_08
00???????????";
CM_ SG_ 517 ARS_OD_DistYStd_Obj_08 "Lateral distance standard deviation of object_08
00???????????";
CM_ SG_ 517 ARS_OD_VabsXStd_Obj_08 "Longitudinal absolution velocity standard deviation of object_08
00???????????????";
CM_ SG_ 517 ARS_OD_VabsYStd_Obj_08 "Lateral absolution velocity standard deviation of object_08
00???????????????";
CM_ SG_ 517 ARS_OD_AabsXStd_Obj_08 "Longitudinal absolution acceleration standard deviation of object_08
00????????????????";
CM_ SG_ 518 ARS_OD_DistX_Obj_10 "Longitudinal distance of object_10
00????????";
CM_ SG_ 518 ARS_OD_Classification_Obj_10 "Classification of object_10
00??????";
CM_ SG_ 518 ARS_OD_AabsYStd_Obj_10 "Lateral absolution acceleration standard deviation of object_10
00????????????????";
CM_ SG_ 518 ARS_OD_ClassConf_Obj_10 "Classification confidence of object_10
00?????????";
CM_ SG_ 518 ARS_OD_ProbOfExist_Obj_10 "Existence probability of object_10
00????????";
CM_ SG_ 518 ARS_OD_DynConf_Obj_10 "Dynamic property confidence of object_10
00???????????";
CM_ SG_ 518 ARS_OD_VabsX_Obj_10 "Longitudinal absolution velocity over ground of object_10
00????????????";
CM_ SG_ 518 ARS_OD_DynProp_Obj_10 "Dynamic property of object_10
00????????";
CM_ SG_ 518 ARS_OD_MirrorProb_Obj_10 "Mirror probability of object_10
00????????";
CM_ SG_ 518 ARS_OD_Length_Obj_10 "Length of object_10
00??????";
CM_ SG_ 518 ARS_OD_MaintenanceState_Obj_10 "Maintenance state of object_10
00????????";
CM_ SG_ 518 ARS_OD_Width_Obj_10 "Width of object_10
00??????";
CM_ SG_ 518 ARS_OD_RCS_Obj_10 "RCS of object_10
00?????????";
CM_ SG_ 518 ARS_OD_Orientation_Obj_10 "Orientation of object_10
00???????";
CM_ SG_ 518 ARS_OD_YawRateAbs_Obj_10 "Yaw rate of object_10
00?????????";
CM_ SG_ 518 ARS_OD_YawRateAbsStd_Obj_10 "Yaw rate standard deviation of object_10
00????????????";
CM_ SG_ 518 ARS_OD_RefPoint_Obj_10 "Reference point of object_10
00???????";
CM_ SG_ 518 ARS_OD_LifeCycle_Obj_10 "Life cycle of object_10
00????????";
CM_ SG_ 518 ARS_OD_AabsX_Obj_10 "Longitudinal absolution acceleration over ground of object_10
00?????????????";
CM_ SG_ 518 ARS_OD_DistY_Obj_10 "Lateral distance of object_10
00????????";
CM_ SG_ 518 ARS_OD_OrientationStd_Obj_10 "Orientation standard deviation of object_10
00??????????";
CM_ SG_ 518 ARS_OD_ObstacleProb_Obj_10 "Obstacle probability of object_10
00?????????";
CM_ SG_ 518 ARS_OD_MicroDopplerFlag_10 "Micro-Doppler flag of object_10
00???????????";
CM_ SG_ 518 ARS_OD_VabsY_Obj_10 "Lateral absolution velocity over ground of object_10
00????????????";
CM_ SG_ 518 ARS_OD_AabsY_Obj_10 "Lateral absolution acceleration over ground of object_10
00?????????????";
CM_ SG_ 518 ARS_OD_DistXStd_Obj_10 "Longitudinal distance standard deviation of object_10
00???????????";
CM_ SG_ 518 ARS_OD_DistYStd_Obj_10 "Lateral distance standard deviation of object_10
00???????????";
CM_ SG_ 518 ARS_OD_VabsXStd_Obj_10 "Longitudinal absolution velocity standard deviation of object_10
00???????????????";
CM_ SG_ 518 ARS_OD_VabsYStd_Obj_10 "Lateral absolution velocity standard deviation of object_10
00???????????????";
CM_ SG_ 518 ARS_OD_AabsXStd_Obj_10 "Longitudinal absolution acceleration standard deviation of object_10
00????????????????";
CM_ SG_ 519 ARS_OD_DistX_Obj_12 "Longitudinal distance of object_12
00????????";
CM_ SG_ 519 ARS_OD_Classification_Obj_12 "Classification of object_12
00??????";
CM_ SG_ 519 ARS_OD_AabsYStd_Obj_12 "Lateral absolution acceleration standard deviation of object_12
00????????????????";
CM_ SG_ 519 ARS_OD_ClassConf_Obj_12 "Classification confidence of object_12
00?????????";
CM_ SG_ 519 ARS_OD_ProbOfExist_Obj_12 "Existence probability of object_12
00????????";
CM_ SG_ 519 ARS_OD_DynConf_Obj_12 "Dynamic property confidence of object_12
00???????????";
CM_ SG_ 519 ARS_OD_VabsX_Obj_12 "Longitudinal absolution velocity over ground of object_12
00????????????";
CM_ SG_ 519 ARS_OD_DynProp_Obj_12 "Dynamic property of object_12
00????????";
CM_ SG_ 519 ARS_OD_MirrorProb_Obj_12 "Mirror probability of object_12
00????????";
CM_ SG_ 519 ARS_OD_Length_Obj_12 "Length of object_12
00??????";
CM_ SG_ 519 ARS_OD_MaintenanceState_Obj_12 "Maintenance state of object_12
00????????";
CM_ SG_ 519 ARS_OD_Width_Obj_12 "Width of object_12
00??????";
CM_ SG_ 519 ARS_OD_RCS_Obj_12 "RCS of object_12
00?????????";
CM_ SG_ 519 ARS_OD_Orientation_Obj_12 "Orientation of object_12
00???????";
CM_ SG_ 519 ARS_OD_YawRateAbs_Obj_12 "Yaw rate of object_12
00?????????";
CM_ SG_ 519 ARS_OD_YawRateAbsStd_Obj_12 "Yaw rate standard deviation of object_12
00????????????";
CM_ SG_ 519 ARS_OD_RefPoint_Obj_12 "Reference point of object_12
00???????";
CM_ SG_ 519 ARS_OD_LifeCycle_Obj_12 "Life cycle of object_12
00????????";
CM_ SG_ 519 ARS_OD_AabsX_Obj_12 "Longitudinal absolution acceleration over ground of object_12
00?????????????";
CM_ SG_ 519 ARS_OD_DistY_Obj_12 "Lateral distance of object_12
00????????";
CM_ SG_ 519 ARS_OD_OrientationStd_Obj_12 "Orientation standard deviation of object_12
00??????????";
CM_ SG_ 519 ARS_OD_ObstacleProb_Obj_12 "Obstacle probability of object_12
00?????????";
CM_ SG_ 519 ARS_OD_MicroDopplerFlag_12 "Micro-Doppler flag of object_12
00???????????";
CM_ SG_ 519 ARS_OD_VabsY_Obj_12 "Lateral absolution velocity over ground of object_12
00????????????";
CM_ SG_ 519 ARS_OD_AabsY_Obj_12 "Lateral absolution acceleration over ground of object_12
00?????????????";
CM_ SG_ 519 ARS_OD_DistXStd_Obj_12 "Longitudinal distance standard deviation of object_12
00???????????";
CM_ SG_ 519 ARS_OD_DistYStd_Obj_12 "Lateral distance standard deviation of object_12
00???????????";
CM_ SG_ 519 ARS_OD_VabsXStd_Obj_12 "Longitudinal absolution velocity standard deviation of object_12
00???????????????";
CM_ SG_ 519 ARS_OD_VabsYStd_Obj_12 "Lateral absolution velocity standard deviation of object_12
00???????????????";
CM_ SG_ 519 ARS_OD_AabsXStd_Obj_12 "Longitudinal absolution acceleration standard deviation of object_12
00????????????????";
CM_ SG_ 520 ARS_OD_DistX_Obj_14 "Longitudinal distance of object_14
00????????";
CM_ SG_ 520 ARS_OD_Classification_Obj_14 "Classification of object_14
00??????";
CM_ SG_ 520 ARS_OD_AabsYStd_Obj_14 "Lateral absolution acceleration standard deviation of object_14
00????????????????";
CM_ SG_ 520 ARS_OD_ClassConf_Obj_14 "Classification confidence of object_14
00?????????";
CM_ SG_ 520 ARS_OD_ProbOfExist_Obj_14 "Existence probability of object_14
00????????";
CM_ SG_ 520 ARS_OD_DynConf_Obj_14 "Dynamic property confidence of object_14
00???????????";
CM_ SG_ 520 ARS_OD_VabsX_Obj_14 "Longitudinal absolution velocity over ground of object_14
00????????????";
CM_ SG_ 520 ARS_OD_DynProp_Obj_14 "Dynamic property of object_14
00????????";
CM_ SG_ 520 ARS_OD_MirrorProb_Obj_14 "Mirror probability of object_14
00????????";
CM_ SG_ 520 ARS_OD_Length_Obj_14 "Length of object_14
00??????";
CM_ SG_ 520 ARS_OD_MaintenanceState_Obj_14 "Maintenance state of object_14
00????????";
CM_ SG_ 520 ARS_OD_Width_Obj_14 "Width of object_14
00??????";
CM_ SG_ 520 ARS_OD_RCS_Obj_14 "RCS of object_14
00?????????";
CM_ SG_ 520 ARS_OD_Orientation_Obj_14 "Orientation of object_14
00???????";
CM_ SG_ 520 ARS_OD_YawRateAbs_Obj_14 "Yaw rate of object_14
00?????????";
CM_ SG_ 520 ARS_OD_YawRateAbsStd_Obj_14 "Yaw rate standard deviation of object_14
00????????????";
CM_ SG_ 520 ARS_OD_RefPoint_Obj_14 "Reference point of object_14
00???????";
CM_ SG_ 520 ARS_OD_LifeCycle_Obj_14 "Life cycle of object_14
00????????";
CM_ SG_ 520 ARS_OD_AabsX_Obj_14 "Longitudinal absolution acceleration over ground of object_14
00?????????????";
CM_ SG_ 520 ARS_OD_DistY_Obj_14 "Lateral distance of object_14
00????????";
CM_ SG_ 520 ARS_OD_OrientationStd_Obj_14 "Orientation standard deviation of object_14
00??????????";
CM_ SG_ 520 ARS_OD_ObstacleProb_Obj_14 "Obstacle probability of object_14
00?????????";
CM_ SG_ 520 ARS_OD_MicroDopplerFlag_14 "Micro-Doppler flag of object_14
00???????????";
CM_ SG_ 520 ARS_OD_VabsY_Obj_14 "Lateral absolution velocity over ground of object_14
00????????????";
CM_ SG_ 520 ARS_OD_AabsY_Obj_14 "Lateral absolution acceleration over ground of object_14
00?????????????";
CM_ SG_ 520 ARS_OD_DistXStd_Obj_14 "Longitudinal distance standard deviation of object_14
00???????????";
CM_ SG_ 520 ARS_OD_DistYStd_Obj_14 "Lateral distance standard deviation of object_14
00???????????";
CM_ SG_ 520 ARS_OD_VabsXStd_Obj_14 "Longitudinal absolution velocity standard deviation of object_14
00???????????????";
CM_ SG_ 520 ARS_OD_VabsYStd_Obj_14 "Lateral absolution velocity standard deviation of object_14
00???????????????";
CM_ SG_ 520 ARS_OD_AabsXStd_Obj_14 "Longitudinal absolution acceleration standard deviation of object_14
00????????????????";
CM_ SG_ 521 ARS_OD_DistX_Obj_16 "Longitudinal distance of object_16
00????????";
CM_ SG_ 521 ARS_OD_Classification_Obj_16 "Classification of object_16
00??????";
CM_ SG_ 521 ARS_OD_AabsYStd_Obj_16 "Lateral absolution acceleration standard deviation of object_16
00????????????????";
CM_ SG_ 521 ARS_OD_ClassConf_Obj_16 "Classification confidence of object_16
00?????????";
CM_ SG_ 521 ARS_OD_ProbOfExist_Obj_16 "Existence probability of object_16
00????????";
CM_ SG_ 521 ARS_OD_DynConf_Obj_16 "Dynamic property confidence of object_16
00???????????";
CM_ SG_ 521 ARS_OD_VabsX_Obj_16 "Longitudinal absolution velocity over ground of object_16
00????????????";
CM_ SG_ 521 ARS_OD_DynProp_Obj_16 "Dynamic property of object_16
00????????";
CM_ SG_ 521 ARS_OD_MirrorProb_Obj_16 "Mirror probability of object_16
00????????";
CM_ SG_ 521 ARS_OD_Length_Obj_16 "Length of object_16
00??????";
CM_ SG_ 521 ARS_OD_MaintenanceState_Obj_16 "Maintenance state of object_16
00????????";
CM_ SG_ 521 ARS_OD_Width_Obj_16 "Width of object_16
00??????";
CM_ SG_ 521 ARS_OD_RCS_Obj_16 "RCS of object_16
00?????????";
CM_ SG_ 521 ARS_OD_Orientation_Obj_16 "Orientation of object_16
00???????";
CM_ SG_ 521 ARS_OD_YawRateAbs_Obj_16 "Yaw rate of object_16
00?????????";
CM_ SG_ 521 ARS_OD_YawRateAbsStd_Obj_16 "Yaw rate standard deviation of object_16
00????????????";
CM_ SG_ 521 ARS_OD_RefPoint_Obj_16 "Reference point of object_16
00???????";
CM_ SG_ 521 ARS_OD_LifeCycle_Obj_16 "Life cycle of object_16
00????????";
CM_ SG_ 521 ARS_OD_AabsX_Obj_16 "Longitudinal absolution acceleration over ground of object_16
00?????????????";
CM_ SG_ 521 ARS_OD_DistY_Obj_16 "Lateral distance of object_16
00????????";
CM_ SG_ 521 ARS_OD_OrientationStd_Obj_16 "Orientation standard deviation of object_16
00??????????";
CM_ SG_ 521 ARS_OD_ObstacleProb_Obj_16 "Obstacle probability of object_16
00?????????";
CM_ SG_ 521 ARS_OD_MicroDopplerFlag_16 "Micro-Doppler flag of object_16
00???????????";
CM_ SG_ 521 ARS_OD_VabsY_Obj_16 "Lateral absolution velocity over ground of object_16
00????????????";
CM_ SG_ 521 ARS_OD_AabsY_Obj_16 "Lateral absolution acceleration over ground of object_16
00?????????????";
CM_ SG_ 521 ARS_OD_DistXStd_Obj_16 "Longitudinal distance standard deviation of object_16
00???????????";
CM_ SG_ 521 ARS_OD_DistYStd_Obj_16 "Lateral distance standard deviation of object_16
00???????????";
CM_ SG_ 521 ARS_OD_VabsXStd_Obj_16 "Longitudinal absolution velocity standard deviation of object_16
00???????????????";
CM_ SG_ 521 ARS_OD_VabsYStd_Obj_16 "Lateral absolution velocity standard deviation of object_16
00???????????????";
CM_ SG_ 521 ARS_OD_AabsXStd_Obj_16 "Longitudinal absolution acceleration standard deviation of object_16
00????????????????";
CM_ SG_ 522 ARS_OD_DistX_Obj_18 "Longitudinal distance of object_18
00????????";
CM_ SG_ 522 ARS_OD_Classification_Obj_18 "Classification of object_18
00??????";
CM_ SG_ 522 ARS_OD_AabsYStd_Obj_18 "Lateral absolution acceleration standard deviation of object_18
00????????????????";
CM_ SG_ 522 ARS_OD_ClassConf_Obj_18 "Classification confidence of object_18
00?????????";
CM_ SG_ 522 ARS_OD_ProbOfExist_Obj_18 "Existence probability of object_18
00????????";
CM_ SG_ 522 ARS_OD_DynConf_Obj_18 "Dynamic property confidence of object_18
00???????????";
CM_ SG_ 522 ARS_OD_VabsX_Obj_18 "Longitudinal absolution velocity over ground of object_18
00????????????";
CM_ SG_ 522 ARS_OD_DynProp_Obj_18 "Dynamic property of object_18
00????????";
CM_ SG_ 522 ARS_OD_MirrorProb_Obj_18 "Mirror probability of object_18
00????????";
CM_ SG_ 522 ARS_OD_Length_Obj_18 "Length of object_18
00??????";
CM_ SG_ 522 ARS_OD_MaintenanceState_Obj_18 "Maintenance state of object_18
00????????";
CM_ SG_ 522 ARS_OD_Width_Obj_18 "Width of object_18
00??????";
CM_ SG_ 522 ARS_OD_RCS_Obj_18 "RCS of object_18
00?????????";
CM_ SG_ 522 ARS_OD_Orientation_Obj_18 "Orientation of object_18
00???????";
CM_ SG_ 522 ARS_OD_YawRateAbs_Obj_18 "Yaw rate of object_18
00?????????";
CM_ SG_ 522 ARS_OD_YawRateAbsStd_Obj_18 "Yaw rate standard deviation of object_18
00????????????";
CM_ SG_ 522 ARS_OD_RefPoint_Obj_18 "Reference point of object_18
00???????";
CM_ SG_ 522 ARS_OD_LifeCycle_Obj_18 "Life cycle of object_18
00????????";
CM_ SG_ 522 ARS_OD_AabsX_Obj_18 "Longitudinal absolution acceleration over ground of object_18
00?????????????";
CM_ SG_ 522 ARS_OD_DistY_Obj_18 "Lateral distance of object_18
00????????";
CM_ SG_ 522 ARS_OD_OrientationStd_Obj_18 "Orientation standard deviation of object_18
00??????????";
CM_ SG_ 522 ARS_OD_ObstacleProb_Obj_18 "Obstacle probability of object_18
00?????????";
CM_ SG_ 522 ARS_OD_MicroDopplerFlag_18 "Micro-Doppler flag of object_18
00???????????";
CM_ SG_ 522 ARS_OD_VabsY_Obj_18 "Lateral absolution velocity over ground of object_18
00????????????";
CM_ SG_ 522 ARS_OD_AabsY_Obj_18 "Lateral absolution acceleration over ground of object_18
00?????????????";
CM_ SG_ 522 ARS_OD_DistXStd_Obj_18 "Longitudinal distance standard deviation of object_18
00???????????";
CM_ SG_ 522 ARS_OD_DistYStd_Obj_18 "Lateral distance standard deviation of object_18
00???????????";
CM_ SG_ 522 ARS_OD_VabsXStd_Obj_18 "Longitudinal absolution velocity standard deviation of object_18
00???????????????";
CM_ SG_ 522 ARS_OD_VabsYStd_Obj_18 "Lateral absolution velocity standard deviation of object_18
00???????????????";
CM_ SG_ 522 ARS_OD_AabsXStd_Obj_18 "Longitudinal absolution acceleration standard deviation of object_18
00????????????????";
CM_ SG_ 523 ARS_OD_DistX_Obj_20 "Longitudinal distance of object_20
00????????";
CM_ SG_ 523 ARS_OD_Classification_Obj_20 "Classification of object_20
00??????";
CM_ SG_ 523 ARS_OD_AabsYStd_Obj_20 "Lateral absolution acceleration standard deviation of object_20
00????????????????";
CM_ SG_ 523 ARS_OD_ClassConf_Obj_20 "Classification confidence of object_20
00?????????";
CM_ SG_ 523 ARS_OD_ProbOfExist_Obj_20 "Existence probability of object_20
00????????";
CM_ SG_ 523 ARS_OD_DynConf_Obj_20 "Dynamic property confidence of object_20
00???????????";
CM_ SG_ 523 ARS_OD_VabsX_Obj_20 "Longitudinal absolution velocity over ground of object_20
00????????????";
CM_ SG_ 523 ARS_OD_DynProp_Obj_20 "Dynamic property of object_20
00????????";
CM_ SG_ 523 ARS_OD_MirrorProb_Obj_20 "Mirror probability of object_20
00????????";
CM_ SG_ 523 ARS_OD_Length_Obj_20 "Length of object_20
00??????";
CM_ SG_ 523 ARS_OD_MaintenanceState_Obj_20 "Maintenance state of object_20
00????????";
CM_ SG_ 523 ARS_OD_Width_Obj_20 "Width of object_20
00??????";
CM_ SG_ 523 ARS_OD_RCS_Obj_20 "RCS of object_20
00?????????";
CM_ SG_ 523 ARS_OD_Orientation_Obj_20 "Orientation of object_20
00???????";
CM_ SG_ 523 ARS_OD_YawRateAbs_Obj_20 "Yaw rate of object_20
00?????????";
CM_ SG_ 523 ARS_OD_YawRateAbsStd_Obj_20 "Yaw rate standard deviation of object_20
00????????????";
CM_ SG_ 523 ARS_OD_RefPoint_Obj_20 "Reference point of object_20
00???????";
CM_ SG_ 523 ARS_OD_LifeCycle_Obj_20 "Life cycle of object_20
00????????";
CM_ SG_ 523 ARS_OD_AabsX_Obj_20 "Longitudinal absolution acceleration over ground of object_20
00?????????????";
CM_ SG_ 523 ARS_OD_DistY_Obj_20 "Lateral distance of object_20
00????????";
CM_ SG_ 523 ARS_OD_OrientationStd_Obj_20 "Orientation standard deviation of object_20
00??????????";
CM_ SG_ 523 ARS_OD_ObstacleProb_Obj_20 "Obstacle probability of object_20
00?????????";
CM_ SG_ 523 ARS_OD_MicroDopplerFlag_20 "Micro-Doppler flag of object_20
00???????????";
CM_ SG_ 523 ARS_OD_VabsY_Obj_20 "Lateral absolution velocity over ground of object_20
00????????????";
CM_ SG_ 523 ARS_OD_AabsY_Obj_20 "Lateral absolution acceleration over ground of object_20
00?????????????";
CM_ SG_ 523 ARS_OD_DistXStd_Obj_20 "Longitudinal distance standard deviation of object_20
00???????????";
CM_ SG_ 523 ARS_OD_DistYStd_Obj_20 "Lateral distance standard deviation of object_20
00???????????";
CM_ SG_ 523 ARS_OD_VabsXStd_Obj_20 "Longitudinal absolution velocity standard deviation of object_20
00???????????????";
CM_ SG_ 523 ARS_OD_VabsYStd_Obj_20 "Lateral absolution velocity standard deviation of object_20
00???????????????";
CM_ SG_ 523 ARS_OD_AabsXStd_Obj_20 "Longitudinal absolution acceleration standard deviation of object_20
00????????????????";
CM_ SG_ 524 ARS_OD_DistX_Obj_22 "Longitudinal distance of object_22
00????????";
CM_ SG_ 524 ARS_OD_Classification_Obj_22 "Classification of object_22
00??????";
CM_ SG_ 524 ARS_OD_AabsYStd_Obj_22 "Lateral absolution acceleration standard deviation of object_22
00????????????????";
CM_ SG_ 524 ARS_OD_ClassConf_Obj_22 "Classification confidence of object_22
00?????????";
CM_ SG_ 524 ARS_OD_ProbOfExist_Obj_22 "Existence probability of object_22
00????????";
CM_ SG_ 524 ARS_OD_DynConf_Obj_22 "Dynamic property confidence of object_22
00???????????";
CM_ SG_ 524 ARS_OD_VabsX_Obj_22 "Longitudinal absolution velocity over ground of object_22
00????????????";
CM_ SG_ 524 ARS_OD_DynProp_Obj_22 "Dynamic property of object_22
00????????";
CM_ SG_ 524 ARS_OD_MirrorProb_Obj_22 "Mirror probability of object_22
00????????";
CM_ SG_ 524 ARS_OD_Length_Obj_22 "Length of object_22
00??????";
CM_ SG_ 524 ARS_OD_MaintenanceState_Obj_22 "Maintenance state of object_22
00????????";
CM_ SG_ 524 ARS_OD_Width_Obj_22 "Width of object_22
00??????";
CM_ SG_ 524 ARS_OD_RCS_Obj_22 "RCS of object_22
00?????????";
CM_ SG_ 524 ARS_OD_Orientation_Obj_22 "Orientation of object_22
00???????";
CM_ SG_ 524 ARS_OD_YawRateAbs_Obj_22 "Yaw rate of object_22
00?????????";
CM_ SG_ 524 ARS_OD_YawRateAbsStd_Obj_22 "Yaw rate standard deviation of object_22
00????????????";
CM_ SG_ 524 ARS_OD_RefPoint_Obj_22 "Reference point of object_22
00???????";
CM_ SG_ 524 ARS_OD_LifeCycle_Obj_22 "Life cycle of object_22
00????????";
CM_ SG_ 524 ARS_OD_AabsX_Obj_22 "Longitudinal absolution acceleration over ground of object_22
00?????????????";
CM_ SG_ 524 ARS_OD_DistY_Obj_22 "Lateral distance of object_22
00????????";
CM_ SG_ 524 ARS_OD_OrientationStd_Obj_22 "Orientation standard deviation of object_22
00??????????";
CM_ SG_ 524 ARS_OD_ObstacleProb_Obj_22 "Obstacle probability of object_22
00?????????";
CM_ SG_ 524 ARS_OD_MicroDopplerFlag_22 "Micro-Doppler flag of object_22
00???????????";
CM_ SG_ 524 ARS_OD_VabsY_Obj_22 "Lateral absolution velocity over ground of object_22
00????????????";
CM_ SG_ 524 ARS_OD_AabsY_Obj_22 "Lateral absolution acceleration over ground of object_22
00?????????????";
CM_ SG_ 524 ARS_OD_DistXStd_Obj_22 "Longitudinal distance standard deviation of object_22
00???????????";
CM_ SG_ 524 ARS_OD_DistYStd_Obj_22 "Lateral distance standard deviation of object_22
00???????????";
CM_ SG_ 524 ARS_OD_VabsXStd_Obj_22 "Longitudinal absolution velocity standard deviation of object_22
00???????????????";
CM_ SG_ 524 ARS_OD_VabsYStd_Obj_22 "Lateral absolution velocity standard deviation of object_22
00???????????????";
CM_ SG_ 524 ARS_OD_AabsXStd_Obj_22 "Longitudinal absolution acceleration standard deviation of object_22
00????????????????";
CM_ SG_ 525 ARS_OD_DistX_Obj_24 "Longitudinal distance of object_24
00????????";
CM_ SG_ 525 ARS_OD_Classification_Obj_24 "Classification of object_24
00??????";
CM_ SG_ 525 ARS_OD_AabsYStd_Obj_24 "Lateral absolution acceleration standard deviation of object_24
00????????????????";
CM_ SG_ 525 ARS_OD_ClassConf_Obj_24 "Classification confidence of object_24
00?????????";
CM_ SG_ 525 ARS_OD_ProbOfExist_Obj_24 "Existence probability of object_24
00????????";
CM_ SG_ 525 ARS_OD_DynConf_Obj_24 "Dynamic property confidence of object_24
00???????????";
CM_ SG_ 525 ARS_OD_VabsX_Obj_24 "Longitudinal absolution velocity over ground of object_24
00????????????";
CM_ SG_ 525 ARS_OD_DynProp_Obj_24 "Dynamic property of object_24
00????????";
CM_ SG_ 525 ARS_OD_MirrorProb_Obj_24 "Mirror probability of object_24
00????????";
CM_ SG_ 525 ARS_OD_Length_Obj_24 "Length of object_24
00??????";
CM_ SG_ 525 ARS_OD_MaintenanceState_Obj_24 "Maintenance state of object_24
00????????";
CM_ SG_ 525 ARS_OD_Width_Obj_24 "Width of object_24
00??????";
CM_ SG_ 525 ARS_OD_RCS_Obj_24 "RCS of object_24
00?????????";
CM_ SG_ 525 ARS_OD_Orientation_Obj_24 "Orientation of object_24
00???????";
CM_ SG_ 525 ARS_OD_YawRateAbs_Obj_24 "Yaw rate of object_24
00?????????";
CM_ SG_ 525 ARS_OD_YawRateAbsStd_Obj_24 "Yaw rate standard deviation of object_24
00????????????";
CM_ SG_ 525 ARS_OD_RefPoint_Obj_24 "Reference point of object_24
00???????";
CM_ SG_ 525 ARS_OD_LifeCycle_Obj_24 "Life cycle of object_24
00????????";
CM_ SG_ 525 ARS_OD_AabsX_Obj_24 "Longitudinal absolution acceleration over ground of object_24
00?????????????";
CM_ SG_ 525 ARS_OD_DistY_Obj_24 "Lateral distance of object_24
00????????";
CM_ SG_ 525 ARS_OD_OrientationStd_Obj_24 "Orientation standard deviation of object_24
00??????????";
CM_ SG_ 525 ARS_OD_ObstacleProb_Obj_24 "Obstacle probability of object_24
00?????????";
CM_ SG_ 525 ARS_OD_MicroDopplerFlag_24 "Micro-Doppler flag of object_24
00???????????";
CM_ SG_ 525 ARS_OD_VabsY_Obj_24 "Lateral absolution velocity over ground of object_24
00????????????";
CM_ SG_ 525 ARS_OD_AabsY_Obj_24 "Lateral absolution acceleration over ground of object_24
00?????????????";
CM_ SG_ 525 ARS_OD_DistXStd_Obj_24 "Longitudinal distance standard deviation of object_24
00???????????";
CM_ SG_ 525 ARS_OD_DistYStd_Obj_24 "Lateral distance standard deviation of object_24
00???????????";
CM_ SG_ 525 ARS_OD_VabsXStd_Obj_24 "Longitudinal absolution velocity standard deviation of object_24
00???????????????";
CM_ SG_ 525 ARS_OD_VabsYStd_Obj_24 "Lateral absolution velocity standard deviation of object_24
00???????????????";
CM_ SG_ 525 ARS_OD_AabsXStd_Obj_24 "Longitudinal absolution acceleration standard deviation of object_24
00????????????????";
CM_ SG_ 526 ARS_OD_DistX_Obj_26 "Longitudinal distance of object_26
00????????";
CM_ SG_ 526 ARS_OD_Classification_Obj_26 "Classification of object_26
00??????";
CM_ SG_ 526 ARS_OD_AabsYStd_Obj_26 "Lateral absolution acceleration standard deviation of object_26
00????????????????";
CM_ SG_ 526 ARS_OD_ClassConf_Obj_26 "Classification confidence of object_26
00?????????";
CM_ SG_ 526 ARS_OD_ProbOfExist_Obj_26 "Existence probability of object_26
00????????";
CM_ SG_ 526 ARS_OD_DynConf_Obj_26 "Dynamic property confidence of object_26
00???????????";
CM_ SG_ 526 ARS_OD_VabsX_Obj_26 "Longitudinal absolution velocity over ground of object_26
00????????????";
CM_ SG_ 526 ARS_OD_DynProp_Obj_26 "Dynamic property of object_26
00????????";
CM_ SG_ 526 ARS_OD_MirrorProb_Obj_26 "Mirror probability of object_26
00????????";
CM_ SG_ 526 ARS_OD_Length_Obj_26 "Length of object_26
00??????";
CM_ SG_ 526 ARS_OD_MaintenanceState_Obj_26 "Maintenance state of object_26
00????????";
CM_ SG_ 526 ARS_OD_Width_Obj_26 "Width of object_26
00??????";
CM_ SG_ 526 ARS_OD_RCS_Obj_26 "RCS of object_26
00?????????";
CM_ SG_ 526 ARS_OD_Orientation_Obj_26 "Orientation of object_26
00???????";
CM_ SG_ 526 ARS_OD_YawRateAbs_Obj_26 "Yaw rate of object_26
00?????????";
CM_ SG_ 526 ARS_OD_YawRateAbsStd_Obj_26 "Yaw rate standard deviation of object_26
00????????????";
CM_ SG_ 526 ARS_OD_RefPoint_Obj_26 "Reference point of object_26
00???????";
CM_ SG_ 526 ARS_OD_LifeCycle_Obj_26 "Life cycle of object_26
00????????";
CM_ SG_ 526 ARS_OD_AabsX_Obj_26 "Longitudinal absolution acceleration over ground of object_26
00?????????????";
CM_ SG_ 526 ARS_OD_DistY_Obj_26 "Lateral distance of object_26
00????????";
CM_ SG_ 526 ARS_OD_OrientationStd_Obj_26 "Orientation standard deviation of object_26
00??????????";
CM_ SG_ 526 ARS_OD_ObstacleProb_Obj_26 "Obstacle probability of object_26
00?????????";
CM_ SG_ 526 ARS_OD_MicroDopplerFlag_26 "Micro-Doppler flag of object_26
00???????????";
CM_ SG_ 526 ARS_OD_VabsY_Obj_26 "Lateral absolution velocity over ground of object_26
00????????????";
CM_ SG_ 526 ARS_OD_AabsY_Obj_26 "Lateral absolution acceleration over ground of object_26
00?????????????";
CM_ SG_ 526 ARS_OD_DistXStd_Obj_26 "Longitudinal distance standard deviation of object_26
00???????????";
CM_ SG_ 526 ARS_OD_DistYStd_Obj_26 "Lateral distance standard deviation of object_26
00???????????";
CM_ SG_ 526 ARS_OD_VabsXStd_Obj_26 "Longitudinal absolution velocity standard deviation of object_26
00???????????????";
CM_ SG_ 526 ARS_OD_VabsYStd_Obj_26 "Lateral absolution velocity standard deviation of object_26
00???????????????";
CM_ SG_ 526 ARS_OD_AabsXStd_Obj_26 "Longitudinal absolution acceleration standard deviation of object_26
00????????????????";
BA_DEF_ BO_  "DiagRequest" ENUM  "no","yes";
BA_DEF_ BO_  "DiagResponse" ENUM  "no","yes";
BA_DEF_ BO_  "GenMsgCycleTime" INT 0 0;
BA_DEF_ BO_  "GenMsgSendType" ENUM  "Cyclic","NotUsed","Event","NotUsed","NotUsed","NotUsed","NotUsed","IfActive","NoMsgSendType","NotUsed";
BA_DEF_ BO_  "VFrameFormat" ENUM  "StandardCAN","ExtendedCAN","RESERVED","RESERVED","RESERVED","RESERVED","RESERVED","RESERVED","RESERVED","RESERVED","RESERVED","RESERVED","RESERVED","RESERVED","StandardCAN_FD","ExtendedCAN_FD";
BA_DEF_ SG_  "GenSigSendType" ENUM  "Cyclic","OnWrite","OnWriteWithRepetition","OnChange","OnChangeWithRepetition","IfActive","IfActiveWithRepetition","NoSigSendType","NotUsed","NotUsed","NotUsed","NotUsed","NotUsed";
BA_DEF_ SG_  "GenSigStartValue" INT 0 0;
BA_DEF_ SG_  "SystemSignalLongSymbol" STRING ;
BA_DEF_DEF_  "DiagRequest" "no";
BA_DEF_DEF_  "DiagResponse" "no";
BA_DEF_DEF_  "GenMsgCycleTime" 0;
BA_DEF_DEF_  "GenMsgSendType" "Cyclic";
BA_DEF_DEF_  "VFrameFormat" "ExtendedCAN_FD";
BA_DEF_DEF_  "GenSigSendType" "Cyclic";
BA_DEF_DEF_  "GenSigStartValue" 0;
BA_DEF_DEF_  "SystemSignalLongSymbol" "";
BA_ "GenMsgSendType" BO_ 307 2;
BA_ "VFrameFormat" BO_ 307 14;
BA_ "GenMsgSendType" BO_ 308 2;
BA_ "VFrameFormat" BO_ 308 14;
BA_ "GenMsgSendType" BO_ 309 2;
BA_ "VFrameFormat" BO_ 309 14;
BA_ "GenMsgSendType" BO_ 512 2;
BA_ "VFrameFormat" BO_ 512 14;
BA_ "GenMsgSendType" BO_ 513 2;
BA_ "VFrameFormat" BO_ 513 14;
BA_ "GenMsgSendType" BO_ 514 2;
BA_ "VFrameFormat" BO_ 514 14;
BA_ "GenMsgSendType" BO_ 515 2;
BA_ "VFrameFormat" BO_ 515 14;
BA_ "GenMsgSendType" BO_ 516 2;
BA_ "VFrameFormat" BO_ 516 14;
BA_ "GenMsgSendType" BO_ 517 2;
BA_ "VFrameFormat" BO_ 517 14;
BA_ "GenMsgSendType" BO_ 518 2;
BA_ "VFrameFormat" BO_ 518 14;
BA_ "GenMsgSendType" BO_ 519 2;
BA_ "VFrameFormat" BO_ 519 14;
BA_ "GenMsgSendType" BO_ 520 2;
BA_ "VFrameFormat" BO_ 520 14;
BA_ "GenMsgSendType" BO_ 521 2;
BA_ "VFrameFormat" BO_ 521 14;
BA_ "GenMsgSendType" BO_ 522 2;
BA_ "VFrameFormat" BO_ 522 14;
BA_ "GenMsgSendType" BO_ 523 2;
BA_ "VFrameFormat" BO_ 523 14;
BA_ "GenMsgSendType" BO_ 524 2;
BA_ "VFrameFormat" BO_ 524 14;
BA_ "GenMsgSendType" BO_ 525 2;
BA_ "VFrameFormat" BO_ 525 14;
BA_ "GenMsgSendType" BO_ 526 2;
BA_ "VFrameFormat" BO_ 526 14;
BA_ "GenSigStartValue" SG_ 307 ARS_RDI_ElevationAng_Clu_377 63;
BA_ "GenSigStartValue" SG_ 307 ARS_RDI_VradRel_Clu_376 1200;
BA_ "GenSigStartValue" SG_ 307 ARS_RDI_VradRel_Clu_378 1200;
BA_ "GenSigStartValue" SG_ 307 ARS_RDI_RCS_Clu_378 256;
BA_ "GenSigStartValue" SG_ 307 ARS_RDI_AzimuthAng_Clu_378 511;
BA_ "GenSigStartValue" SG_ 307 ARS_RDI_ElevationAng_Clu_378 63;
BA_ "GenSigStartValue" SG_ 307 ARS_RDI_VradRel_Clu_379 1200;
BA_ "GenSigStartValue" SG_ 307 ARS_RDI_RCS_Clu_379 256;
BA_ "GenSigStartValue" SG_ 307 ARS_RDI_AzimuthAng_Clu_379 511;
BA_ "GenSigStartValue" SG_ 307 ARS_RDI_ElevationAng_Clu_379 63;
BA_ "GenSigStartValue" SG_ 307 ARS_RDI_RCS_Clu_376 256;
BA_ "GenSigStartValue" SG_ 307 ARS_RDI_VradRel_Clu_380 1200;
BA_ "GenSigStartValue" SG_ 307 ARS_RDI_RCS_Clu_380 256;
BA_ "GenSigStartValue" SG_ 307 ARS_RDI_AzimuthAng_Clu_380 511;
BA_ "GenSigStartValue" SG_ 307 ARS_RDI_ElevationAng_Clu_380 63;
BA_ "GenSigStartValue" SG_ 307 ARS_RDI_VradRel_Clu_381 1200;
BA_ "GenSigStartValue" SG_ 307 ARS_RDI_RCS_Clu_381 256;
BA_ "GenSigStartValue" SG_ 307 ARS_RDI_AzimuthAng_Clu_376 511;
BA_ "GenSigStartValue" SG_ 307 ARS_RDI_AzimuthAng_Clu_381 511;
BA_ "GenSigStartValue" SG_ 307 ARS_RDI_ElevationAng_Clu_381 63;
BA_ "GenSigStartValue" SG_ 307 ARS_RDI_VradRel_Clu_382 1200;
BA_ "GenSigStartValue" SG_ 307 ARS_RDI_RCS_Clu_382 256;
BA_ "GenSigStartValue" SG_ 307 ARS_RDI_AzimuthAng_Clu_382 511;
BA_ "GenSigStartValue" SG_ 307 ARS_RDI_ElevationAng_Clu_382 63;
BA_ "GenSigStartValue" SG_ 307 ARS_RDI_ElevationAng_Clu_376 63;
BA_ "GenSigStartValue" SG_ 307 ARS_RDI_VradRel_Clu_383 1200;
BA_ "GenSigStartValue" SG_ 307 ARS_RDI_RCS_Clu_383 256;
BA_ "GenSigStartValue" SG_ 307 ARS_RDI_AzimuthAng_Clu_383 511;
BA_ "GenSigStartValue" SG_ 307 ARS_RDI_ElevationAng_Clu_383 63;
BA_ "SystemSignalLongSymbol" SG_ 307 ARS_RDI_CRC16_Checksum_Clu_376_3 "ARS_RDI_CRC16_Checksum_Clu_376_383";
BA_ "GenSigStartValue" SG_ 307 ARS_RDI_VradRel_Clu_377 1200;
BA_ "GenSigStartValue" SG_ 307 ARS_RDI_RCS_Clu_377 256;
BA_ "GenSigStartValue" SG_ 307 ARS_RDI_AzimuthAng_Clu_377 511;
BA_ "GenSigStartValue" SG_ 308 ARS_RDI_ElevationAng_Clu_385 63;
BA_ "GenSigStartValue" SG_ 308 ARS_RDI_VradRel_Clu_384 1200;
BA_ "GenSigStartValue" SG_ 308 ARS_RDI_VradRel_Clu_386 1200;
BA_ "GenSigStartValue" SG_ 308 ARS_RDI_RCS_Clu_386 256;
BA_ "GenSigStartValue" SG_ 308 ARS_RDI_AzimuthAng_Clu_386 511;
BA_ "GenSigStartValue" SG_ 308 ARS_RDI_ElevationAng_Clu_386 63;
BA_ "GenSigStartValue" SG_ 308 ARS_RDI_VradRel_Clu_387 1200;
BA_ "GenSigStartValue" SG_ 308 ARS_RDI_RCS_Clu_387 256;
BA_ "GenSigStartValue" SG_ 308 ARS_RDI_AzimuthAng_Clu_387 511;
BA_ "GenSigStartValue" SG_ 308 ARS_RDI_ElevationAng_Clu_387 63;
BA_ "GenSigStartValue" SG_ 308 ARS_RDI_RCS_Clu_384 256;
BA_ "GenSigStartValue" SG_ 308 ARS_RDI_VradRel_Clu_388 1200;
BA_ "GenSigStartValue" SG_ 308 ARS_RDI_RCS_Clu_388 256;
BA_ "GenSigStartValue" SG_ 308 ARS_RDI_AzimuthAng_Clu_388 511;
BA_ "GenSigStartValue" SG_ 308 ARS_RDI_ElevationAng_Clu_388 63;
BA_ "GenSigStartValue" SG_ 308 ARS_RDI_VradRel_Clu_389 1200;
BA_ "GenSigStartValue" SG_ 308 ARS_RDI_RCS_Clu_389 256;
BA_ "GenSigStartValue" SG_ 308 ARS_RDI_AzimuthAng_Clu_384 511;
BA_ "GenSigStartValue" SG_ 308 ARS_RDI_AzimuthAng_Clu_389 511;
BA_ "GenSigStartValue" SG_ 308 ARS_RDI_ElevationAng_Clu_389 63;
BA_ "GenSigStartValue" SG_ 308 ARS_RDI_VradRel_Clu_390 1200;
BA_ "GenSigStartValue" SG_ 308 ARS_RDI_RCS_Clu_390 256;
BA_ "GenSigStartValue" SG_ 308 ARS_RDI_AzimuthAng_Clu_390 511;
BA_ "GenSigStartValue" SG_ 308 ARS_RDI_ElevationAng_Clu_390 63;
BA_ "GenSigStartValue" SG_ 308 ARS_RDI_ElevationAng_Clu_384 63;
BA_ "GenSigStartValue" SG_ 308 ARS_RDI_VradRel_Clu_391 1200;
BA_ "GenSigStartValue" SG_ 308 ARS_RDI_RCS_Clu_391 256;
BA_ "GenSigStartValue" SG_ 308 ARS_RDI_AzimuthAng_Clu_391 511;
BA_ "GenSigStartValue" SG_ 308 ARS_RDI_ElevationAng_Clu_391 63;
BA_ "SystemSignalLongSymbol" SG_ 308 ARS_RDI_CRC16_Checksum_Clu_384_3 "ARS_RDI_CRC16_Checksum_Clu_384_391";
BA_ "GenSigStartValue" SG_ 308 ARS_RDI_VradRel_Clu_385 1200;
BA_ "GenSigStartValue" SG_ 308 ARS_RDI_RCS_Clu_385 256;
BA_ "GenSigStartValue" SG_ 308 ARS_RDI_AzimuthAng_Clu_385 511;
BA_ "GenSigStartValue" SG_ 309 ARS_RDI_ElevationAng_Clu_393 63;
BA_ "GenSigStartValue" SG_ 309 ARS_RDI_VradRel_Clu_392 1200;
BA_ "GenSigStartValue" SG_ 309 ARS_RDI_VradRel_Clu_394 1200;
BA_ "GenSigStartValue" SG_ 309 ARS_RDI_RCS_Clu_394 256;
BA_ "GenSigStartValue" SG_ 309 ARS_RDI_AzimuthAng_Clu_394 511;
BA_ "GenSigStartValue" SG_ 309 ARS_RDI_ElevationAng_Clu_394 63;
BA_ "GenSigStartValue" SG_ 309 ARS_RDI_VradRel_Clu_395 1200;
BA_ "GenSigStartValue" SG_ 309 ARS_RDI_RCS_Clu_395 256;
BA_ "GenSigStartValue" SG_ 309 ARS_RDI_AzimuthAng_Clu_395 511;
BA_ "GenSigStartValue" SG_ 309 ARS_RDI_ElevationAng_Clu_395 63;
BA_ "GenSigStartValue" SG_ 309 ARS_RDI_RCS_Clu_392 256;
BA_ "GenSigStartValue" SG_ 309 ARS_RDI_VradRel_Clu_396 1200;
BA_ "GenSigStartValue" SG_ 309 ARS_RDI_RCS_Clu_396 256;
BA_ "GenSigStartValue" SG_ 309 ARS_RDI_AzimuthAng_Clu_396 511;
BA_ "GenSigStartValue" SG_ 309 ARS_RDI_ElevationAng_Clu_396 63;
BA_ "GenSigStartValue" SG_ 309 ARS_RDI_VradRel_Clu_397 1200;
BA_ "GenSigStartValue" SG_ 309 ARS_RDI_RCS_Clu_397 256;
BA_ "GenSigStartValue" SG_ 309 ARS_RDI_AzimuthAng_Clu_392 511;
BA_ "GenSigStartValue" SG_ 309 ARS_RDI_AzimuthAng_Clu_397 511;
BA_ "GenSigStartValue" SG_ 309 ARS_RDI_ElevationAng_Clu_397 63;
BA_ "GenSigStartValue" SG_ 309 ARS_RDI_VradRel_Clu_398 1200;
BA_ "GenSigStartValue" SG_ 309 ARS_RDI_RCS_Clu_398 256;
BA_ "GenSigStartValue" SG_ 309 ARS_RDI_AzimuthAng_Clu_398 511;
BA_ "GenSigStartValue" SG_ 309 ARS_RDI_ElevationAng_Clu_398 63;
BA_ "GenSigStartValue" SG_ 309 ARS_RDI_ElevationAng_Clu_392 63;
BA_ "GenSigStartValue" SG_ 309 ARS_RDI_VradRel_Clu_399 1200;
BA_ "GenSigStartValue" SG_ 309 ARS_RDI_RCS_Clu_399 256;
BA_ "GenSigStartValue" SG_ 309 ARS_RDI_AzimuthAng_Clu_399 511;
BA_ "GenSigStartValue" SG_ 309 ARS_RDI_ElevationAng_Clu_399 63;
BA_ "SystemSignalLongSymbol" SG_ 309 ARS_RDI_CRC16_Checksum_Clu_392_3 "ARS_RDI_CRC16_Checksum_Clu_392_399";
BA_ "GenSigStartValue" SG_ 309 ARS_RDI_VradRel_Clu_393 1200;
BA_ "GenSigStartValue" SG_ 309 ARS_RDI_RCS_Clu_393 256;
BA_ "GenSigStartValue" SG_ 309 ARS_RDI_AzimuthAng_Clu_393 511;
BA_ "GenSigStartValue" SG_ 512 ARS_OD_EgoVelocity 340;
BA_ "GenSigStartValue" SG_ 512 ARS_OD_EgoYawRate 511;
BA_ "GenSigStartValue" SG_ 512 ARS_OD_EgoAcceleration 160;
BA_ "GenSigStartValue" SG_ 512 ARS_OD_EgoCurvature 511;
BA_ "GenSigStartValue" SG_ 513 ARS_OD_DistX_Obj_00 1143;
BA_ "GenSigStartValue" SG_ 513 ARS_OD_VabsX_Obj_00 1024;
BA_ "GenSigStartValue" SG_ 513 ARS_OD_RCS_Obj_00 256;
BA_ "GenSigStartValue" SG_ 513 ARS_OD_Orientation_Obj_00 511;
BA_ "GenSigStartValue" SG_ 513 ARS_OD_YawRateAbs_Obj_00 511;
BA_ "GenSigStartValue" SG_ 513 ARS_OD_DistX_Obj_01 1143;
BA_ "GenSigStartValue" SG_ 513 ARS_OD_VabsX_Obj_01 1024;
BA_ "GenSigStartValue" SG_ 513 ARS_OD_AabsX_Obj_01 255;
BA_ "GenSigStartValue" SG_ 513 ARS_OD_AabsX_Obj_00 255;
BA_ "GenSigStartValue" SG_ 513 ARS_OD_DistY_Obj_01 2047;
BA_ "GenSigStartValue" SG_ 513 ARS_OD_VabsY_Obj_01 1024;
BA_ "GenSigStartValue" SG_ 513 ARS_OD_AabsY_Obj_01 255;
BA_ "GenSigStartValue" SG_ 513 ARS_OD_DistY_Obj_00 2047;
BA_ "GenSigStartValue" SG_ 513 ARS_OD_RCS_Obj_01 256;
BA_ "GenSigStartValue" SG_ 513 ARS_OD_Orientation_Obj_01 511;
BA_ "GenSigStartValue" SG_ 513 ARS_OD_YawRateAbs_Obj_01 511;
BA_ "GenSigStartValue" SG_ 513 ARS_OD_VabsY_Obj_00 1024;
BA_ "GenSigStartValue" SG_ 513 ARS_OD_ID_00 255;
BA_ "GenSigStartValue" SG_ 513 ARS_OD_ID_01 255;
BA_ "GenSigStartValue" SG_ 513 ARS_OD_AabsY_Obj_00 255;
BA_ "GenSigStartValue" SG_ 514 ARS_OD_DistX_Obj_02 1143;
BA_ "GenSigStartValue" SG_ 514 ARS_OD_VabsX_Obj_02 1024;
BA_ "GenSigStartValue" SG_ 514 ARS_OD_RCS_Obj_02 256;
BA_ "GenSigStartValue" SG_ 514 ARS_OD_Orientation_Obj_02 511;
BA_ "GenSigStartValue" SG_ 514 ARS_OD_YawRateAbs_Obj_02 511;
BA_ "GenSigStartValue" SG_ 514 ARS_OD_DistX_Obj_03 1143;
BA_ "GenSigStartValue" SG_ 514 ARS_OD_VabsX_Obj_03 1024;
BA_ "GenSigStartValue" SG_ 514 ARS_OD_AabsX_Obj_03 255;
BA_ "GenSigStartValue" SG_ 514 ARS_OD_AabsX_Obj_02 255;
BA_ "GenSigStartValue" SG_ 514 ARS_OD_DistY_Obj_03 2047;
BA_ "GenSigStartValue" SG_ 514 ARS_OD_VabsY_Obj_03 1024;
BA_ "GenSigStartValue" SG_ 514 ARS_OD_AabsY_Obj_03 255;
BA_ "GenSigStartValue" SG_ 514 ARS_OD_DistY_Obj_02 2047;
BA_ "GenSigStartValue" SG_ 514 ARS_OD_RCS_Obj_03 256;
BA_ "GenSigStartValue" SG_ 514 ARS_OD_Orientation_Obj_03 511;
BA_ "GenSigStartValue" SG_ 514 ARS_OD_YawRateAbs_Obj_03 511;
BA_ "GenSigStartValue" SG_ 514 ARS_OD_VabsY_Obj_02 1024;
BA_ "GenSigStartValue" SG_ 514 ARS_OD_ID_02 255;
BA_ "GenSigStartValue" SG_ 514 ARS_OD_ID_03 255;
BA_ "GenSigStartValue" SG_ 514 ARS_OD_AabsY_Obj_02 255;
BA_ "GenSigStartValue" SG_ 515 ARS_OD_DistX_Obj_04 1143;
BA_ "GenSigStartValue" SG_ 515 ARS_OD_VabsX_Obj_04 1024;
BA_ "GenSigStartValue" SG_ 515 ARS_OD_RCS_Obj_04 256;
BA_ "GenSigStartValue" SG_ 515 ARS_OD_Orientation_Obj_04 511;
BA_ "GenSigStartValue" SG_ 515 ARS_OD_YawRateAbs_Obj_04 511;
BA_ "GenSigStartValue" SG_ 515 ARS_OD_DistX_Obj_05 1143;
BA_ "GenSigStartValue" SG_ 515 ARS_OD_VabsX_Obj_05 1024;
BA_ "GenSigStartValue" SG_ 515 ARS_OD_AabsX_Obj_05 255;
BA_ "GenSigStartValue" SG_ 515 ARS_OD_AabsX_Obj_04 255;
BA_ "GenSigStartValue" SG_ 515 ARS_OD_DistY_Obj_05 2047;
BA_ "GenSigStartValue" SG_ 515 ARS_OD_VabsY_Obj_05 1024;
BA_ "GenSigStartValue" SG_ 515 ARS_OD_AabsY_Obj_05 255;
BA_ "GenSigStartValue" SG_ 515 ARS_OD_DistY_Obj_04 2047;
BA_ "GenSigStartValue" SG_ 515 ARS_OD_RCS_Obj_05 256;
BA_ "GenSigStartValue" SG_ 515 ARS_OD_Orientation_Obj_05 511;
BA_ "GenSigStartValue" SG_ 515 ARS_OD_YawRateAbs_Obj_05 511;
BA_ "GenSigStartValue" SG_ 515 ARS_OD_VabsY_Obj_04 1024;
BA_ "GenSigStartValue" SG_ 515 ARS_OD_ID_04 255;
BA_ "GenSigStartValue" SG_ 515 ARS_OD_ID_05 255;
BA_ "GenSigStartValue" SG_ 515 ARS_OD_AabsY_Obj_04 255;
BA_ "GenSigStartValue" SG_ 516 ARS_OD_DistX_Obj_06 1143;
BA_ "GenSigStartValue" SG_ 516 ARS_OD_VabsX_Obj_06 1024;
BA_ "GenSigStartValue" SG_ 516 ARS_OD_RCS_Obj_06 256;
BA_ "GenSigStartValue" SG_ 516 ARS_OD_Orientation_Obj_06 511;
BA_ "GenSigStartValue" SG_ 516 ARS_OD_YawRateAbs_Obj_06 511;
BA_ "GenSigStartValue" SG_ 516 ARS_OD_DistX_Obj_07 1143;
BA_ "GenSigStartValue" SG_ 516 ARS_OD_VabsX_Obj_07 1024;
BA_ "GenSigStartValue" SG_ 516 ARS_OD_AabsX_Obj_07 255;
BA_ "GenSigStartValue" SG_ 516 ARS_OD_AabsX_Obj_06 255;
BA_ "GenSigStartValue" SG_ 516 ARS_OD_DistY_Obj_07 2047;
BA_ "GenSigStartValue" SG_ 516 ARS_OD_VabsY_Obj_07 1024;
BA_ "GenSigStartValue" SG_ 516 ARS_OD_AabsY_Obj_07 255;
BA_ "GenSigStartValue" SG_ 516 ARS_OD_DistY_Obj_06 2047;
BA_ "GenSigStartValue" SG_ 516 ARS_OD_RCS_Obj_07 256;
BA_ "GenSigStartValue" SG_ 516 ARS_OD_Orientation_Obj_07 511;
BA_ "GenSigStartValue" SG_ 516 ARS_OD_YawRateAbs_Obj_07 511;
BA_ "GenSigStartValue" SG_ 516 ARS_OD_VabsY_Obj_06 1024;
BA_ "GenSigStartValue" SG_ 516 ARS_OD_ID_06 255;
BA_ "GenSigStartValue" SG_ 516 ARS_OD_ID_07 255;
BA_ "GenSigStartValue" SG_ 516 ARS_OD_AabsY_Obj_06 255;
BA_ "GenSigStartValue" SG_ 517 ARS_OD_DistX_Obj_08 1143;
BA_ "GenSigStartValue" SG_ 517 ARS_OD_VabsX_Obj_08 1024;
BA_ "GenSigStartValue" SG_ 517 ARS_OD_RCS_Obj_08 256;
BA_ "GenSigStartValue" SG_ 517 ARS_OD_Orientation_Obj_08 511;
BA_ "GenSigStartValue" SG_ 517 ARS_OD_YawRateAbs_Obj_08 511;
BA_ "GenSigStartValue" SG_ 517 ARS_OD_DistX_Obj_09 1143;
BA_ "GenSigStartValue" SG_ 517 ARS_OD_VabsX_Obj_09 1024;
BA_ "GenSigStartValue" SG_ 517 ARS_OD_AabsX_Obj_09 255;
BA_ "GenSigStartValue" SG_ 517 ARS_OD_AabsX_Obj_08 255;
BA_ "GenSigStartValue" SG_ 517 ARS_OD_DistY_Obj_09 2047;
BA_ "GenSigStartValue" SG_ 517 ARS_OD_VabsY_Obj_09 1024;
BA_ "GenSigStartValue" SG_ 517 ARS_OD_AabsY_Obj_09 255;
BA_ "GenSigStartValue" SG_ 517 ARS_OD_DistY_Obj_08 2047;
BA_ "GenSigStartValue" SG_ 517 ARS_OD_RCS_Obj_09 256;
BA_ "GenSigStartValue" SG_ 517 ARS_OD_Orientation_Obj_09 511;
BA_ "GenSigStartValue" SG_ 517 ARS_OD_YawRateAbs_Obj_09 511;
BA_ "GenSigStartValue" SG_ 517 ARS_OD_VabsY_Obj_08 1024;
BA_ "GenSigStartValue" SG_ 517 ARS_OD_ID_08 255;
BA_ "GenSigStartValue" SG_ 517 ARS_OD_ID_09 255;
BA_ "GenSigStartValue" SG_ 517 ARS_OD_AabsY_Obj_08 255;
BA_ "GenSigStartValue" SG_ 518 ARS_OD_DistX_Obj_10 1143;
BA_ "GenSigStartValue" SG_ 518 ARS_OD_VabsX_Obj_10 1024;
BA_ "GenSigStartValue" SG_ 518 ARS_OD_RCS_Obj_10 256;
BA_ "GenSigStartValue" SG_ 518 ARS_OD_Orientation_Obj_10 511;
BA_ "GenSigStartValue" SG_ 518 ARS_OD_YawRateAbs_Obj_10 511;
BA_ "GenSigStartValue" SG_ 518 ARS_OD_DistX_Obj_11 1143;
BA_ "GenSigStartValue" SG_ 518 ARS_OD_VabsX_Obj_11 1024;
BA_ "GenSigStartValue" SG_ 518 ARS_OD_AabsX_Obj_11 255;
BA_ "GenSigStartValue" SG_ 518 ARS_OD_AabsX_Obj_10 255;
BA_ "GenSigStartValue" SG_ 518 ARS_OD_DistY_Obj_11 2047;
BA_ "GenSigStartValue" SG_ 518 ARS_OD_VabsY_Obj_11 1024;
BA_ "GenSigStartValue" SG_ 518 ARS_OD_AabsY_Obj_11 255;
BA_ "GenSigStartValue" SG_ 518 ARS_OD_DistY_Obj_10 2047;
BA_ "GenSigStartValue" SG_ 518 ARS_OD_RCS_Obj_11 256;
BA_ "GenSigStartValue" SG_ 518 ARS_OD_Orientation_Obj_11 511;
BA_ "GenSigStartValue" SG_ 518 ARS_OD_YawRateAbs_Obj_11 511;
BA_ "GenSigStartValue" SG_ 518 ARS_OD_VabsY_Obj_10 1024;
BA_ "GenSigStartValue" SG_ 518 ARS_OD_ID_10 255;
BA_ "GenSigStartValue" SG_ 518 ARS_OD_ID_11 255;
BA_ "GenSigStartValue" SG_ 518 ARS_OD_AabsY_Obj_10 255;
BA_ "GenSigStartValue" SG_ 519 ARS_OD_DistX_Obj_12 1143;
BA_ "GenSigStartValue" SG_ 519 ARS_OD_VabsX_Obj_12 1024;
BA_ "GenSigStartValue" SG_ 519 ARS_OD_RCS_Obj_12 256;
BA_ "GenSigStartValue" SG_ 519 ARS_OD_Orientation_Obj_12 511;
BA_ "GenSigStartValue" SG_ 519 ARS_OD_YawRateAbs_Obj_12 511;
BA_ "GenSigStartValue" SG_ 519 ARS_OD_DistX_Obj_13 1143;
BA_ "GenSigStartValue" SG_ 519 ARS_OD_VabsX_Obj_13 1024;
BA_ "GenSigStartValue" SG_ 519 ARS_OD_AabsX_Obj_13 255;
BA_ "GenSigStartValue" SG_ 519 ARS_OD_AabsX_Obj_12 255;
BA_ "GenSigStartValue" SG_ 519 ARS_OD_DistY_Obj_13 2047;
BA_ "GenSigStartValue" SG_ 519 ARS_OD_VabsY_Obj_13 1024;
BA_ "GenSigStartValue" SG_ 519 ARS_OD_AabsY_Obj_13 255;
BA_ "GenSigStartValue" SG_ 519 ARS_OD_DistY_Obj_12 2047;
BA_ "GenSigStartValue" SG_ 519 ARS_OD_RCS_Obj_13 256;
BA_ "GenSigStartValue" SG_ 519 ARS_OD_Orientation_Obj_13 511;
BA_ "GenSigStartValue" SG_ 519 ARS_OD_YawRateAbs_Obj_13 511;
BA_ "GenSigStartValue" SG_ 519 ARS_OD_VabsY_Obj_12 1024;
BA_ "GenSigStartValue" SG_ 519 ARS_OD_ID_12 255;
BA_ "GenSigStartValue" SG_ 519 ARS_OD_ID_13 255;
BA_ "GenSigStartValue" SG_ 519 ARS_OD_AabsY_Obj_12 255;
BA_ "GenSigStartValue" SG_ 520 ARS_OD_DistX_Obj_14 1143;
BA_ "GenSigStartValue" SG_ 520 ARS_OD_VabsX_Obj_14 1024;
BA_ "GenSigStartValue" SG_ 520 ARS_OD_RCS_Obj_14 256;
BA_ "GenSigStartValue" SG_ 520 ARS_OD_Orientation_Obj_14 511;
BA_ "GenSigStartValue" SG_ 520 ARS_OD_YawRateAbs_Obj_14 511;
BA_ "GenSigStartValue" SG_ 520 ARS_OD_DistX_Obj_15 1143;
BA_ "GenSigStartValue" SG_ 520 ARS_OD_VabsX_Obj_15 1024;
BA_ "GenSigStartValue" SG_ 520 ARS_OD_AabsX_Obj_15 255;
BA_ "GenSigStartValue" SG_ 520 ARS_OD_AabsX_Obj_14 255;
BA_ "GenSigStartValue" SG_ 520 ARS_OD_DistY_Obj_15 2047;
BA_ "GenSigStartValue" SG_ 520 ARS_OD_VabsY_Obj_15 1024;
BA_ "GenSigStartValue" SG_ 520 ARS_OD_AabsY_Obj_15 255;
BA_ "GenSigStartValue" SG_ 520 ARS_OD_DistY_Obj_14 2047;
BA_ "GenSigStartValue" SG_ 520 ARS_OD_RCS_Obj_15 256;
BA_ "GenSigStartValue" SG_ 520 ARS_OD_Orientation_Obj_15 511;
BA_ "GenSigStartValue" SG_ 520 ARS_OD_YawRateAbs_Obj_15 511;
BA_ "GenSigStartValue" SG_ 520 ARS_OD_VabsY_Obj_14 1024;
BA_ "GenSigStartValue" SG_ 520 ARS_OD_ID_14 255;
BA_ "GenSigStartValue" SG_ 520 ARS_OD_ID_15 255;
BA_ "GenSigStartValue" SG_ 520 ARS_OD_AabsY_Obj_14 255;
BA_ "GenSigStartValue" SG_ 521 ARS_OD_DistX_Obj_16 1143;
BA_ "GenSigStartValue" SG_ 521 ARS_OD_VabsX_Obj_16 1024;
BA_ "GenSigStartValue" SG_ 521 ARS_OD_RCS_Obj_16 256;
BA_ "GenSigStartValue" SG_ 521 ARS_OD_Orientation_Obj_16 511;
BA_ "GenSigStartValue" SG_ 521 ARS_OD_YawRateAbs_Obj_16 511;
BA_ "GenSigStartValue" SG_ 521 ARS_OD_DistX_Obj_17 1143;
BA_ "GenSigStartValue" SG_ 521 ARS_OD_VabsX_Obj_17 1024;
BA_ "GenSigStartValue" SG_ 521 ARS_OD_AabsX_Obj_17 255;
BA_ "GenSigStartValue" SG_ 521 ARS_OD_AabsX_Obj_16 255;
BA_ "GenSigStartValue" SG_ 521 ARS_OD_DistY_Obj_17 2047;
BA_ "GenSigStartValue" SG_ 521 ARS_OD_VabsY_Obj_17 1024;
BA_ "GenSigStartValue" SG_ 521 ARS_OD_AabsY_Obj_17 255;
BA_ "GenSigStartValue" SG_ 521 ARS_OD_DistY_Obj_16 2047;
BA_ "GenSigStartValue" SG_ 521 ARS_OD_RCS_Obj_17 256;
BA_ "GenSigStartValue" SG_ 521 ARS_OD_Orientation_Obj_17 511;
BA_ "GenSigStartValue" SG_ 521 ARS_OD_YawRateAbs_Obj_17 511;
BA_ "GenSigStartValue" SG_ 521 ARS_OD_VabsY_Obj_16 1024;
BA_ "GenSigStartValue" SG_ 521 ARS_OD_ID_16 255;
BA_ "GenSigStartValue" SG_ 521 ARS_OD_ID_17 255;
BA_ "GenSigStartValue" SG_ 521 ARS_OD_AabsY_Obj_16 255;
BA_ "GenSigStartValue" SG_ 522 ARS_OD_DistX_Obj_18 1143;
BA_ "GenSigStartValue" SG_ 522 ARS_OD_VabsX_Obj_18 1024;
BA_ "GenSigStartValue" SG_ 522 ARS_OD_RCS_Obj_18 256;
BA_ "GenSigStartValue" SG_ 522 ARS_OD_Orientation_Obj_18 511;
BA_ "GenSigStartValue" SG_ 522 ARS_OD_YawRateAbs_Obj_18 511;
BA_ "GenSigStartValue" SG_ 522 ARS_OD_DistX_Obj_19 1143;
BA_ "GenSigStartValue" SG_ 522 ARS_OD_VabsX_Obj_19 1024;
BA_ "GenSigStartValue" SG_ 522 ARS_OD_AabsX_Obj_19 255;
BA_ "GenSigStartValue" SG_ 522 ARS_OD_AabsX_Obj_18 255;
BA_ "GenSigStartValue" SG_ 522 ARS_OD_DistY_Obj_19 2047;
BA_ "GenSigStartValue" SG_ 522 ARS_OD_VabsY_Obj_19 1024;
BA_ "GenSigStartValue" SG_ 522 ARS_OD_AabsY_Obj_19 255;
BA_ "GenSigStartValue" SG_ 522 ARS_OD_DistY_Obj_18 2047;
BA_ "GenSigStartValue" SG_ 522 ARS_OD_RCS_Obj_19 256;
BA_ "GenSigStartValue" SG_ 522 ARS_OD_Orientation_Obj_19 511;
BA_ "GenSigStartValue" SG_ 522 ARS_OD_YawRateAbs_Obj_19 511;
BA_ "GenSigStartValue" SG_ 522 ARS_OD_VabsY_Obj_18 1024;
BA_ "GenSigStartValue" SG_ 522 ARS_OD_ID_18 255;
BA_ "GenSigStartValue" SG_ 522 ARS_OD_ID_19 255;
BA_ "GenSigStartValue" SG_ 522 ARS_OD_AabsY_Obj_18 255;
BA_ "GenSigStartValue" SG_ 523 ARS_OD_DistX_Obj_20 1143;
BA_ "GenSigStartValue" SG_ 523 ARS_OD_VabsX_Obj_20 1024;
BA_ "GenSigStartValue" SG_ 523 ARS_OD_RCS_Obj_20 256;
BA_ "GenSigStartValue" SG_ 523 ARS_OD_Orientation_Obj_20 511;
BA_ "GenSigStartValue" SG_ 523 ARS_OD_YawRateAbs_Obj_20 511;
BA_ "GenSigStartValue" SG_ 523 ARS_OD_DistX_Obj_21 1143;
BA_ "GenSigStartValue" SG_ 523 ARS_OD_VabsX_Obj_21 1024;
BA_ "GenSigStartValue" SG_ 523 ARS_OD_AabsX_Obj_21 255;
BA_ "GenSigStartValue" SG_ 523 ARS_OD_AabsX_Obj_20 255;
BA_ "GenSigStartValue" SG_ 523 ARS_OD_DistY_Obj_21 2047;
BA_ "GenSigStartValue" SG_ 523 ARS_OD_VabsY_Obj_21 1024;
BA_ "GenSigStartValue" SG_ 523 ARS_OD_AabsY_Obj_21 255;
BA_ "GenSigStartValue" SG_ 523 ARS_OD_DistY_Obj_20 2047;
BA_ "GenSigStartValue" SG_ 523 ARS_OD_RCS_Obj_21 256;
BA_ "GenSigStartValue" SG_ 523 ARS_OD_Orientation_Obj_21 511;
BA_ "GenSigStartValue" SG_ 523 ARS_OD_YawRateAbs_Obj_21 511;
BA_ "GenSigStartValue" SG_ 523 ARS_OD_VabsY_Obj_20 1024;
BA_ "GenSigStartValue" SG_ 523 ARS_OD_ID_20 255;
BA_ "GenSigStartValue" SG_ 523 ARS_OD_ID_21 255;
BA_ "GenSigStartValue" SG_ 523 ARS_OD_AabsY_Obj_20 255;
BA_ "GenSigStartValue" SG_ 524 ARS_OD_DistX_Obj_22 1143;
BA_ "GenSigStartValue" SG_ 524 ARS_OD_VabsX_Obj_22 1024;
BA_ "GenSigStartValue" SG_ 524 ARS_OD_RCS_Obj_22 256;
BA_ "GenSigStartValue" SG_ 524 ARS_OD_Orientation_Obj_22 511;
BA_ "GenSigStartValue" SG_ 524 ARS_OD_YawRateAbs_Obj_22 511;
BA_ "GenSigStartValue" SG_ 524 ARS_OD_DistX_Obj_23 1143;
BA_ "GenSigStartValue" SG_ 524 ARS_OD_VabsX_Obj_23 1024;
BA_ "GenSigStartValue" SG_ 524 ARS_OD_AabsX_Obj_23 255;
BA_ "GenSigStartValue" SG_ 524 ARS_OD_AabsX_Obj_22 255;
BA_ "GenSigStartValue" SG_ 524 ARS_OD_DistY_Obj_23 2047;
BA_ "GenSigStartValue" SG_ 524 ARS_OD_VabsY_Obj_23 1024;
BA_ "GenSigStartValue" SG_ 524 ARS_OD_AabsY_Obj_23 255;
BA_ "GenSigStartValue" SG_ 524 ARS_OD_DistY_Obj_22 2047;
BA_ "GenSigStartValue" SG_ 524 ARS_OD_RCS_Obj_23 256;
BA_ "GenSigStartValue" SG_ 524 ARS_OD_Orientation_Obj_23 511;
BA_ "GenSigStartValue" SG_ 524 ARS_OD_YawRateAbs_Obj_23 511;
BA_ "GenSigStartValue" SG_ 524 ARS_OD_VabsY_Obj_22 1024;
BA_ "GenSigStartValue" SG_ 524 ARS_OD_ID_22 255;
BA_ "GenSigStartValue" SG_ 524 ARS_OD_ID_23 255;
BA_ "GenSigStartValue" SG_ 524 ARS_OD_AabsY_Obj_22 255;
BA_ "GenSigStartValue" SG_ 525 ARS_OD_DistX_Obj_24 1143;
BA_ "GenSigStartValue" SG_ 525 ARS_OD_VabsX_Obj_24 1024;
BA_ "GenSigStartValue" SG_ 525 ARS_OD_RCS_Obj_24 256;
BA_ "GenSigStartValue" SG_ 525 ARS_OD_Orientation_Obj_24 511;
BA_ "GenSigStartValue" SG_ 525 ARS_OD_YawRateAbs_Obj_24 511;
BA_ "GenSigStartValue" SG_ 525 ARS_OD_DistX_Obj_25 1143;
BA_ "GenSigStartValue" SG_ 525 ARS_OD_VabsX_Obj_25 1024;
BA_ "GenSigStartValue" SG_ 525 ARS_OD_AabsX_Obj_25 255;
BA_ "GenSigStartValue" SG_ 525 ARS_OD_AabsX_Obj_24 255;
BA_ "GenSigStartValue" SG_ 525 ARS_OD_DistY_Obj_25 2047;
BA_ "GenSigStartValue" SG_ 525 ARS_OD_VabsY_Obj_25 1024;
BA_ "GenSigStartValue" SG_ 525 ARS_OD_AabsY_Obj_25 255;
BA_ "GenSigStartValue" SG_ 525 ARS_OD_DistY_Obj_24 2047;
BA_ "GenSigStartValue" SG_ 525 ARS_OD_RCS_Obj_25 256;
BA_ "GenSigStartValue" SG_ 525 ARS_OD_Orientation_Obj_25 511;
BA_ "GenSigStartValue" SG_ 525 ARS_OD_YawRateAbs_Obj_25 511;
BA_ "GenSigStartValue" SG_ 525 ARS_OD_VabsY_Obj_24 1024;
BA_ "GenSigStartValue" SG_ 525 ARS_OD_ID_24 255;
BA_ "GenSigStartValue" SG_ 525 ARS_OD_ID_25 255;
BA_ "GenSigStartValue" SG_ 525 ARS_OD_AabsY_Obj_24 255;
BA_ "GenSigStartValue" SG_ 526 ARS_OD_DistX_Obj_26 1143;
BA_ "GenSigStartValue" SG_ 526 ARS_OD_VabsX_Obj_26 1024;
BA_ "GenSigStartValue" SG_ 526 ARS_OD_RCS_Obj_26 256;
BA_ "GenSigStartValue" SG_ 526 ARS_OD_Orientation_Obj_26 511;
BA_ "GenSigStartValue" SG_ 526 ARS_OD_YawRateAbs_Obj_26 511;
BA_ "GenSigStartValue" SG_ 526 ARS_OD_DistX_Obj_27 1143;
BA_ "GenSigStartValue" SG_ 526 ARS_OD_VabsX_Obj_27 1024;
BA_ "GenSigStartValue" SG_ 526 ARS_OD_AabsX_Obj_27 255;
BA_ "GenSigStartValue" SG_ 526 ARS_OD_AabsX_Obj_26 255;
BA_ "GenSigStartValue" SG_ 526 ARS_OD_DistY_Obj_27 2047;
BA_ "GenSigStartValue" SG_ 526 ARS_OD_VabsY_Obj_27 1024;
BA_ "GenSigStartValue" SG_ 526 ARS_OD_AabsY_Obj_27 255;
BA_ "GenSigStartValue" SG_ 526 ARS_OD_DistY_Obj_26 2047;
BA_ "GenSigStartValue" SG_ 526 ARS_OD_RCS_Obj_27 256;
BA_ "GenSigStartValue" SG_ 526 ARS_OD_Orientation_Obj_27 511;
BA_ "GenSigStartValue" SG_ 526 ARS_OD_YawRateAbs_Obj_27 511;
BA_ "GenSigStartValue" SG_ 526 ARS_OD_VabsY_Obj_26 1024;
BA_ "GenSigStartValue" SG_ 526 ARS_OD_ID_26 255;
BA_ "GenSigStartValue" SG_ 526 ARS_OD_ID_27 255;
BA_ "GenSigStartValue" SG_ 526 ARS_OD_AabsY_Obj_26 255;
VAL_ 307 ARS_RDI_DynProp_Clu_378 0 "STATIONARY" 1 "MOVING" 2 "AMBIGUOUS" 3 "RESERVED" ;
VAL_ 307 ARS_RDI_Quality_Clu_378 0 "INVALID" 1 "LOW" 2 "MID" 3 "HIGH" ;
VAL_ 307 ARS_RDI_DynProp_Clu_379 0 "STATIONARY" 1 "MOVING" 2 "AMBIGUOUS" 3 "RESERVED" ;
VAL_ 307 ARS_RDI_Quality_Clu_379 0 "INVALID" 1 "LOW" 2 "MID" 3 "HIGH" ;
VAL_ 307 ARS_RDI_DynProp_Clu_380 0 "STATIONARY" 1 "MOVING" 2 "AMBIGUOUS" 3 "RESERVED" ;
VAL_ 307 ARS_RDI_Quality_Clu_380 0 "INVALID" 1 "LOW" 2 "MID" 3 "HIGH" ;
VAL_ 307 ARS_RDI_DynProp_Clu_381 0 "STATIONARY" 1 "MOVING" 2 "AMBIGUOUS" 3 "RESERVED" ;
VAL_ 307 ARS_RDI_Quality_Clu_381 0 "INVALID" 1 "LOW" 2 "MID" 3 "HIGH" ;
VAL_ 307 ARS_RDI_DynProp_Clu_382 0 "STATIONARY" 1 "MOVING" 2 "AMBIGUOUS" 3 "RESERVED" ;
VAL_ 307 ARS_RDI_Quality_Clu_382 0 "INVALID" 1 "LOW" 2 "MID" 3 "HIGH" ;
VAL_ 307 ARS_RDI_DynProp_Clu_383 0 "STATIONARY" 1 "MOVING" 2 "AMBIGUOUS" 3 "RESERVED" ;
VAL_ 307 ARS_RDI_Quality_Clu_383 0 "INVALID" 1 "LOW" 2 "MID" 3 "HIGH" ;
VAL_ 307 ARS_RDI_DynProp_Clu_376 0 "STATIONARY" 1 "MOVING" 2 "AMBIGUOUS" 3 "RESERVED" ;
VAL_ 307 ARS_RDI_Quality_Clu_376 0 "INVALID" 1 "LOW" 2 "MID" 3 "HIGH" ;
VAL_ 307 ARS_RDI_DynProp_Clu_377 0 "STATIONARY" 1 "MOVING" 2 "AMBIGUOUS" 3 "RESERVED" ;
VAL_ 307 ARS_RDI_Quality_Clu_377 0 "INVALID" 1 "LOW" 2 "MID" 3 "HIGH" ;
VAL_ 308 ARS_RDI_DynProp_Clu_386 0 "STATIONARY" 1 "MOVING" 2 "AMBIGUOUS" 3 "RESERVED" ;
VAL_ 308 ARS_RDI_Quality_Clu_386 0 "INVALID" 1 "LOW" 2 "MID" 3 "HIGH" ;
VAL_ 308 ARS_RDI_DynProp_Clu_387 0 "STATIONARY" 1 "MOVING" 2 "AMBIGUOUS" 3 "RESERVED" ;
VAL_ 308 ARS_RDI_Quality_Clu_387 0 "INVALID" 1 "LOW" 2 "MID" 3 "HIGH" ;
VAL_ 308 ARS_RDI_DynProp_Clu_388 0 "STATIONARY" 1 "MOVING" 2 "AMBIGUOUS" 3 "RESERVED" ;
VAL_ 308 ARS_RDI_Quality_Clu_388 0 "INVALID" 1 "LOW" 2 "MID" 3 "HIGH" ;
VAL_ 308 ARS_RDI_DynProp_Clu_389 0 "STATIONARY" 1 "MOVING" 2 "AMBIGUOUS" 3 "RESERVED" ;
VAL_ 308 ARS_RDI_Quality_Clu_389 0 "INVALID" 1 "LOW" 2 "MID" 3 "HIGH" ;
VAL_ 308 ARS_RDI_DynProp_Clu_390 0 "STATIONARY" 1 "MOVING" 2 "AMBIGUOUS" 3 "RESERVED" ;
VAL_ 308 ARS_RDI_Quality_Clu_390 0 "INVALID" 1 "LOW" 2 "MID" 3 "HIGH" ;
VAL_ 308 ARS_RDI_DynProp_Clu_391 0 "STATIONARY" 1 "MOVING" 2 "AMBIGUOUS" 3 "RESERVED" ;
VAL_ 308 ARS_RDI_Quality_Clu_391 0 "INVALID" 1 "LOW" 2 "MID" 3 "HIGH" ;
VAL_ 308 ARS_RDI_DynProp_Clu_384 0 "STATIONARY" 1 "MOVING" 2 "AMBIGUOUS" 3 "RESERVED" ;
VAL_ 308 ARS_RDI_Quality_Clu_384 0 "INVALID" 1 "LOW" 2 "MID" 3 "HIGH" ;
VAL_ 308 ARS_RDI_DynProp_Clu_385 0 "STATIONARY" 1 "MOVING" 2 "AMBIGUOUS" 3 "RESERVED" ;
VAL_ 308 ARS_RDI_Quality_Clu_385 0 "INVALID" 1 "LOW" 2 "MID" 3 "HIGH" ;
VAL_ 309 ARS_RDI_DynProp_Clu_394 0 "STATIONARY" 1 "MOVING" 2 "AMBIGUOUS" 3 "RESERVED" ;
VAL_ 309 ARS_RDI_Quality_Clu_394 0 "INVALID" 1 "LOW" 2 "MID" 3 "HIGH" ;
VAL_ 309 ARS_RDI_DynProp_Clu_395 0 "STATIONARY" 1 "MOVING" 2 "AMBIGUOUS" 3 "RESERVED" ;
VAL_ 309 ARS_RDI_Quality_Clu_395 0 "INVALID" 1 "LOW" 2 "MID" 3 "HIGH" ;
VAL_ 309 ARS_RDI_DynProp_Clu_396 0 "STATIONARY" 1 "MOVING" 2 "AMBIGUOUS" 3 "RESERVED" ;
VAL_ 309 ARS_RDI_Quality_Clu_396 0 "INVALID" 1 "LOW" 2 "MID" 3 "HIGH" ;
VAL_ 309 ARS_RDI_DynProp_Clu_397 0 "STATIONARY" 1 "MOVING" 2 "AMBIGUOUS" 3 "RESERVED" ;
VAL_ 309 ARS_RDI_Quality_Clu_397 0 "INVALID" 1 "LOW" 2 "MID" 3 "HIGH" ;
VAL_ 309 ARS_RDI_DynProp_Clu_398 0 "STATIONARY" 1 "MOVING" 2 "AMBIGUOUS" 3 "RESERVED" ;
VAL_ 309 ARS_RDI_Quality_Clu_398 0 "INVALID" 1 "LOW" 2 "MID" 3 "HIGH" ;
VAL_ 309 ARS_RDI_DynProp_Clu_399 0 "STATIONARY" 1 "MOVING" 2 "AMBIGUOUS" 3 "RESERVED" ;
VAL_ 309 ARS_RDI_Quality_Clu_399 0 "INVALID" 1 "LOW" 2 "MID" 3 "HIGH" ;
VAL_ 309 ARS_RDI_DynProp_Clu_392 0 "STATIONARY" 1 "MOVING" 2 "AMBIGUOUS" 3 "RESERVED" ;
VAL_ 309 ARS_RDI_Quality_Clu_392 0 "INVALID" 1 "LOW" 2 "MID" 3 "HIGH" ;
VAL_ 309 ARS_RDI_DynProp_Clu_393 0 "STATIONARY" 1 "MOVING" 2 "AMBIGUOUS" 3 "RESERVED" ;
VAL_ 309 ARS_RDI_Quality_Clu_393 0 "INVALID" 1 "LOW" 2 "MID" 3 "HIGH" ;
VAL_ 512 ARS_OD_TaskValidFlag 0 "INVALID" 1 "VALID" ;
VAL_ 512 ARS_OD_ExtendedCycleFlag 0 "FALSE" 1 "TRUE" ;
VAL_ 513 ARS_OD_Classification_Obj_00 0 "POINT" 1 "CAR" 2 "TRUCK" 3 "PEDESTRIAN" 4 "MOTORCYCLE" 5 "BICYCLE" 6 "WIDE" 7 "UNCLASSIFIED" ;
VAL_ 513 ARS_OD_DynProp_Obj_00 0 "MOVING" 1 "STATIONARY" 2 "ONCOMING" 3 "CROSSING_LEFT2RIGHT" 4 "CROSSING_RIGHT2LEFT" 5 "UNKNOWN" 6 "STOPPED" 7 "RESERVED" ;
VAL_ 513 ARS_OD_MaintenanceState_Obj_00 0 "INVALID" 1 "NEW" 2 "MEASURED" 3 "PREDICTED" ;
VAL_ 513 ARS_OD_RefPoint_Obj_00 0 "REAR" 1 "LEFT" 2 "FRONT" 3 "RIGHT" ;
VAL_ 513 ARS_OD_Classification_Obj_01 0 "POINT" 1 "CAR" 2 "TRUCK" 3 "PEDESTRIAN" 4 "MOTORCYCLE" 5 "BICYCLE" 6 "WIDE" 7 "UNCLASSIFIED" ;
VAL_ 513 ARS_OD_DynProp_Obj_01 0 "MOVING" 1 "STATIONARY" 2 "ONCOMING" 3 "CROSSING_LEFT2RIGHT" 4 "CROSSING_RIGHT2LEFT" 5 "UNKNOWN" 6 "STOPPED" 7 "RESERVED" ;
VAL_ 513 ARS_OD_MaintenanceState_Obj_01 0 "INVALID" 1 "NEW" 2 "MEASURED" 3 "PREDICTED" ;
VAL_ 513 ARS_OD_RefPoint_Obj_01 0 "REAR" 1 "LEFT" 2 "FRONT" 3 "RIGHT" ;
VAL_ 513 ARS_OD_MicroDopplerFlag_00 0 "FALSE" 1 "TRUE" ;
VAL_ 513 ARS_OD_MicroDopplerFlag_01 0 "FALSE" 1 "TRUE" ;
VAL_ 514 ARS_OD_Classification_Obj_02 0 "POINT" 1 "CAR" 2 "TRUCK" 3 "PEDESTRIAN" 4 "MOTORCYCLE" 5 "BICYCLE" 6 "WIDE" 7 "UNCLASSIFIED" ;
VAL_ 514 ARS_OD_DynProp_Obj_02 0 "MOVING" 1 "STATIONARY" 2 "ONCOMING" 3 "CROSSING_LEFT2RIGHT" 4 "CROSSING_RIGHT2LEFT" 5 "UNKNOWN" 6 "STOPPED" 7 "RESERVED" ;
VAL_ 514 ARS_OD_MaintenanceState_Obj_02 0 "INVALID" 1 "NEW" 2 "MEASURED" 3 "PREDICTED" ;
VAL_ 514 ARS_OD_RefPoint_Obj_02 0 "REAR" 1 "LEFT" 2 "FRONT" 3 "RIGHT" ;
VAL_ 514 ARS_OD_Classification_Obj_03 0 "POINT" 1 "CAR" 2 "TRUCK" 3 "PEDESTRIAN" 4 "MOTORCYCLE" 5 "BICYCLE" 6 "WIDE" 7 "UNCLASSIFIED" ;
VAL_ 514 ARS_OD_DynProp_Obj_03 0 "MOVING" 1 "STATIONARY" 2 "ONCOMING" 3 "CROSSING_LEFT2RIGHT" 4 "CROSSING_RIGHT2LEFT" 5 "UNKNOWN" 6 "STOPPED" 7 "RESERVED" ;
VAL_ 514 ARS_OD_MaintenanceState_Obj_03 0 "INVALID" 1 "NEW" 2 "MEASURED" 3 "PREDICTED" ;
VAL_ 514 ARS_OD_RefPoint_Obj_03 0 "REAR" 1 "LEFT" 2 "FRONT" 3 "RIGHT" ;
VAL_ 514 ARS_OD_MicroDopplerFlag_02 0 "FALSE" 1 "TRUE" ;
VAL_ 514 ARS_OD_MicroDopplerFlag_03 0 "FALSE" 1 "TRUE" ;
VAL_ 515 ARS_OD_Classification_Obj_04 0 "POINT" 1 "CAR" 2 "TRUCK" 3 "PEDESTRIAN" 4 "MOTORCYCLE" 5 "BICYCLE" 6 "WIDE" 7 "UNCLASSIFIED" ;
VAL_ 515 ARS_OD_DynProp_Obj_04 0 "MOVING" 1 "STATIONARY" 2 "ONCOMING" 3 "CROSSING_LEFT2RIGHT" 4 "CROSSING_RIGHT2LEFT" 5 "UNKNOWN" 6 "STOPPED" 7 "RESERVED" ;
VAL_ 515 ARS_OD_MaintenanceState_Obj_04 0 "INVALID" 1 "NEW" 2 "MEASURED" 3 "PREDICTED" ;
VAL_ 515 ARS_OD_RefPoint_Obj_04 0 "REAR" 1 "LEFT" 2 "FRONT" 3 "RIGHT" ;
VAL_ 515 ARS_OD_Classification_Obj_05 0 "POINT" 1 "CAR" 2 "TRUCK" 3 "PEDESTRIAN" 4 "MOTORCYCLE" 5 "BICYCLE" 6 "WIDE" 7 "UNCLASSIFIED" ;
VAL_ 515 ARS_OD_DynProp_Obj_05 0 "MOVING" 1 "STATIONARY" 2 "ONCOMING" 3 "CROSSING_LEFT2RIGHT" 4 "CROSSING_RIGHT2LEFT" 5 "UNKNOWN" 6 "STOPPED" 7 "RESERVED" ;
VAL_ 515 ARS_OD_MaintenanceState_Obj_05 0 "INVALID" 1 "NEW" 2 "MEASURED" 3 "PREDICTED" ;
VAL_ 515 ARS_OD_RefPoint_Obj_05 0 "REAR" 1 "LEFT" 2 "FRONT" 3 "RIGHT" ;
VAL_ 515 ARS_OD_MicroDopplerFlag_04 0 "FALSE" 1 "TRUE" ;
VAL_ 515 ARS_OD_MicroDopplerFlag_05 0 "FALSE" 1 "TRUE" ;
VAL_ 516 ARS_OD_Classification_Obj_06 0 "POINT" 1 "CAR" 2 "TRUCK" 3 "PEDESTRIAN" 4 "MOTORCYCLE" 5 "BICYCLE" 6 "WIDE" 7 "UNCLASSIFIED" ;
VAL_ 516 ARS_OD_DynProp_Obj_06 0 "MOVING" 1 "STATIONARY" 2 "ONCOMING" 3 "CROSSING_LEFT2RIGHT" 4 "CROSSING_RIGHT2LEFT" 5 "UNKNOWN" 6 "STOPPED" 7 "RESERVED" ;
VAL_ 516 ARS_OD_MaintenanceState_Obj_06 0 "INVALID" 1 "NEW" 2 "MEASURED" 3 "PREDICTED" ;
VAL_ 516 ARS_OD_RefPoint_Obj_06 0 "REAR" 1 "LEFT" 2 "FRONT" 3 "RIGHT" ;
VAL_ 516 ARS_OD_Classification_Obj_07 0 "POINT" 1 "CAR" 2 "TRUCK" 3 "PEDESTRIAN" 4 "MOTORCYCLE" 5 "BICYCLE" 6 "WIDE" 7 "UNCLASSIFIED" ;
VAL_ 516 ARS_OD_DynProp_Obj_07 0 "MOVING" 1 "STATIONARY" 2 "ONCOMING" 3 "CROSSING_LEFT2RIGHT" 4 "CROSSING_RIGHT2LEFT" 5 "UNKNOWN" 6 "STOPPED" 7 "RESERVED" ;
VAL_ 516 ARS_OD_MaintenanceState_Obj_07 0 "INVALID" 1 "NEW" 2 "MEASURED" 3 "PREDICTED" ;
VAL_ 516 ARS_OD_RefPoint_Obj_07 0 "REAR" 1 "LEFT" 2 "FRONT" 3 "RIGHT" ;
VAL_ 516 ARS_OD_MicroDopplerFlag_06 0 "FALSE" 1 "TRUE" ;
VAL_ 516 ARS_OD_MicroDopplerFlag_07 0 "FALSE" 1 "TRUE" ;
VAL_ 517 ARS_OD_Classification_Obj_08 0 "POINT" 1 "CAR" 2 "TRUCK" 3 "PEDESTRIAN" 4 "MOTORCYCLE" 5 "BICYCLE" 6 "WIDE" 7 "UNCLASSIFIED" ;
VAL_ 517 ARS_OD_DynProp_Obj_08 0 "MOVING" 1 "STATIONARY" 2 "ONCOMING" 3 "CROSSING_LEFT2RIGHT" 4 "CROSSING_RIGHT2LEFT" 5 "UNKNOWN" 6 "STOPPED" 7 "RESERVED" ;
VAL_ 517 ARS_OD_MaintenanceState_Obj_08 0 "INVALID" 1 "NEW" 2 "MEASURED" 3 "PREDICTED" ;
VAL_ 517 ARS_OD_RefPoint_Obj_08 0 "REAR" 1 "LEFT" 2 "FRONT" 3 "RIGHT" ;
VAL_ 517 ARS_OD_Classification_Obj_09 0 "POINT" 1 "CAR" 2 "TRUCK" 3 "PEDESTRIAN" 4 "MOTORCYCLE" 5 "BICYCLE" 6 "WIDE" 7 "UNCLASSIFIED" ;
VAL_ 517 ARS_OD_DynProp_Obj_09 0 "MOVING" 1 "STATIONARY" 2 "ONCOMING" 3 "CROSSING_LEFT2RIGHT" 4 "CROSSING_RIGHT2LEFT" 5 "UNKNOWN" 6 "STOPPED" 7 "RESERVED" ;
VAL_ 517 ARS_OD_MaintenanceState_Obj_09 0 "INVALID" 1 "NEW" 2 "MEASURED" 3 "PREDICTED" ;
VAL_ 517 ARS_OD_RefPoint_Obj_09 0 "REAR" 1 "LEFT" 2 "FRONT" 3 "RIGHT" ;
VAL_ 517 ARS_OD_MicroDopplerFlag_08 0 "FALSE" 1 "TRUE" ;
VAL_ 517 ARS_OD_MicroDopplerFlag_09 0 "FALSE" 1 "TRUE" ;
VAL_ 518 ARS_OD_Classification_Obj_10 0 "POINT" 1 "CAR" 2 "TRUCK" 3 "PEDESTRIAN" 4 "MOTORCYCLE" 5 "BICYCLE" 6 "WIDE" 7 "UNCLASSIFIED" ;
VAL_ 518 ARS_OD_DynProp_Obj_10 0 "MOVING" 1 "STATIONARY" 2 "ONCOMING" 3 "CROSSING_LEFT2RIGHT" 4 "CROSSING_RIGHT2LEFT" 5 "UNKNOWN" 6 "STOPPED" 7 "RESERVED" ;
VAL_ 518 ARS_OD_MaintenanceState_Obj_10 0 "INVALID" 1 "NEW" 2 "MEASURED" 3 "PREDICTED" ;
VAL_ 518 ARS_OD_RefPoint_Obj_10 0 "REAR" 1 "LEFT" 2 "FRONT" 3 "RIGHT" ;
VAL_ 518 ARS_OD_Classification_Obj_11 0 "POINT" 1 "CAR" 2 "TRUCK" 3 "PEDESTRIAN" 4 "MOTORCYCLE" 5 "BICYCLE" 6 "WIDE" 7 "UNCLASSIFIED" ;
VAL_ 518 ARS_OD_DynProp_Obj_11 0 "MOVING" 1 "STATIONARY" 2 "ONCOMING" 3 "CROSSING_LEFT2RIGHT" 4 "CROSSING_RIGHT2LEFT" 5 "UNKNOWN" 6 "STOPPED" 7 "RESERVED" ;
VAL_ 518 ARS_OD_MaintenanceState_Obj_11 0 "INVALID" 1 "NEW" 2 "MEASURED" 3 "PREDICTED" ;
VAL_ 518 ARS_OD_RefPoint_Obj_11 0 "REAR" 1 "LEFT" 2 "FRONT" 3 "RIGHT" ;
VAL_ 518 ARS_OD_MicroDopplerFlag_10 0 "FALSE" 1 "TRUE" ;
VAL_ 518 ARS_OD_MicroDopplerFlag_11 0 "FALSE" 1 "TRUE" ;
VAL_ 519 ARS_OD_Classification_Obj_12 0 "POINT" 1 "CAR" 2 "TRUCK" 3 "PEDESTRIAN" 4 "MOTORCYCLE" 5 "BICYCLE" 6 "WIDE" 7 "UNCLASSIFIED" ;
VAL_ 519 ARS_OD_DynProp_Obj_12 0 "MOVING" 1 "STATIONARY" 2 "ONCOMING" 3 "CROSSING_LEFT2RIGHT" 4 "CROSSING_RIGHT2LEFT" 5 "UNKNOWN" 6 "STOPPED" 7 "RESERVED" ;
VAL_ 519 ARS_OD_MaintenanceState_Obj_12 0 "INVALID" 1 "NEW" 2 "MEASURED" 3 "PREDICTED" ;
VAL_ 519 ARS_OD_RefPoint_Obj_12 0 "REAR" 1 "LEFT" 2 "FRONT" 3 "RIGHT" ;
VAL_ 519 ARS_OD_Classification_Obj_13 0 "POINT" 1 "CAR" 2 "TRUCK" 3 "PEDESTRIAN" 4 "MOTORCYCLE" 5 "BICYCLE" 6 "WIDE" 7 "UNCLASSIFIED" ;
VAL_ 519 ARS_OD_DynProp_Obj_13 0 "MOVING" 1 "STATIONARY" 2 "ONCOMING" 3 "CROSSING_LEFT2RIGHT" 4 "CROSSING_RIGHT2LEFT" 5 "UNKNOWN" 6 "STOPPED" 7 "RESERVED" ;
VAL_ 519 ARS_OD_MaintenanceState_Obj_13 0 "INVALID" 1 "NEW" 2 "MEASURED" 3 "PREDICTED" ;
VAL_ 519 ARS_OD_RefPoint_Obj_13 0 "REAR" 1 "LEFT" 2 "FRONT" 3 "RIGHT" ;
VAL_ 519 ARS_OD_MicroDopplerFlag_12 0 "FALSE" 1 "TRUE" ;
VAL_ 519 ARS_OD_MicroDopplerFlag_13 0 "FALSE" 1 "TRUE" ;
VAL_ 520 ARS_OD_Classification_Obj_14 0 "POINT" 1 "CAR" 2 "TRUCK" 3 "PEDESTRIAN" 4 "MOTORCYCLE" 5 "BICYCLE" 6 "WIDE" 7 "UNCLASSIFIED" ;
VAL_ 520 ARS_OD_DynProp_Obj_14 0 "MOVING" 1 "STATIONARY" 2 "ONCOMING" 3 "CROSSING_LEFT2RIGHT" 4 "CROSSING_RIGHT2LEFT" 5 "UNKNOWN" 6 "STOPPED" 7 "RESERVED" ;
VAL_ 520 ARS_OD_MaintenanceState_Obj_14 0 "INVALID" 1 "NEW" 2 "MEASURED" 3 "PREDICTED" ;
VAL_ 520 ARS_OD_RefPoint_Obj_14 0 "REAR" 1 "LEFT" 2 "FRONT" 3 "RIGHT" ;
VAL_ 520 ARS_OD_Classification_Obj_15 0 "POINT" 1 "CAR" 2 "TRUCK" 3 "PEDESTRIAN" 4 "MOTORCYCLE" 5 "BICYCLE" 6 "WIDE" 7 "UNCLASSIFIED" ;
VAL_ 520 ARS_OD_DynProp_Obj_15 0 "MOVING" 1 "STATIONARY" 2 "ONCOMING" 3 "CROSSING_LEFT2RIGHT" 4 "CROSSING_RIGHT2LEFT" 5 "UNKNOWN" 6 "STOPPED" 7 "RESERVED" ;
VAL_ 520 ARS_OD_MaintenanceState_Obj_15 0 "INVALID" 1 "NEW" 2 "MEASURED" 3 "PREDICTED" ;
VAL_ 520 ARS_OD_RefPoint_Obj_15 0 "REAR" 1 "LEFT" 2 "FRONT" 3 "RIGHT" ;
VAL_ 520 ARS_OD_MicroDopplerFlag_14 0 "FALSE" 1 "TRUE" ;
VAL_ 520 ARS_OD_MicroDopplerFlag_15 0 "FALSE" 1 "TRUE" ;
VAL_ 521 ARS_OD_Classification_Obj_16 0 "POINT" 1 "CAR" 2 "TRUCK" 3 "PEDESTRIAN" 4 "MOTORCYCLE" 5 "BICYCLE" 6 "WIDE" 7 "UNCLASSIFIED" ;
VAL_ 521 ARS_OD_DynProp_Obj_16 0 "MOVING" 1 "STATIONARY" 2 "ONCOMING" 3 "CROSSING_LEFT2RIGHT" 4 "CROSSING_RIGHT2LEFT" 5 "UNKNOWN" 6 "STOPPED" 7 "RESERVED" ;
VAL_ 521 ARS_OD_MaintenanceState_Obj_16 0 "INVALID" 1 "NEW" 2 "MEASURED" 3 "PREDICTED" ;
VAL_ 521 ARS_OD_RefPoint_Obj_16 0 "REAR" 1 "LEFT" 2 "FRONT" 3 "RIGHT" ;
VAL_ 521 ARS_OD_Classification_Obj_17 0 "POINT" 1 "CAR" 2 "TRUCK" 3 "PEDESTRIAN" 4 "MOTORCYCLE" 5 "BICYCLE" 6 "WIDE" 7 "UNCLASSIFIED" ;
VAL_ 521 ARS_OD_DynProp_Obj_17 0 "MOVING" 1 "STATIONARY" 2 "ONCOMING" 3 "CROSSING_LEFT2RIGHT" 4 "CROSSING_RIGHT2LEFT" 5 "UNKNOWN" 6 "STOPPED" 7 "RESERVED" ;
VAL_ 521 ARS_OD_MaintenanceState_Obj_17 0 "INVALID" 1 "NEW" 2 "MEASURED" 3 "PREDICTED" ;
VAL_ 521 ARS_OD_RefPoint_Obj_17 0 "REAR" 1 "LEFT" 2 "FRONT" 3 "RIGHT" ;
VAL_ 521 ARS_OD_MicroDopplerFlag_16 0 "FALSE" 1 "TRUE" ;
VAL_ 521 ARS_OD_MicroDopplerFlag_17 0 "FALSE" 1 "TRUE" ;
VAL_ 522 ARS_OD_Classification_Obj_18 0 "POINT" 1 "CAR" 2 "TRUCK" 3 "PEDESTRIAN" 4 "MOTORCYCLE" 5 "BICYCLE" 6 "WIDE" 7 "UNCLASSIFIED" ;
VAL_ 522 ARS_OD_DynProp_Obj_18 0 "MOVING" 1 "STATIONARY" 2 "ONCOMING" 3 "CROSSING_LEFT2RIGHT" 4 "CROSSING_RIGHT2LEFT" 5 "UNKNOWN" 6 "STOPPED" 7 "RESERVED" ;
VAL_ 522 ARS_OD_MaintenanceState_Obj_18 0 "INVALID" 1 "NEW" 2 "MEASURED" 3 "PREDICTED" ;
VAL_ 522 ARS_OD_RefPoint_Obj_18 0 "REAR" 1 "LEFT" 2 "FRONT" 3 "RIGHT" ;
VAL_ 522 ARS_OD_Classification_Obj_19 0 "POINT" 1 "CAR" 2 "TRUCK" 3 "PEDESTRIAN" 4 "MOTORCYCLE" 5 "BICYCLE" 6 "WIDE" 7 "UNCLASSIFIED" ;
VAL_ 522 ARS_OD_DynProp_Obj_19 0 "MOVING" 1 "STATIONARY" 2 "ONCOMING" 3 "CROSSING_LEFT2RIGHT" 4 "CROSSING_RIGHT2LEFT" 5 "UNKNOWN" 6 "STOPPED" 7 "RESERVED" ;
VAL_ 522 ARS_OD_MaintenanceState_Obj_19 0 "INVALID" 1 "NEW" 2 "MEASURED" 3 "PREDICTED" ;
VAL_ 522 ARS_OD_RefPoint_Obj_19 0 "REAR" 1 "LEFT" 2 "FRONT" 3 "RIGHT" ;
VAL_ 522 ARS_OD_MicroDopplerFlag_18 0 "FALSE" 1 "TRUE" ;
VAL_ 522 ARS_OD_MicroDopplerFlag_19 0 "FALSE" 1 "TRUE" ;
VAL_ 523 ARS_OD_Classification_Obj_20 0 "POINT" 1 "CAR" 2 "TRUCK" 3 "PEDESTRIAN" 4 "MOTORCYCLE" 5 "BICYCLE" 6 "WIDE" 7 "UNCLASSIFIED" ;
VAL_ 523 ARS_OD_DynProp_Obj_20 0 "MOVING" 1 "STATIONARY" 2 "ONCOMING" 3 "CROSSING_LEFT2RIGHT" 4 "CROSSING_RIGHT2LEFT" 5 "UNKNOWN" 6 "STOPPED" 7 "RESERVED" ;
VAL_ 523 ARS_OD_MaintenanceState_Obj_20 0 "INVALID" 1 "NEW" 2 "MEASURED" 3 "PREDICTED" ;
VAL_ 523 ARS_OD_RefPoint_Obj_20 0 "REAR" 1 "LEFT" 2 "FRONT" 3 "RIGHT" ;
VAL_ 523 ARS_OD_Classification_Obj_21 0 "POINT" 1 "CAR" 2 "TRUCK" 3 "PEDESTRIAN" 4 "MOTORCYCLE" 5 "BICYCLE" 6 "WIDE" 7 "UNCLASSIFIED" ;
VAL_ 523 ARS_OD_DynProp_Obj_21 0 "MOVING" 1 "STATIONARY" 2 "ONCOMING" 3 "CROSSING_LEFT2RIGHT" 4 "CROSSING_RIGHT2LEFT" 5 "UNKNOWN" 6 "STOPPED" 7 "RESERVED" ;
VAL_ 523 ARS_OD_MaintenanceState_Obj_21 0 "INVALID" 1 "NEW" 2 "MEASURED" 3 "PREDICTED" ;
VAL_ 523 ARS_OD_RefPoint_Obj_21 0 "REAR" 1 "LEFT" 2 "FRONT" 3 "RIGHT" ;
VAL_ 523 ARS_OD_MicroDopplerFlag_20 0 "FALSE" 1 "TRUE" ;
VAL_ 523 ARS_OD_MicroDopplerFlag_21 0 "FALSE" 1 "TRUE" ;
VAL_ 524 ARS_OD_Classification_Obj_22 0 "POINT" 1 "CAR" 2 "TRUCK" 3 "PEDESTRIAN" 4 "MOTORCYCLE" 5 "BICYCLE" 6 "WIDE" 7 "UNCLASSIFIED" ;
VAL_ 524 ARS_OD_DynProp_Obj_22 0 "MOVING" 1 "STATIONARY" 2 "ONCOMING" 3 "CROSSING_LEFT2RIGHT" 4 "CROSSING_RIGHT2LEFT" 5 "UNKNOWN" 6 "STOPPED" 7 "RESERVED" ;
VAL_ 524 ARS_OD_MaintenanceState_Obj_22 0 "INVALID" 1 "NEW" 2 "MEASURED" 3 "PREDICTED" ;
VAL_ 524 ARS_OD_RefPoint_Obj_22 0 "REAR" 1 "LEFT" 2 "FRONT" 3 "RIGHT" ;
VAL_ 524 ARS_OD_Classification_Obj_23 0 "POINT" 1 "CAR" 2 "TRUCK" 3 "PEDESTRIAN" 4 "MOTORCYCLE" 5 "BICYCLE" 6 "WIDE" 7 "UNCLASSIFIED" ;
VAL_ 524 ARS_OD_DynProp_Obj_23 0 "MOVING" 1 "STATIONARY" 2 "ONCOMING" 3 "CROSSING_LEFT2RIGHT" 4 "CROSSING_RIGHT2LEFT" 5 "UNKNOWN" 6 "STOPPED" 7 "RESERVED" ;
VAL_ 524 ARS_OD_MaintenanceState_Obj_23 0 "INVALID" 1 "NEW" 2 "MEASURED" 3 "PREDICTED" ;
VAL_ 524 ARS_OD_RefPoint_Obj_23 0 "REAR" 1 "LEFT" 2 "FRONT" 3 "RIGHT" ;
VAL_ 524 ARS_OD_MicroDopplerFlag_22 0 "FALSE" 1 "TRUE" ;
VAL_ 524 ARS_OD_MicroDopplerFlag_23 0 "FALSE" 1 "TRUE" ;
VAL_ 525 ARS_OD_Classification_Obj_24 0 "POINT" 1 "CAR" 2 "TRUCK" 3 "PEDESTRIAN" 4 "MOTORCYCLE" 5 "BICYCLE" 6 "WIDE" 7 "UNCLASSIFIED" ;
VAL_ 525 ARS_OD_DynProp_Obj_24 0 "MOVING" 1 "STATIONARY" 2 "ONCOMING" 3 "CROSSING_LEFT2RIGHT" 4 "CROSSING_RIGHT2LEFT" 5 "UNKNOWN" 6 "STOPPED" 7 "RESERVED" ;
VAL_ 525 ARS_OD_MaintenanceState_Obj_24 0 "INVALID" 1 "NEW" 2 "MEASURED" 3 "PREDICTED" ;
VAL_ 525 ARS_OD_RefPoint_Obj_24 0 "REAR" 1 "LEFT" 2 "FRONT" 3 "RIGHT" ;
VAL_ 525 ARS_OD_Classification_Obj_25 0 "POINT" 1 "CAR" 2 "TRUCK" 3 "PEDESTRIAN" 4 "MOTORCYCLE" 5 "BICYCLE" 6 "WIDE" 7 "UNCLASSIFIED" ;
VAL_ 525 ARS_OD_DynProp_Obj_25 0 "MOVING" 1 "STATIONARY" 2 "ONCOMING" 3 "CROSSING_LEFT2RIGHT" 4 "CROSSING_RIGHT2LEFT" 5 "UNKNOWN" 6 "STOPPED" 7 "RESERVED" ;
VAL_ 525 ARS_OD_MaintenanceState_Obj_25 0 "INVALID" 1 "NEW" 2 "MEASURED" 3 "PREDICTED" ;
VAL_ 525 ARS_OD_RefPoint_Obj_25 0 "REAR" 1 "LEFT" 2 "FRONT" 3 "RIGHT" ;
VAL_ 525 ARS_OD_MicroDopplerFlag_24 0 "FALSE" 1 "TRUE" ;
VAL_ 525 ARS_OD_MicroDopplerFlag_25 0 "FALSE" 1 "TRUE" ;
VAL_ 526 ARS_OD_Classification_Obj_26 0 "POINT" 1 "CAR" 2 "TRUCK" 3 "PEDESTRIAN" 4 "MOTORCYCLE" 5 "BICYCLE" 6 "WIDE" 7 "UNCLASSIFIED" ;
VAL_ 526 ARS_OD_DynProp_Obj_26 0 "MOVING" 1 "STATIONARY" 2 "ONCOMING" 3 "CROSSING_LEFT2RIGHT" 4 "CROSSING_RIGHT2LEFT" 5 "UNKNOWN" 6 "STOPPED" 7 "RESERVED" ;
VAL_ 526 ARS_OD_MaintenanceState_Obj_26 0 "INVALID" 1 "NEW" 2 "MEASURED" 3 "PREDICTED" ;
VAL_ 526 ARS_OD_RefPoint_Obj_26 0 "REAR" 1 "LEFT" 2 "FRONT" 3 "RIGHT" ;
VAL_ 526 ARS_OD_Classification_Obj_27 0 "POINT" 1 "CAR" 2 "TRUCK" 3 "PEDESTRIAN" 4 "MOTORCYCLE" 5 "BICYCLE" 6 "WIDE" 7 "UNCLASSIFIED" ;
VAL_ 526 ARS_OD_DynProp_Obj_27 0 "MOVING" 1 "STATIONARY" 2 "ONCOMING" 3 "CROSSING_LEFT2RIGHT" 4 "CROSSING_RIGHT2LEFT" 5 "UNKNOWN" 6 "STOPPED" 7 "RESERVED" ;
VAL_ 526 ARS_OD_MaintenanceState_Obj_27 0 "INVALID" 1 "NEW" 2 "MEASURED" 3 "PREDICTED" ;
VAL_ 526 ARS_OD_RefPoint_Obj_27 0 "REAR" 1 "LEFT" 2 "FRONT" 3 "RIGHT" ;
VAL_ 526 ARS_OD_MicroDopplerFlag_26 0 "FALSE" 1 "TRUE" ;
VAL_ 526 ARS_OD_MicroDopplerFlag_27 0 "FALSE" 1 "TRUE" ;
SIG_GROUP_ 307 Signal_Group_ARS_RDI_376_383 1 : ARS_RDI_Range_Clu_376 ARS_RDI_ElevationAng_Clu_377 ARS_RDI_SNR_Clu_377 ARS_RDI_Range_Clu_378 ARS_RDI_VradRel_Clu_376 ARS_RDI_VradRel_Clu_378 ARS_RDI_RCS_Clu_378 ARS_RDI_AzimuthAng_Clu_378 ARS_RDI_ElevationAng_Clu_378 ARS_RDI_SNR_Clu_378 ARS_RDI_DynProp_Clu_378 ARS_RDI_Quality_Clu_378 ARS_RDI_DynProp_Clu_379 ARS_RDI_Quality_Clu_379 ARS_RDI_Range_Clu_379 ARS_RDI_VradRel_Clu_379 ARS_RDI_RCS_Clu_379 ARS_RDI_AzimuthAng_Clu_379 ARS_RDI_ElevationAng_Clu_379 ARS_RDI_SNR_Clu_379 ARS_RDI_RCS_Clu_376 ARS_RDI_Range_Clu_380 ARS_RDI_VradRel_Clu_380 ARS_RDI_RCS_Clu_380 ARS_RDI_AzimuthAng_Clu_380 ARS_RDI_ElevationAng_Clu_380 ARS_RDI_SNR_Clu_380 ARS_RDI_DynProp_Clu_380 ARS_RDI_Quality_Clu_380 ARS_RDI_DynProp_Clu_381 ARS_RDI_Quality_Clu_381 ARS_RDI_Range_Clu_381 ARS_RDI_VradRel_Clu_381 ARS_RDI_RCS_Clu_381 ARS_RDI_AzimuthAng_Clu_376 ARS_RDI_AzimuthAng_Clu_381 ARS_RDI_ElevationAng_Clu_381 ARS_RDI_SNR_Clu_381 ARS_RDI_Range_Clu_382 ARS_RDI_VradRel_Clu_382 ARS_RDI_RCS_Clu_382 ARS_RDI_AzimuthAng_Clu_382 ARS_RDI_ElevationAng_Clu_382 ARS_RDI_SNR_Clu_382 ARS_RDI_DynProp_Clu_382 ARS_RDI_Quality_Clu_382 ARS_RDI_DynProp_Clu_383 ARS_RDI_Quality_Clu_383 ARS_RDI_Range_Clu_383 ARS_RDI_ElevationAng_Clu_376 ARS_RDI_VradRel_Clu_383 ARS_RDI_RCS_Clu_383 ARS_RDI_AzimuthAng_Clu_383 ARS_RDI_ElevationAng_Clu_383 ARS_RDI_SNR_Clu_383 ARS_RDI_MsgCounter_Clu_376_383 ARS_RDI_CRC16_Checksum_Clu_376_3 ARS_RDI_SNR_Clu_376 ARS_RDI_DynProp_Clu_376 ARS_RDI_Quality_Clu_376 ARS_RDI_DynProp_Clu_377 ARS_RDI_Quality_Clu_377 ARS_RDI_Range_Clu_377 ARS_RDI_VradRel_Clu_377 ARS_RDI_RCS_Clu_377 ARS_RDI_AzimuthAng_Clu_377;
SIG_GROUP_ 308 Signal_Group_ARS_RDI_384_391 1 : ARS_RDI_Range_Clu_384 ARS_RDI_ElevationAng_Clu_385 ARS_RDI_SNR_Clu_385 ARS_RDI_Range_Clu_386 ARS_RDI_VradRel_Clu_384 ARS_RDI_VradRel_Clu_386 ARS_RDI_RCS_Clu_386 ARS_RDI_AzimuthAng_Clu_386 ARS_RDI_ElevationAng_Clu_386 ARS_RDI_SNR_Clu_386 ARS_RDI_DynProp_Clu_386 ARS_RDI_Quality_Clu_386 ARS_RDI_DynProp_Clu_387 ARS_RDI_Quality_Clu_387 ARS_RDI_Range_Clu_387 ARS_RDI_VradRel_Clu_387 ARS_RDI_RCS_Clu_387 ARS_RDI_AzimuthAng_Clu_387 ARS_RDI_ElevationAng_Clu_387 ARS_RDI_SNR_Clu_387 ARS_RDI_RCS_Clu_384 ARS_RDI_Range_Clu_388 ARS_RDI_VradRel_Clu_388 ARS_RDI_RCS_Clu_388 ARS_RDI_AzimuthAng_Clu_388 ARS_RDI_ElevationAng_Clu_388 ARS_RDI_SNR_Clu_388 ARS_RDI_DynProp_Clu_388 ARS_RDI_Quality_Clu_388 ARS_RDI_DynProp_Clu_389 ARS_RDI_Quality_Clu_389 ARS_RDI_Range_Clu_389 ARS_RDI_VradRel_Clu_389 ARS_RDI_RCS_Clu_389 ARS_RDI_AzimuthAng_Clu_384 ARS_RDI_AzimuthAng_Clu_389 ARS_RDI_ElevationAng_Clu_389 ARS_RDI_SNR_Clu_389 ARS_RDI_Range_Clu_390 ARS_RDI_VradRel_Clu_390 ARS_RDI_RCS_Clu_390 ARS_RDI_AzimuthAng_Clu_390 ARS_RDI_ElevationAng_Clu_390 ARS_RDI_SNR_Clu_390 ARS_RDI_DynProp_Clu_390 ARS_RDI_Quality_Clu_390 ARS_RDI_DynProp_Clu_391 ARS_RDI_Quality_Clu_391 ARS_RDI_Range_Clu_391 ARS_RDI_ElevationAng_Clu_384 ARS_RDI_VradRel_Clu_391 ARS_RDI_RCS_Clu_391 ARS_RDI_AzimuthAng_Clu_391 ARS_RDI_ElevationAng_Clu_391 ARS_RDI_SNR_Clu_391 ARS_RDI_MsgCounter_Clu_384_391 ARS_RDI_CRC16_Checksum_Clu_384_3 ARS_RDI_SNR_Clu_384 ARS_RDI_DynProp_Clu_384 ARS_RDI_Quality_Clu_384 ARS_RDI_DynProp_Clu_385 ARS_RDI_Quality_Clu_385 ARS_RDI_Range_Clu_385 ARS_RDI_VradRel_Clu_385 ARS_RDI_RCS_Clu_385 ARS_RDI_AzimuthAng_Clu_385;
SIG_GROUP_ 309 Signal_Group_ARS_RDI_392_399 1 : ARS_RDI_Range_Clu_392 ARS_RDI_ElevationAng_Clu_393 ARS_RDI_SNR_Clu_393 ARS_RDI_Range_Clu_394 ARS_RDI_VradRel_Clu_392 ARS_RDI_VradRel_Clu_394 ARS_RDI_RCS_Clu_394 ARS_RDI_AzimuthAng_Clu_394 ARS_RDI_ElevationAng_Clu_394 ARS_RDI_SNR_Clu_394 ARS_RDI_DynProp_Clu_394 ARS_RDI_Quality_Clu_394 ARS_RDI_DynProp_Clu_395 ARS_RDI_Quality_Clu_395 ARS_RDI_Range_Clu_395 ARS_RDI_VradRel_Clu_395 ARS_RDI_RCS_Clu_395 ARS_RDI_AzimuthAng_Clu_395 ARS_RDI_ElevationAng_Clu_395 ARS_RDI_SNR_Clu_395 ARS_RDI_RCS_Clu_392 ARS_RDI_Range_Clu_396 ARS_RDI_VradRel_Clu_396 ARS_RDI_RCS_Clu_396 ARS_RDI_AzimuthAng_Clu_396 ARS_RDI_ElevationAng_Clu_396 ARS_RDI_SNR_Clu_396 ARS_RDI_DynProp_Clu_396 ARS_RDI_Quality_Clu_396 ARS_RDI_DynProp_Clu_397 ARS_RDI_Quality_Clu_397 ARS_RDI_Range_Clu_397 ARS_RDI_VradRel_Clu_397 ARS_RDI_RCS_Clu_397 ARS_RDI_AzimuthAng_Clu_392 ARS_RDI_AzimuthAng_Clu_397 ARS_RDI_ElevationAng_Clu_397 ARS_RDI_SNR_Clu_397 ARS_RDI_Range_Clu_398 ARS_RDI_VradRel_Clu_398 ARS_RDI_RCS_Clu_398 ARS_RDI_AzimuthAng_Clu_398 ARS_RDI_ElevationAng_Clu_398 ARS_RDI_SNR_Clu_398 ARS_RDI_DynProp_Clu_398 ARS_RDI_Quality_Clu_398 ARS_RDI_DynProp_Clu_399 ARS_RDI_Quality_Clu_399 ARS_RDI_Range_Clu_399 ARS_RDI_ElevationAng_Clu_392 ARS_RDI_VradRel_Clu_399 ARS_RDI_RCS_Clu_399 ARS_RDI_AzimuthAng_Clu_399 ARS_RDI_ElevationAng_Clu_399 ARS_RDI_SNR_Clu_399 ARS_RDI_MsgCounter_Clu_392_399 ARS_RDI_CRC16_Checksum_Clu_392_3 ARS_RDI_SNR_Clu_392 ARS_RDI_DynProp_Clu_392 ARS_RDI_Quality_Clu_392 ARS_RDI_DynProp_Clu_393 ARS_RDI_Quality_Clu_393 ARS_RDI_Range_Clu_393 ARS_RDI_VradRel_Clu_393 ARS_RDI_RCS_Clu_393 ARS_RDI_AzimuthAng_Clu_393;
SIG_GROUP_ 512 Signal_Group_ARS_OD_Header 1 : ARS_OD_TimeStampGlobSec ARS_OD_CycleCounter ARS_OD_NumOfObjects ARS_OD_TaskValidFlag ARS_OD_ExtendedCycleFlag ARS_OD_Latency ARS_OD_EgoVelocity ARS_OD_EgoYawRate ARS_OD_EgoVelocityStd ARS_OD_EgoAcceleration ARS_OD_EgoCurvature ARS_OD_MsgCounter_Header ARS_OD_CRC16_Checksum_Header ARS_OD_TimeStampGlobNanoSec ARS_OD_TimeStampLocal ARS_OD_MeasCounter;
SIG_GROUP_ 513 Signal_Group_ARS_OD_00_01 1 : ARS_OD_DistX_Obj_00 ARS_OD_Classification_Obj_00 ARS_OD_AabsYStd_Obj_00 ARS_OD_ClassConf_Obj_00 ARS_OD_ProbOfExist_Obj_00 ARS_OD_DynConf_Obj_00 ARS_OD_VabsX_Obj_00 ARS_OD_DynProp_Obj_00 ARS_OD_MirrorProb_Obj_00 ARS_OD_Length_Obj_00 ARS_OD_MaintenanceState_Obj_00 ARS_OD_Width_Obj_00 ARS_OD_RCS_Obj_00 ARS_OD_Orientation_Obj_00 ARS_OD_YawRateAbs_Obj_00 ARS_OD_YawRateAbsStd_Obj_00 ARS_OD_RefPoint_Obj_00 ARS_OD_LifeCycle_Obj_00 ARS_OD_DistX_Obj_01 ARS_OD_VabsX_Obj_01 ARS_OD_AabsX_Obj_01 ARS_OD_AabsX_Obj_00 ARS_OD_DistY_Obj_01 ARS_OD_VabsY_Obj_01 ARS_OD_AabsY_Obj_01 ARS_OD_DistXStd_Obj_01 ARS_OD_DistYStd_Obj_01 ARS_OD_VabsXStd_Obj_01 ARS_OD_VabsYStd_Obj_01 ARS_OD_AabsXStd_Obj_01 ARS_OD_Classification_Obj_01 ARS_OD_AabsYStd_Obj_01 ARS_OD_ClassConf_Obj_01 ARS_OD_DistY_Obj_00 ARS_OD_ProbOfExist_Obj_01 ARS_OD_DynConf_Obj_01 ARS_OD_DynProp_Obj_01 ARS_OD_MirrorProb_Obj_01 ARS_OD_Length_Obj_01 ARS_OD_MaintenanceState_Obj_01 ARS_OD_Width_Obj_01 ARS_OD_RCS_Obj_01 ARS_OD_Orientation_Obj_01 ARS_OD_YawRateAbs_Obj_01 ARS_OD_YawRateAbsStd_Obj_01 ARS_OD_RefPoint_Obj_01 ARS_OD_LifeCycle_Obj_01 ARS_OD_OrientationStd_Obj_00 ARS_OD_OrientationStd_Obj_01 ARS_OD_ObstacleProb_Obj_00 ARS_OD_MicroDopplerFlag_00 ARS_OD_ObstacleProb_Obj_01 ARS_OD_VabsY_Obj_00 ARS_OD_MicroDopplerFlag_01 ARS_OD_ID_00 ARS_OD_ID_01 ARS_OD_MsgCounter_Obj_00_01 ARS_OD_CRC16_Checksum_Obj_00_01 ARS_OD_AabsY_Obj_00 ARS_OD_DistXStd_Obj_00 ARS_OD_DistYStd_Obj_00 ARS_OD_VabsXStd_Obj_00 ARS_OD_VabsYStd_Obj_00 ARS_OD_AabsXStd_Obj_00;
SIG_GROUP_ 514 Signal_Group_ARS_OD_02_03 1 : ARS_OD_DistX_Obj_02 ARS_OD_Classification_Obj_02 ARS_OD_AabsYStd_Obj_02 ARS_OD_ClassConf_Obj_02 ARS_OD_ProbOfExist_Obj_02 ARS_OD_DynConf_Obj_02 ARS_OD_VabsX_Obj_02 ARS_OD_DynProp_Obj_02 ARS_OD_MirrorProb_Obj_02 ARS_OD_Length_Obj_02 ARS_OD_MaintenanceState_Obj_02 ARS_OD_Width_Obj_02 ARS_OD_RCS_Obj_02 ARS_OD_Orientation_Obj_02 ARS_OD_YawRateAbs_Obj_02 ARS_OD_YawRateAbsStd_Obj_02 ARS_OD_RefPoint_Obj_02 ARS_OD_LifeCycle_Obj_02 ARS_OD_DistX_Obj_03 ARS_OD_VabsX_Obj_03 ARS_OD_AabsX_Obj_03 ARS_OD_AabsX_Obj_02 ARS_OD_DistY_Obj_03 ARS_OD_VabsY_Obj_03 ARS_OD_AabsY_Obj_03 ARS_OD_DistXStd_Obj_03 ARS_OD_DistYStd_Obj_03 ARS_OD_VabsXStd_Obj_03 ARS_OD_VabsYStd_Obj_03 ARS_OD_AabsXStd_Obj_03 ARS_OD_Classification_Obj_03 ARS_OD_AabsYStd_Obj_03 ARS_OD_ClassConf_Obj_03 ARS_OD_DistY_Obj_02 ARS_OD_ProbOfExist_Obj_03 ARS_OD_DynConf_Obj_03 ARS_OD_DynProp_Obj_03 ARS_OD_MirrorProb_Obj_03 ARS_OD_Length_Obj_03 ARS_OD_MaintenanceState_Obj_03 ARS_OD_Width_Obj_03 ARS_OD_RCS_Obj_03 ARS_OD_Orientation_Obj_03 ARS_OD_YawRateAbs_Obj_03 ARS_OD_YawRateAbsStd_Obj_03 ARS_OD_RefPoint_Obj_03 ARS_OD_LifeCycle_Obj_03 ARS_OD_OrientationStd_Obj_02 ARS_OD_OrientationStd_Obj_03 ARS_OD_ObstacleProb_Obj_02 ARS_OD_MicroDopplerFlag_02 ARS_OD_ObstacleProb_Obj_03 ARS_OD_VabsY_Obj_02 ARS_OD_MicroDopplerFlag_03 ARS_OD_ID_02 ARS_OD_ID_03 ARS_OD_MsgCounter_Obj_02_03 ARS_OD_CRC16_Checksum_Obj_02_03 ARS_OD_AabsY_Obj_02 ARS_OD_DistXStd_Obj_02 ARS_OD_DistYStd_Obj_02 ARS_OD_VabsXStd_Obj_02 ARS_OD_VabsYStd_Obj_02 ARS_OD_AabsXStd_Obj_02;
SIG_GROUP_ 515 Signal_Group_ARS_OD_04_05 1 : ARS_OD_DistX_Obj_04 ARS_OD_Classification_Obj_04 ARS_OD_AabsYStd_Obj_04 ARS_OD_ClassConf_Obj_04 ARS_OD_ProbOfExist_Obj_04 ARS_OD_DynConf_Obj_04 ARS_OD_VabsX_Obj_04 ARS_OD_DynProp_Obj_04 ARS_OD_MirrorProb_Obj_04 ARS_OD_Length_Obj_04 ARS_OD_MaintenanceState_Obj_04 ARS_OD_Width_Obj_04 ARS_OD_RCS_Obj_04 ARS_OD_Orientation_Obj_04 ARS_OD_YawRateAbs_Obj_04 ARS_OD_YawRateAbsStd_Obj_04 ARS_OD_RefPoint_Obj_04 ARS_OD_LifeCycle_Obj_04 ARS_OD_DistX_Obj_05 ARS_OD_VabsX_Obj_05 ARS_OD_AabsX_Obj_05 ARS_OD_AabsX_Obj_04 ARS_OD_DistY_Obj_05 ARS_OD_VabsY_Obj_05 ARS_OD_AabsY_Obj_05 ARS_OD_DistXStd_Obj_05 ARS_OD_DistYStd_Obj_05 ARS_OD_VabsXStd_Obj_05 ARS_OD_VabsYStd_Obj_05 ARS_OD_AabsXStd_Obj_05 ARS_OD_Classification_Obj_05 ARS_OD_AabsYStd_Obj_05 ARS_OD_ClassConf_Obj_05 ARS_OD_DistY_Obj_04 ARS_OD_ProbOfExist_Obj_05 ARS_OD_DynConf_Obj_05 ARS_OD_DynProp_Obj_05 ARS_OD_MirrorProb_Obj_05 ARS_OD_Length_Obj_05 ARS_OD_MaintenanceState_Obj_05 ARS_OD_Width_Obj_05 ARS_OD_RCS_Obj_05 ARS_OD_Orientation_Obj_05 ARS_OD_YawRateAbs_Obj_05 ARS_OD_YawRateAbsStd_Obj_05 ARS_OD_RefPoint_Obj_05 ARS_OD_LifeCycle_Obj_05 ARS_OD_OrientationStd_Obj_04 ARS_OD_OrientationStd_Obj_05 ARS_OD_ObstacleProb_Obj_04 ARS_OD_MicroDopplerFlag_04 ARS_OD_ObstacleProb_Obj_05 ARS_OD_VabsY_Obj_04 ARS_OD_MicroDopplerFlag_05 ARS_OD_ID_04 ARS_OD_ID_05 ARS_OD_MsgCounter_Obj_04_05 ARS_OD_CRC16_Checksum_Obj_04_05 ARS_OD_AabsY_Obj_04 ARS_OD_DistXStd_Obj_04 ARS_OD_DistYStd_Obj_04 ARS_OD_VabsXStd_Obj_04 ARS_OD_VabsYStd_Obj_04 ARS_OD_AabsXStd_Obj_04;
SIG_GROUP_ 516 Signal_Group_ARS_OD_06_07 1 : ARS_OD_DistX_Obj_06 ARS_OD_Classification_Obj_06 ARS_OD_AabsYStd_Obj_06 ARS_OD_ClassConf_Obj_06 ARS_OD_ProbOfExist_Obj_06 ARS_OD_DynConf_Obj_06 ARS_OD_VabsX_Obj_06 ARS_OD_DynProp_Obj_06 ARS_OD_MirrorProb_Obj_06 ARS_OD_Length_Obj_06 ARS_OD_MaintenanceState_Obj_06 ARS_OD_Width_Obj_06 ARS_OD_RCS_Obj_06 ARS_OD_Orientation_Obj_06 ARS_OD_YawRateAbs_Obj_06 ARS_OD_YawRateAbsStd_Obj_06 ARS_OD_RefPoint_Obj_06 ARS_OD_LifeCycle_Obj_06 ARS_OD_DistX_Obj_07 ARS_OD_VabsX_Obj_07 ARS_OD_AabsX_Obj_07 ARS_OD_AabsX_Obj_06 ARS_OD_DistY_Obj_07 ARS_OD_VabsY_Obj_07 ARS_OD_AabsY_Obj_07 ARS_OD_DistXStd_Obj_07 ARS_OD_DistYStd_Obj_07 ARS_OD_VabsXStd_Obj_07 ARS_OD_VabsYStd_Obj_07 ARS_OD_AabsXStd_Obj_07 ARS_OD_Classification_Obj_07 ARS_OD_AabsYStd_Obj_07 ARS_OD_ClassConf_Obj_07 ARS_OD_DistY_Obj_06 ARS_OD_ProbOfExist_Obj_07 ARS_OD_DynConf_Obj_07 ARS_OD_DynProp_Obj_07 ARS_OD_MirrorProb_Obj_07 ARS_OD_Length_Obj_07 ARS_OD_MaintenanceState_Obj_07 ARS_OD_Width_Obj_07 ARS_OD_RCS_Obj_07 ARS_OD_Orientation_Obj_07 ARS_OD_YawRateAbs_Obj_07 ARS_OD_YawRateAbsStd_Obj_07 ARS_OD_RefPoint_Obj_07 ARS_OD_LifeCycle_Obj_07 ARS_OD_OrientationStd_Obj_06 ARS_OD_OrientationStd_Obj_07 ARS_OD_ObstacleProb_Obj_06 ARS_OD_MicroDopplerFlag_06 ARS_OD_ObstacleProb_Obj_07 ARS_OD_VabsY_Obj_06 ARS_OD_MicroDopplerFlag_07 ARS_OD_ID_06 ARS_OD_ID_07 ARS_OD_MsgCounter_Obj_06_07 ARS_OD_CRC16_Checksum_Obj_06_07 ARS_OD_AabsY_Obj_06 ARS_OD_DistXStd_Obj_06 ARS_OD_DistYStd_Obj_06 ARS_OD_VabsXStd_Obj_06 ARS_OD_VabsYStd_Obj_06 ARS_OD_AabsXStd_Obj_06;
SIG_GROUP_ 517 Signal_Group_ARS_OD_08_09 1 : ARS_OD_DistX_Obj_08 ARS_OD_Classification_Obj_08 ARS_OD_AabsYStd_Obj_08 ARS_OD_ClassConf_Obj_08 ARS_OD_ProbOfExist_Obj_08 ARS_OD_DynConf_Obj_08 ARS_OD_VabsX_Obj_08 ARS_OD_DynProp_Obj_08 ARS_OD_MirrorProb_Obj_08 ARS_OD_Length_Obj_08 ARS_OD_MaintenanceState_Obj_08 ARS_OD_Width_Obj_08 ARS_OD_RCS_Obj_08 ARS_OD_Orientation_Obj_08 ARS_OD_YawRateAbs_Obj_08 ARS_OD_YawRateAbsStd_Obj_08 ARS_OD_RefPoint_Obj_08 ARS_OD_LifeCycle_Obj_08 ARS_OD_DistX_Obj_09 ARS_OD_VabsX_Obj_09 ARS_OD_AabsX_Obj_09 ARS_OD_AabsX_Obj_08 ARS_OD_DistY_Obj_09 ARS_OD_VabsY_Obj_09 ARS_OD_AabsY_Obj_09 ARS_OD_DistXStd_Obj_09 ARS_OD_DistYStd_Obj_09 ARS_OD_VabsXStd_Obj_09 ARS_OD_VabsYStd_Obj_09 ARS_OD_AabsXStd_Obj_09 ARS_OD_Classification_Obj_09 ARS_OD_AabsYStd_Obj_09 ARS_OD_ClassConf_Obj_09 ARS_OD_DistY_Obj_08 ARS_OD_ProbOfExist_Obj_09 ARS_OD_DynConf_Obj_09 ARS_OD_DynProp_Obj_09 ARS_OD_MirrorProb_Obj_09 ARS_OD_Length_Obj_09 ARS_OD_MaintenanceState_Obj_09 ARS_OD_Width_Obj_09 ARS_OD_RCS_Obj_09 ARS_OD_Orientation_Obj_09 ARS_OD_YawRateAbs_Obj_09 ARS_OD_YawRateAbsStd_Obj_09 ARS_OD_RefPoint_Obj_09 ARS_OD_LifeCycle_Obj_09 ARS_OD_OrientationStd_Obj_08 ARS_OD_OrientationStd_Obj_09 ARS_OD_ObstacleProb_Obj_08 ARS_OD_MicroDopplerFlag_08 ARS_OD_ObstacleProb_Obj_09 ARS_OD_VabsY_Obj_08 ARS_OD_MicroDopplerFlag_09 ARS_OD_ID_08 ARS_OD_ID_09 ARS_OD_MsgCounter_Obj_08_09 ARS_OD_CRC16_Checksum_Obj_08_09 ARS_OD_AabsY_Obj_08 ARS_OD_DistXStd_Obj_08 ARS_OD_DistYStd_Obj_08 ARS_OD_VabsXStd_Obj_08 ARS_OD_VabsYStd_Obj_08 ARS_OD_AabsXStd_Obj_08;
SIG_GROUP_ 518 Signal_Group_ARS_OD_10_11 1 : ARS_OD_DistX_Obj_10 ARS_OD_Classification_Obj_10 ARS_OD_AabsYStd_Obj_10 ARS_OD_ClassConf_Obj_10 ARS_OD_ProbOfExist_Obj_10 ARS_OD_DynConf_Obj_10 ARS_OD_VabsX_Obj_10 ARS_OD_DynProp_Obj_10 ARS_OD_MirrorProb_Obj_10 ARS_OD_Length_Obj_10 ARS_OD_MaintenanceState_Obj_10 ARS_OD_Width_Obj_10 ARS_OD_RCS_Obj_10 ARS_OD_Orientation_Obj_10 ARS_OD_YawRateAbs_Obj_10 ARS_OD_YawRateAbsStd_Obj_10 ARS_OD_RefPoint_Obj_10 ARS_OD_LifeCycle_Obj_10 ARS_OD_DistX_Obj_11 ARS_OD_VabsX_Obj_11 ARS_OD_AabsX_Obj_11 ARS_OD_AabsX_Obj_10 ARS_OD_DistY_Obj_11 ARS_OD_VabsY_Obj_11 ARS_OD_AabsY_Obj_11 ARS_OD_DistXStd_Obj_11 ARS_OD_DistYStd_Obj_11 ARS_OD_VabsXStd_Obj_11 ARS_OD_VabsYStd_Obj_11 ARS_OD_AabsXStd_Obj_11 ARS_OD_Classification_Obj_11 ARS_OD_AabsYStd_Obj_11 ARS_OD_ClassConf_Obj_11 ARS_OD_DistY_Obj_10 ARS_OD_ProbOfExist_Obj_11 ARS_OD_DynConf_Obj_11 ARS_OD_DynProp_Obj_11 ARS_OD_MirrorProb_Obj_11 ARS_OD_Length_Obj_11 ARS_OD_MaintenanceState_Obj_11 ARS_OD_Width_Obj_11 ARS_OD_RCS_Obj_11 ARS_OD_Orientation_Obj_11 ARS_OD_YawRateAbs_Obj_11 ARS_OD_YawRateAbsStd_Obj_11 ARS_OD_RefPoint_Obj_11 ARS_OD_LifeCycle_Obj_11 ARS_OD_OrientationStd_Obj_10 ARS_OD_OrientationStd_Obj_11 ARS_OD_ObstacleProb_Obj_10 ARS_OD_MicroDopplerFlag_10 ARS_OD_ObstacleProb_Obj_11 ARS_OD_VabsY_Obj_10 ARS_OD_MicroDopplerFlag_11 ARS_OD_ID_10 ARS_OD_ID_11 ARS_OD_MsgCounter_Obj_10_11 ARS_OD_CRC16_Checksum_Obj_10_11 ARS_OD_AabsY_Obj_10 ARS_OD_DistXStd_Obj_10 ARS_OD_DistYStd_Obj_10 ARS_OD_VabsXStd_Obj_10 ARS_OD_VabsYStd_Obj_10 ARS_OD_AabsXStd_Obj_10;
SIG_GROUP_ 519 Signal_Group_ARS_OD_12_13 1 : ARS_OD_DistX_Obj_12 ARS_OD_Classification_Obj_12 ARS_OD_AabsYStd_Obj_12 ARS_OD_ClassConf_Obj_12 ARS_OD_ProbOfExist_Obj_12 ARS_OD_DynConf_Obj_12 ARS_OD_VabsX_Obj_12 ARS_OD_DynProp_Obj_12 ARS_OD_MirrorProb_Obj_12 ARS_OD_Length_Obj_12 ARS_OD_MaintenanceState_Obj_12 ARS_OD_Width_Obj_12 ARS_OD_RCS_Obj_12 ARS_OD_Orientation_Obj_12 ARS_OD_YawRateAbs_Obj_12 ARS_OD_YawRateAbsStd_Obj_12 ARS_OD_RefPoint_Obj_12 ARS_OD_LifeCycle_Obj_12 ARS_OD_DistX_Obj_13 ARS_OD_VabsX_Obj_13 ARS_OD_AabsX_Obj_13 ARS_OD_AabsX_Obj_12 ARS_OD_DistY_Obj_13 ARS_OD_VabsY_Obj_13 ARS_OD_AabsY_Obj_13 ARS_OD_DistXStd_Obj_13 ARS_OD_DistYStd_Obj_13 ARS_OD_VabsXStd_Obj_13 ARS_OD_VabsYStd_Obj_13 ARS_OD_AabsXStd_Obj_13 ARS_OD_Classification_Obj_13 ARS_OD_AabsYStd_Obj_13 ARS_OD_ClassConf_Obj_13 ARS_OD_DistY_Obj_12 ARS_OD_ProbOfExist_Obj_13 ARS_OD_DynConf_Obj_13 ARS_OD_DynProp_Obj_13 ARS_OD_MirrorProb_Obj_13 ARS_OD_Length_Obj_13 ARS_OD_MaintenanceState_Obj_13 ARS_OD_Width_Obj_13 ARS_OD_RCS_Obj_13 ARS_OD_Orientation_Obj_13 ARS_OD_YawRateAbs_Obj_13 ARS_OD_YawRateAbsStd_Obj_13 ARS_OD_RefPoint_Obj_13 ARS_OD_LifeCycle_Obj_13 ARS_OD_OrientationStd_Obj_12 ARS_OD_OrientationStd_Obj_13 ARS_OD_ObstacleProb_Obj_12 ARS_OD_MicroDopplerFlag_12 ARS_OD_ObstacleProb_Obj_13 ARS_OD_VabsY_Obj_12 ARS_OD_MicroDopplerFlag_13 ARS_OD_ID_12 ARS_OD_ID_13 ARS_OD_MsgCounter_Obj_12_13 ARS_OD_CRC16_Checksum_Obj_12_13 ARS_OD_AabsY_Obj_12 ARS_OD_DistXStd_Obj_12 ARS_OD_DistYStd_Obj_12 ARS_OD_VabsXStd_Obj_12 ARS_OD_VabsYStd_Obj_12 ARS_OD_AabsXStd_Obj_12;
SIG_GROUP_ 520 Signal_Group_ARS_OD_14_15 1 : ARS_OD_DistX_Obj_14 ARS_OD_Classification_Obj_14 ARS_OD_AabsYStd_Obj_14 ARS_OD_ClassConf_Obj_14 ARS_OD_ProbOfExist_Obj_14 ARS_OD_DynConf_Obj_14 ARS_OD_VabsX_Obj_14 ARS_OD_DynProp_Obj_14 ARS_OD_MirrorProb_Obj_14 ARS_OD_Length_Obj_14 ARS_OD_MaintenanceState_Obj_14 ARS_OD_Width_Obj_14 ARS_OD_RCS_Obj_14 ARS_OD_Orientation_Obj_14 ARS_OD_YawRateAbs_Obj_14 ARS_OD_YawRateAbsStd_Obj_14 ARS_OD_RefPoint_Obj_14 ARS_OD_LifeCycle_Obj_14 ARS_OD_DistX_Obj_15 ARS_OD_VabsX_Obj_15 ARS_OD_AabsX_Obj_15 ARS_OD_AabsX_Obj_14 ARS_OD_DistY_Obj_15 ARS_OD_VabsY_Obj_15 ARS_OD_AabsY_Obj_15 ARS_OD_DistXStd_Obj_15 ARS_OD_DistYStd_Obj_15 ARS_OD_VabsXStd_Obj_15 ARS_OD_VabsYStd_Obj_15 ARS_OD_AabsXStd_Obj_15 ARS_OD_Classification_Obj_15 ARS_OD_AabsYStd_Obj_15 ARS_OD_ClassConf_Obj_15 ARS_OD_DistY_Obj_14 ARS_OD_ProbOfExist_Obj_15 ARS_OD_DynConf_Obj_15 ARS_OD_DynProp_Obj_15 ARS_OD_MirrorProb_Obj_15 ARS_OD_Length_Obj_15 ARS_OD_MaintenanceState_Obj_15 ARS_OD_Width_Obj_15 ARS_OD_RCS_Obj_15 ARS_OD_Orientation_Obj_15 ARS_OD_YawRateAbs_Obj_15 ARS_OD_YawRateAbsStd_Obj_15 ARS_OD_RefPoint_Obj_15 ARS_OD_LifeCycle_Obj_15 ARS_OD_OrientationStd_Obj_14 ARS_OD_OrientationStd_Obj_15 ARS_OD_ObstacleProb_Obj_14 ARS_OD_MicroDopplerFlag_14 ARS_OD_ObstacleProb_Obj_15 ARS_OD_VabsY_Obj_14 ARS_OD_MicroDopplerFlag_15 ARS_OD_ID_14 ARS_OD_ID_15 ARS_OD_MsgCounter_Obj_14_15 ARS_OD_CRC16_Checksum_Obj_14_15 ARS_OD_AabsY_Obj_14 ARS_OD_DistXStd_Obj_14 ARS_OD_DistYStd_Obj_14 ARS_OD_VabsXStd_Obj_14 ARS_OD_VabsYStd_Obj_14 ARS_OD_AabsXStd_Obj_14;
SIG_GROUP_ 521 Signal_Group_ARS_OD_16_17 1 : ARS_OD_DistX_Obj_16 ARS_OD_Classification_Obj_16 ARS_OD_AabsYStd_Obj_16 ARS_OD_ClassConf_Obj_16 ARS_OD_ProbOfExist_Obj_16 ARS_OD_DynConf_Obj_16 ARS_OD_VabsX_Obj_16 ARS_OD_DynProp_Obj_16 ARS_OD_MirrorProb_Obj_16 ARS_OD_Length_Obj_16 ARS_OD_MaintenanceState_Obj_16 ARS_OD_Width_Obj_16 ARS_OD_RCS_Obj_16 ARS_OD_Orientation_Obj_16 ARS_OD_YawRateAbs_Obj_16 ARS_OD_YawRateAbsStd_Obj_16 ARS_OD_RefPoint_Obj_16 ARS_OD_LifeCycle_Obj_16 ARS_OD_DistX_Obj_17 ARS_OD_VabsX_Obj_17 ARS_OD_AabsX_Obj_17 ARS_OD_AabsX_Obj_16 ARS_OD_DistY_Obj_17 ARS_OD_VabsY_Obj_17 ARS_OD_AabsY_Obj_17 ARS_OD_DistXStd_Obj_17 ARS_OD_DistYStd_Obj_17 ARS_OD_VabsXStd_Obj_17 ARS_OD_VabsYStd_Obj_17 ARS_OD_AabsXStd_Obj_17 ARS_OD_Classification_Obj_17 ARS_OD_AabsYStd_Obj_17 ARS_OD_ClassConf_Obj_17 ARS_OD_DistY_Obj_16 ARS_OD_ProbOfExist_Obj_17 ARS_OD_DynConf_Obj_17 ARS_OD_DynProp_Obj_17 ARS_OD_MirrorProb_Obj_17 ARS_OD_Length_Obj_17 ARS_OD_MaintenanceState_Obj_17 ARS_OD_Width_Obj_17 ARS_OD_RCS_Obj_17 ARS_OD_Orientation_Obj_17 ARS_OD_YawRateAbs_Obj_17 ARS_OD_YawRateAbsStd_Obj_17 ARS_OD_RefPoint_Obj_17 ARS_OD_LifeCycle_Obj_17 ARS_OD_OrientationStd_Obj_16 ARS_OD_OrientationStd_Obj_17 ARS_OD_ObstacleProb_Obj_16 ARS_OD_MicroDopplerFlag_16 ARS_OD_ObstacleProb_Obj_17 ARS_OD_VabsY_Obj_16 ARS_OD_MicroDopplerFlag_17 ARS_OD_ID_16 ARS_OD_ID_17 ARS_OD_MsgCounter_Obj_16_17 ARS_OD_CRC16_Checksum_Obj_16_17 ARS_OD_AabsY_Obj_16 ARS_OD_DistXStd_Obj_16 ARS_OD_DistYStd_Obj_16 ARS_OD_VabsXStd_Obj_16 ARS_OD_VabsYStd_Obj_16 ARS_OD_AabsXStd_Obj_16;
SIG_GROUP_ 522 Signal_Group_ARS_OD_18_19 1 : ARS_OD_DistX_Obj_18 ARS_OD_Classification_Obj_18 ARS_OD_AabsYStd_Obj_18 ARS_OD_ClassConf_Obj_18 ARS_OD_ProbOfExist_Obj_18 ARS_OD_DynConf_Obj_18 ARS_OD_VabsX_Obj_18 ARS_OD_DynProp_Obj_18 ARS_OD_MirrorProb_Obj_18 ARS_OD_Length_Obj_18 ARS_OD_MaintenanceState_Obj_18 ARS_OD_Width_Obj_18 ARS_OD_RCS_Obj_18 ARS_OD_Orientation_Obj_18 ARS_OD_YawRateAbs_Obj_18 ARS_OD_YawRateAbsStd_Obj_18 ARS_OD_RefPoint_Obj_18 ARS_OD_LifeCycle_Obj_18 ARS_OD_DistX_Obj_19 ARS_OD_VabsX_Obj_19 ARS_OD_AabsX_Obj_19 ARS_OD_AabsX_Obj_18 ARS_OD_DistY_Obj_19 ARS_OD_VabsY_Obj_19 ARS_OD_AabsY_Obj_19 ARS_OD_DistXStd_Obj_19 ARS_OD_DistYStd_Obj_19 ARS_OD_VabsXStd_Obj_19 ARS_OD_VabsYStd_Obj_19 ARS_OD_AabsXStd_Obj_19 ARS_OD_Classification_Obj_19 ARS_OD_AabsYStd_Obj_19 ARS_OD_ClassConf_Obj_19 ARS_OD_DistY_Obj_18 ARS_OD_ProbOfExist_Obj_19 ARS_OD_DynConf_Obj_19 ARS_OD_DynProp_Obj_19 ARS_OD_MirrorProb_Obj_19 ARS_OD_Length_Obj_19 ARS_OD_MaintenanceState_Obj_19 ARS_OD_Width_Obj_19 ARS_OD_RCS_Obj_19 ARS_OD_Orientation_Obj_19 ARS_OD_YawRateAbs_Obj_19 ARS_OD_YawRateAbsStd_Obj_19 ARS_OD_RefPoint_Obj_19 ARS_OD_LifeCycle_Obj_19 ARS_OD_OrientationStd_Obj_18 ARS_OD_OrientationStd_Obj_19 ARS_OD_ObstacleProb_Obj_18 ARS_OD_MicroDopplerFlag_18 ARS_OD_ObstacleProb_Obj_19 ARS_OD_VabsY_Obj_18 ARS_OD_MicroDopplerFlag_19 ARS_OD_ID_18 ARS_OD_ID_19 ARS_OD_MsgCounter_Obj_18_19 ARS_OD_CRC16_Checksum_Obj_18_19 ARS_OD_AabsY_Obj_18 ARS_OD_DistXStd_Obj_18 ARS_OD_DistYStd_Obj_18 ARS_OD_VabsXStd_Obj_18 ARS_OD_VabsYStd_Obj_18 ARS_OD_AabsXStd_Obj_18;
SIG_GROUP_ 523 Signal_Group_ARS_OD_20_21 1 : ARS_OD_DistX_Obj_20 ARS_OD_Classification_Obj_20 ARS_OD_AabsYStd_Obj_20 ARS_OD_ClassConf_Obj_20 ARS_OD_ProbOfExist_Obj_20 ARS_OD_DynConf_Obj_20 ARS_OD_VabsX_Obj_20 ARS_OD_DynProp_Obj_20 ARS_OD_MirrorProb_Obj_20 ARS_OD_Length_Obj_20 ARS_OD_MaintenanceState_Obj_20 ARS_OD_Width_Obj_20 ARS_OD_RCS_Obj_20 ARS_OD_Orientation_Obj_20 ARS_OD_YawRateAbs_Obj_20 ARS_OD_YawRateAbsStd_Obj_20 ARS_OD_RefPoint_Obj_20 ARS_OD_LifeCycle_Obj_20 ARS_OD_DistX_Obj_21 ARS_OD_VabsX_Obj_21 ARS_OD_AabsX_Obj_21 ARS_OD_AabsX_Obj_20 ARS_OD_DistY_Obj_21 ARS_OD_VabsY_Obj_21 ARS_OD_AabsY_Obj_21 ARS_OD_DistXStd_Obj_21 ARS_OD_DistYStd_Obj_21 ARS_OD_VabsXStd_Obj_21 ARS_OD_VabsYStd_Obj_21 ARS_OD_AabsXStd_Obj_21 ARS_OD_Classification_Obj_21 ARS_OD_AabsYStd_Obj_21 ARS_OD_ClassConf_Obj_21 ARS_OD_DistY_Obj_20 ARS_OD_ProbOfExist_Obj_21 ARS_OD_DynConf_Obj_21 ARS_OD_DynProp_Obj_21 ARS_OD_MirrorProb_Obj_21 ARS_OD_Length_Obj_21 ARS_OD_MaintenanceState_Obj_21 ARS_OD_Width_Obj_21 ARS_OD_RCS_Obj_21 ARS_OD_Orientation_Obj_21 ARS_OD_YawRateAbs_Obj_21 ARS_OD_YawRateAbsStd_Obj_21 ARS_OD_RefPoint_Obj_21 ARS_OD_LifeCycle_Obj_21 ARS_OD_OrientationStd_Obj_20 ARS_OD_OrientationStd_Obj_21 ARS_OD_ObstacleProb_Obj_20 ARS_OD_MicroDopplerFlag_20 ARS_OD_ObstacleProb_Obj_21 ARS_OD_VabsY_Obj_20 ARS_OD_MicroDopplerFlag_21 ARS_OD_ID_20 ARS_OD_ID_21 ARS_OD_MsgCounter_Obj_20_21 ARS_OD_CRC16_Checksum_Obj_20_21 ARS_OD_AabsY_Obj_20 ARS_OD_DistXStd_Obj_20 ARS_OD_DistYStd_Obj_20 ARS_OD_VabsXStd_Obj_20 ARS_OD_VabsYStd_Obj_20 ARS_OD_AabsXStd_Obj_20;
SIG_GROUP_ 524 Signal_Group_ARS_OD_22_23 1 : ARS_OD_DistX_Obj_22 ARS_OD_Classification_Obj_22 ARS_OD_AabsYStd_Obj_22 ARS_OD_ClassConf_Obj_22 ARS_OD_ProbOfExist_Obj_22 ARS_OD_DynConf_Obj_22 ARS_OD_VabsX_Obj_22 ARS_OD_DynProp_Obj_22 ARS_OD_MirrorProb_Obj_22 ARS_OD_Length_Obj_22 ARS_OD_MaintenanceState_Obj_22 ARS_OD_Width_Obj_22 ARS_OD_RCS_Obj_22 ARS_OD_Orientation_Obj_22 ARS_OD_YawRateAbs_Obj_22 ARS_OD_YawRateAbsStd_Obj_22 ARS_OD_RefPoint_Obj_22 ARS_OD_LifeCycle_Obj_22 ARS_OD_DistX_Obj_23 ARS_OD_VabsX_Obj_23 ARS_OD_AabsX_Obj_23 ARS_OD_AabsX_Obj_22 ARS_OD_DistY_Obj_23 ARS_OD_VabsY_Obj_23 ARS_OD_AabsY_Obj_23 ARS_OD_DistXStd_Obj_23 ARS_OD_DistYStd_Obj_23 ARS_OD_VabsXStd_Obj_23 ARS_OD_VabsYStd_Obj_23 ARS_OD_AabsXStd_Obj_23 ARS_OD_Classification_Obj_23 ARS_OD_AabsYStd_Obj_23 ARS_OD_ClassConf_Obj_23 ARS_OD_DistY_Obj_22 ARS_OD_ProbOfExist_Obj_23 ARS_OD_DynConf_Obj_23 ARS_OD_DynProp_Obj_23 ARS_OD_MirrorProb_Obj_23 ARS_OD_Length_Obj_23 ARS_OD_MaintenanceState_Obj_23 ARS_OD_Width_Obj_23 ARS_OD_RCS_Obj_23 ARS_OD_Orientation_Obj_23 ARS_OD_YawRateAbs_Obj_23 ARS_OD_YawRateAbsStd_Obj_23 ARS_OD_RefPoint_Obj_23 ARS_OD_LifeCycle_Obj_23 ARS_OD_OrientationStd_Obj_22 ARS_OD_OrientationStd_Obj_23 ARS_OD_ObstacleProb_Obj_22 ARS_OD_MicroDopplerFlag_22 ARS_OD_ObstacleProb_Obj_23 ARS_OD_VabsY_Obj_22 ARS_OD_MicroDopplerFlag_23 ARS_OD_ID_22 ARS_OD_ID_23 ARS_OD_MsgCounter_Obj_22_23 ARS_OD_CRC16_Checksum_Obj_22_23 ARS_OD_AabsY_Obj_22 ARS_OD_DistXStd_Obj_22 ARS_OD_DistYStd_Obj_22 ARS_OD_VabsXStd_Obj_22 ARS_OD_VabsYStd_Obj_22 ARS_OD_AabsXStd_Obj_22;
SIG_GROUP_ 525 Signal_Group_ARS_OD_24_25 1 : ARS_OD_DistX_Obj_24 ARS_OD_Classification_Obj_24 ARS_OD_AabsYStd_Obj_24 ARS_OD_ClassConf_Obj_24 ARS_OD_ProbOfExist_Obj_24 ARS_OD_DynConf_Obj_24 ARS_OD_VabsX_Obj_24 ARS_OD_DynProp_Obj_24 ARS_OD_MirrorProb_Obj_24 ARS_OD_Length_Obj_24 ARS_OD_MaintenanceState_Obj_24 ARS_OD_Width_Obj_24 ARS_OD_RCS_Obj_24 ARS_OD_Orientation_Obj_24 ARS_OD_YawRateAbs_Obj_24 ARS_OD_YawRateAbsStd_Obj_24 ARS_OD_RefPoint_Obj_24 ARS_OD_LifeCycle_Obj_24 ARS_OD_DistX_Obj_25 ARS_OD_VabsX_Obj_25 ARS_OD_AabsX_Obj_25 ARS_OD_AabsX_Obj_24 ARS_OD_DistY_Obj_25 ARS_OD_VabsY_Obj_25 ARS_OD_AabsY_Obj_25 ARS_OD_DistXStd_Obj_25 ARS_OD_DistYStd_Obj_25 ARS_OD_VabsXStd_Obj_25 ARS_OD_VabsYStd_Obj_25 ARS_OD_AabsXStd_Obj_25 ARS_OD_Classification_Obj_25 ARS_OD_AabsYStd_Obj_25 ARS_OD_ClassConf_Obj_25 ARS_OD_DistY_Obj_24 ARS_OD_ProbOfExist_Obj_25 ARS_OD_DynConf_Obj_25 ARS_OD_DynProp_Obj_25 ARS_OD_MirrorProb_Obj_25 ARS_OD_Length_Obj_25 ARS_OD_MaintenanceState_Obj_25 ARS_OD_Width_Obj_25 ARS_OD_RCS_Obj_25 ARS_OD_Orientation_Obj_25 ARS_OD_YawRateAbs_Obj_25 ARS_OD_YawRateAbsStd_Obj_25 ARS_OD_RefPoint_Obj_25 ARS_OD_LifeCycle_Obj_25 ARS_OD_OrientationStd_Obj_24 ARS_OD_OrientationStd_Obj_25 ARS_OD_ObstacleProb_Obj_24 ARS_OD_MicroDopplerFlag_24 ARS_OD_ObstacleProb_Obj_25 ARS_OD_VabsY_Obj_24 ARS_OD_MicroDopplerFlag_25 ARS_OD_ID_24 ARS_OD_ID_25 ARS_OD_MsgCounter_Obj_24_25 ARS_OD_CRC16_Checksum_Obj_24_25 ARS_OD_AabsY_Obj_24 ARS_OD_DistXStd_Obj_24 ARS_OD_DistYStd_Obj_24 ARS_OD_VabsXStd_Obj_24 ARS_OD_VabsYStd_Obj_24 ARS_OD_AabsXStd_Obj_24;
SIG_GROUP_ 526 Signal_Group_ARS_OD_26_27 1 : ARS_OD_DistX_Obj_26 ARS_OD_Classification_Obj_26 ARS_OD_AabsYStd_Obj_26 ARS_OD_ClassConf_Obj_26 ARS_OD_ProbOfExist_Obj_26 ARS_OD_DynConf_Obj_26 ARS_OD_VabsX_Obj_26 ARS_OD_DynProp_Obj_26 ARS_OD_MirrorProb_Obj_26 ARS_OD_Length_Obj_26 ARS_OD_MaintenanceState_Obj_26 ARS_OD_Width_Obj_26 ARS_OD_RCS_Obj_26 ARS_OD_Orientation_Obj_26 ARS_OD_YawRateAbs_Obj_26 ARS_OD_YawRateAbsStd_Obj_26 ARS_OD_RefPoint_Obj_26 ARS_OD_LifeCycle_Obj_26 ARS_OD_DistX_Obj_27 ARS_OD_VabsX_Obj_27 ARS_OD_AabsX_Obj_27 ARS_OD_AabsX_Obj_26 ARS_OD_DistY_Obj_27 ARS_OD_VabsY_Obj_27 ARS_OD_AabsY_Obj_27 ARS_OD_DistXStd_Obj_27 ARS_OD_DistYStd_Obj_27 ARS_OD_VabsXStd_Obj_27 ARS_OD_VabsYStd_Obj_27 ARS_OD_AabsXStd_Obj_27 ARS_OD_Classification_Obj_27 ARS_OD_AabsYStd_Obj_27 ARS_OD_ClassConf_Obj_27 ARS_OD_DistY_Obj_26 ARS_OD_ProbOfExist_Obj_27 ARS_OD_DynConf_Obj_27 ARS_OD_DynProp_Obj_27 ARS_OD_MirrorProb_Obj_27 ARS_OD_Length_Obj_27 ARS_OD_MaintenanceState_Obj_27 ARS_OD_Width_Obj_27 ARS_OD_RCS_Obj_27 ARS_OD_Orientation_Obj_27 ARS_OD_YawRateAbs_Obj_27 ARS_OD_YawRateAbsStd_Obj_27 ARS_OD_RefPoint_Obj_27 ARS_OD_LifeCycle_Obj_27 ARS_OD_OrientationStd_Obj_26 ARS_OD_OrientationStd_Obj_27 ARS_OD_ObstacleProb_Obj_26 ARS_OD_MicroDopplerFlag_26 ARS_OD_ObstacleProb_Obj_27 ARS_OD_VabsY_Obj_26 ARS_OD_MicroDopplerFlag_27 ARS_OD_ID_26 ARS_OD_ID_27 ARS_OD_MsgCounter_Obj_26_27 ARS_OD_CRC16_Checksum_Obj_26_27 ARS_OD_AabsY_Obj_26 ARS_OD_DistXStd_Obj_26 ARS_OD_DistYStd_Obj_26 ARS_OD_VabsXStd_Obj_26 ARS_OD_VabsYStd_Obj_26 ARS_OD_AabsXStd_Obj_26;
