VERSION "created by canmatrix"

NS_ :

BS_:

BU_: FR GW

BO_ 288 ARS_RDI_224_231: 64 FR
 SG_ ARS_RDI_Range_Clu_224 : 7|12@0+ (0.0625,0) [0|255.9375] "m"  GW
 SG_ ARS_RDI_ElevationAng_Clu_225 : 109|7@0+ (0.005,-0.315) [-0.315|0.32] "rad"  GW
 SG_ ARS_RDI_SNR_Clu_225 : 118|7@0+ (0.5,0) [0|63.5] "dB"  GW
 SG_ ARS_RDI_Range_Clu_226 : 127|12@0+ (0.0625,0) [0|255.9375] "m"  GW
 SG_ ARS_RDI_VradRel_Clu_224 : 11|11@0+ (0.1,-120) [-120|84.7] "m/s"  GW
 SG_ ARS_RDI_VradRel_Clu_226 : 131|11@0+ (0.1,-120) [-120|84.7] "m/s"  GW
 SG_ ARS_RDI_RCS_Clu_226 : 136|9@0+ (0.2,-51.2) [-51.2|51] "dBsm"  GW
 SG_ ARS_RDI_AzimuthAng_Clu_226 : 159|10@0+ (0.002,-1.022) [-1.022|1.024] "rad"  GW
 SG_ ARS_RDI_ElevationAng_Clu_226 : 165|7@0+ (0.005,-0.315) [-0.315|0.32] "rad"  GW
 SG_ ARS_RDI_SNR_Clu_226 : 174|7@0+ (0.5,0) [0|63.5] "dB"  GW
 SG_ ARS_RDI_DynProp_Clu_226 : 183|2@0+ (1,0) [0|3] ""  GW
 SG_ ARS_RDI_Quality_Clu_226 : 181|2@0+ (1,0) [0|3] ""  GW
 SG_ ARS_RDI_DynProp_Clu_227 : 179|2@0+ (1,0) [0|3] ""  GW
 SG_ ARS_RDI_Quality_Clu_227 : 177|2@0+ (1,0) [0|3] ""  GW
 SG_ ARS_RDI_Range_Clu_227 : 191|12@0+ (0.0625,0) [0|255.9375] "m"  GW
 SG_ ARS_RDI_VradRel_Clu_227 : 195|11@0+ (0.1,-120) [-120|84.7] "m/s"  GW
 SG_ ARS_RDI_RCS_Clu_227 : 200|9@0+ (0.2,-51.2) [-51.2|51] "dBsm"  GW
 SG_ ARS_RDI_AzimuthAng_Clu_227 : 223|10@0+ (0.002,-1.022) [-1.022|1.024] "rad"  GW
 SG_ ARS_RDI_ElevationAng_Clu_227 : 229|7@0+ (0.005,-0.315) [-0.315|0.32] "rad"  GW
 SG_ ARS_RDI_SNR_Clu_227 : 238|7@0+ (0.5,0) [0|63.5] "dB"  GW
 SG_ ARS_RDI_RCS_Clu_224 : 16|9@0+ (0.2,-51.2) [-51.2|51] "dBsm"  GW
 SG_ ARS_RDI_Range_Clu_228 : 247|12@0+ (0.0625,0) [0|255.9375] "m"  GW
 SG_ ARS_RDI_VradRel_Clu_228 : 251|11@0+ (0.1,-120) [-120|84.7] "m/s"  GW
 SG_ ARS_RDI_RCS_Clu_228 : 256|9@0+ (0.2,-51.2) [-51.2|51] "dBsm"  GW
 SG_ ARS_RDI_AzimuthAng_Clu_228 : 279|10@0+ (0.002,-1.022) [-1.022|1.024] "rad"  GW
 SG_ ARS_RDI_ElevationAng_Clu_228 : 285|7@0+ (0.005,-0.315) [-0.315|0.32] "rad"  GW
 SG_ ARS_RDI_SNR_Clu_228 : 294|7@0+ (0.5,0) [0|63.5] "dB"  GW
 SG_ ARS_RDI_DynProp_Clu_228 : 303|2@0+ (1,0) [0|3] ""  GW
 SG_ ARS_RDI_Quality_Clu_228 : 301|2@0+ (1,0) [0|3] ""  GW
 SG_ ARS_RDI_DynProp_Clu_229 : 299|2@0+ (1,0) [0|3] ""  GW
 SG_ ARS_RDI_Quality_Clu_229 : 297|2@0+ (1,0) [0|3] ""  GW
 SG_ ARS_RDI_Range_Clu_229 : 311|12@0+ (0.0625,0) [0|255.9375] "m"  GW
 SG_ ARS_RDI_VradRel_Clu_229 : 315|11@0+ (0.1,-120) [-120|84.7] "m/s"  GW
 SG_ ARS_RDI_RCS_Clu_229 : 320|9@0+ (0.2,-51.2) [-51.2|51] "dBsm"  GW
 SG_ ARS_RDI_AzimuthAng_Clu_224 : 39|10@0+ (0.002,-1.022) [-1.022|1.024] "rad"  GW
 SG_ ARS_RDI_AzimuthAng_Clu_229 : 343|10@0+ (0.002,-1.022) [-1.022|1.024] "rad"  GW
 SG_ ARS_RDI_ElevationAng_Clu_229 : 349|7@0+ (0.005,-0.315) [-0.315|0.32] "rad"  GW
 SG_ ARS_RDI_SNR_Clu_229 : 358|7@0+ (0.5,0) [0|63.5] "dB"  GW
 SG_ ARS_RDI_Range_Clu_230 : 367|12@0+ (0.0625,0) [0|255.9375] "m"  GW
 SG_ ARS_RDI_VradRel_Clu_230 : 371|11@0+ (0.1,-120) [-120|84.7] "m/s"  GW
 SG_ ARS_RDI_RCS_Clu_230 : 376|9@0+ (0.2,-51.2) [-51.2|51] "dBsm"  GW
 SG_ ARS_RDI_AzimuthAng_Clu_230 : 399|10@0+ (0.002,-1.022) [-1.022|1.024] "rad"  GW
 SG_ ARS_RDI_ElevationAng_Clu_230 : 405|7@0+ (0.005,-0.315) [-0.315|0.32] "rad"  GW
 SG_ ARS_RDI_SNR_Clu_230 : 414|7@0+ (0.5,0) [0|63.5] "dB"  GW
 SG_ ARS_RDI_DynProp_Clu_230 : 423|2@0+ (1,0) [0|3] ""  GW
 SG_ ARS_RDI_Quality_Clu_230 : 421|2@0+ (1,0) [0|3] ""  GW
 SG_ ARS_RDI_DynProp_Clu_231 : 419|2@0+ (1,0) [0|3] ""  GW
 SG_ ARS_RDI_Quality_Clu_231 : 417|2@0+ (1,0) [0|3] ""  GW
 SG_ ARS_RDI_Range_Clu_231 : 431|12@0+ (0.0625,0) [0|255.9375] "m"  GW
 SG_ ARS_RDI_ElevationAng_Clu_224 : 45|7@0+ (0.005,-0.315) [-0.315|0.32] "rad"  GW
 SG_ ARS_RDI_VradRel_Clu_231 : 435|11@0+ (0.1,-120) [-120|84.7] "m/s"  GW
 SG_ ARS_RDI_RCS_Clu_231 : 440|9@0+ (0.2,-51.2) [-51.2|51] "dBsm"  GW
 SG_ ARS_RDI_AzimuthAng_Clu_231 : 463|10@0+ (0.002,-1.022) [-1.022|1.024] "rad"  GW
 SG_ ARS_RDI_ElevationAng_Clu_231 : 469|7@0+ (0.005,-0.315) [-0.315|0.32] "rad"  GW
 SG_ ARS_RDI_SNR_Clu_231 : 478|7@0+ (0.5,0) [0|63.5] "dB"  GW
 SG_ ARS_RDI_MsgCounter_Clu_224_231 : 495|8@0+ (1,0) [0|255] ""  GW
 SG_ ARS_RDI_CRC16_Checksum_Clu_224_2 : 503|16@0+ (1,0) [0|65535] ""  GW
 SG_ ARS_RDI_SNR_Clu_224 : 54|7@0+ (0.5,0) [0|63.5] "dB"  GW
 SG_ ARS_RDI_DynProp_Clu_224 : 63|2@0+ (1,0) [0|3] ""  GW
 SG_ ARS_RDI_Quality_Clu_224 : 61|2@0+ (1,0) [0|3] ""  GW
 SG_ ARS_RDI_DynProp_Clu_225 : 59|2@0+ (1,0) [0|3] ""  GW
 SG_ ARS_RDI_Quality_Clu_225 : 57|2@0+ (1,0) [0|3] ""  GW
 SG_ ARS_RDI_Range_Clu_225 : 71|12@0+ (0.0625,0) [0|255.9375] "m"  GW
 SG_ ARS_RDI_VradRel_Clu_225 : 75|11@0+ (0.1,-120) [-120|84.7] "m/s"  GW
 SG_ ARS_RDI_RCS_Clu_225 : 80|9@0+ (0.2,-51.2) [-51.2|51] "dBsm"  GW
 SG_ ARS_RDI_AzimuthAng_Clu_225 : 103|10@0+ (0.002,-1.022) [-1.022|1.024] "rad"  GW

BO_ 289 ARS_RDI_232_239: 64 FR
 SG_ ARS_RDI_Range_Clu_232 : 7|12@0+ (0.0625,0) [0|255.9375] "m"  GW
 SG_ ARS_RDI_ElevationAng_Clu_233 : 109|7@0+ (0.005,-0.315) [-0.315|0.32] "rad"  GW
 SG_ ARS_RDI_SNR_Clu_233 : 118|7@0+ (0.5,0) [0|63.5] "dB"  GW
 SG_ ARS_RDI_Range_Clu_234 : 127|12@0+ (0.0625,0) [0|255.9375] "m"  GW
 SG_ ARS_RDI_VradRel_Clu_232 : 11|11@0+ (0.1,-120) [-120|84.7] "m/s"  GW
 SG_ ARS_RDI_VradRel_Clu_234 : 131|11@0+ (0.1,-120) [-120|84.7] "m/s"  GW
 SG_ ARS_RDI_RCS_Clu_234 : 136|9@0+ (0.2,-51.2) [-51.2|51] "dBsm"  GW
 SG_ ARS_RDI_AzimuthAng_Clu_234 : 159|10@0+ (0.002,-1.022) [-1.022|1.024] "rad"  GW
 SG_ ARS_RDI_ElevationAng_Clu_234 : 165|7@0+ (0.005,-0.315) [-0.315|0.32] "rad"  GW
 SG_ ARS_RDI_SNR_Clu_234 : 174|7@0+ (0.5,0) [0|63.5] "dB"  GW
 SG_ ARS_RDI_DynProp_Clu_234 : 183|2@0+ (1,0) [0|3] ""  GW
 SG_ ARS_RDI_Quality_Clu_234 : 181|2@0+ (1,0) [0|3] ""  GW
 SG_ ARS_RDI_DynProp_Clu_235 : 179|2@0+ (1,0) [0|3] ""  GW
 SG_ ARS_RDI_Quality_Clu_235 : 177|2@0+ (1,0) [0|3] ""  GW
 SG_ ARS_RDI_Range_Clu_235 : 191|12@0+ (0.0625,0) [0|255.9375] "m"  GW
 SG_ ARS_RDI_VradRel_Clu_235 : 195|11@0+ (0.1,-120) [-120|84.7] "m/s"  GW
 SG_ ARS_RDI_RCS_Clu_235 : 200|9@0+ (0.2,-51.2) [-51.2|51] "dBsm"  GW
 SG_ ARS_RDI_AzimuthAng_Clu_235 : 223|10@0+ (0.002,-1.022) [-1.022|1.024] "rad"  GW
 SG_ ARS_RDI_ElevationAng_Clu_235 : 229|7@0+ (0.005,-0.315) [-0.315|0.32] "rad"  GW
 SG_ ARS_RDI_SNR_Clu_235 : 238|7@0+ (0.5,0) [0|63.5] "dB"  GW
 SG_ ARS_RDI_RCS_Clu_232 : 16|9@0+ (0.2,-51.2) [-51.2|51] "dBsm"  GW
 SG_ ARS_RDI_Range_Clu_236 : 247|12@0+ (0.0625,0) [0|255.9375] "m"  GW
 SG_ ARS_RDI_VradRel_Clu_236 : 251|11@0+ (0.1,-120) [-120|84.7] "m/s"  GW
 SG_ ARS_RDI_RCS_Clu_236 : 256|9@0+ (0.2,-51.2) [-51.2|51] "dBsm"  GW
 SG_ ARS_RDI_AzimuthAng_Clu_236 : 279|10@0+ (0.002,-1.022) [-1.022|1.024] "rad"  GW
 SG_ ARS_RDI_ElevationAng_Clu_236 : 285|7@0+ (0.005,-0.315) [-0.315|0.32] "rad"  GW
 SG_ ARS_RDI_SNR_Clu_236 : 294|7@0+ (0.5,0) [0|63.5] "dB"  GW
 SG_ ARS_RDI_DynProp_Clu_236 : 303|2@0+ (1,0) [0|3] ""  GW
 SG_ ARS_RDI_Quality_Clu_236 : 301|2@0+ (1,0) [0|3] ""  GW
 SG_ ARS_RDI_DynProp_Clu_237 : 299|2@0+ (1,0) [0|3] ""  GW
 SG_ ARS_RDI_Quality_Clu_237 : 297|2@0+ (1,0) [0|3] ""  GW
 SG_ ARS_RDI_Range_Clu_237 : 311|12@0+ (0.0625,0) [0|255.9375] "m"  GW
 SG_ ARS_RDI_VradRel_Clu_237 : 315|11@0+ (0.1,-120) [-120|84.7] "m/s"  GW
 SG_ ARS_RDI_RCS_Clu_237 : 320|9@0+ (0.2,-51.2) [-51.2|51] "dBsm"  GW
 SG_ ARS_RDI_AzimuthAng_Clu_232 : 39|10@0+ (0.002,-1.022) [-1.022|1.024] "rad"  GW
 SG_ ARS_RDI_AzimuthAng_Clu_237 : 343|10@0+ (0.002,-1.022) [-1.022|1.024] "rad"  GW
 SG_ ARS_RDI_ElevationAng_Clu_237 : 349|7@0+ (0.005,-0.315) [-0.315|0.32] "rad"  GW
 SG_ ARS_RDI_SNR_Clu_237 : 358|7@0+ (0.5,0) [0|63.5] "dB"  GW
 SG_ ARS_RDI_Range_Clu_238 : 367|12@0+ (0.0625,0) [0|255.9375] "m"  GW
 SG_ ARS_RDI_VradRel_Clu_238 : 371|11@0+ (0.1,-120) [-120|84.7] "m/s"  GW
 SG_ ARS_RDI_RCS_Clu_238 : 376|9@0+ (0.2,-51.2) [-51.2|51] "dBsm"  GW
 SG_ ARS_RDI_AzimuthAng_Clu_238 : 399|10@0+ (0.002,-1.022) [-1.022|1.024] "rad"  GW
 SG_ ARS_RDI_ElevationAng_Clu_238 : 405|7@0+ (0.005,-0.315) [-0.315|0.32] "rad"  GW
 SG_ ARS_RDI_SNR_Clu_238 : 414|7@0+ (0.5,0) [0|63.5] "dB"  GW
 SG_ ARS_RDI_DynProp_Clu_238 : 423|2@0+ (1,0) [0|3] ""  GW
 SG_ ARS_RDI_Quality_Clu_238 : 421|2@0+ (1,0) [0|3] ""  GW
 SG_ ARS_RDI_DynProp_Clu_239 : 419|2@0+ (1,0) [0|3] ""  GW
 SG_ ARS_RDI_Quality_Clu_239 : 417|2@0+ (1,0) [0|3] ""  GW
 SG_ ARS_RDI_Range_Clu_239 : 431|12@0+ (0.0625,0) [0|255.9375] "m"  GW
 SG_ ARS_RDI_ElevationAng_Clu_232 : 45|7@0+ (0.005,-0.315) [-0.315|0.32] "rad"  GW
 SG_ ARS_RDI_VradRel_Clu_239 : 435|11@0+ (0.1,-120) [-120|84.7] "m/s"  GW
 SG_ ARS_RDI_RCS_Clu_239 : 440|9@0+ (0.2,-51.2) [-51.2|51] "dBsm"  GW
 SG_ ARS_RDI_AzimuthAng_Clu_239 : 463|10@0+ (0.002,-1.022) [-1.022|1.024] "rad"  GW
 SG_ ARS_RDI_ElevationAng_Clu_239 : 469|7@0+ (0.005,-0.315) [-0.315|0.32] "rad"  GW
 SG_ ARS_RDI_SNR_Clu_239 : 478|7@0+ (0.5,0) [0|63.5] "dB"  GW
 SG_ ARS_RDI_MsgCounter_Clu_232_239 : 495|8@0+ (1,0) [0|255] ""  GW
 SG_ ARS_RDI_CRC16_Checksum_Clu_232_2 : 503|16@0+ (1,0) [0|65535] ""  GW
 SG_ ARS_RDI_SNR_Clu_232 : 54|7@0+ (0.5,0) [0|63.5] "dB"  GW
 SG_ ARS_RDI_DynProp_Clu_232 : 63|2@0+ (1,0) [0|3] ""  GW
 SG_ ARS_RDI_Quality_Clu_232 : 61|2@0+ (1,0) [0|3] ""  GW
 SG_ ARS_RDI_DynProp_Clu_233 : 59|2@0+ (1,0) [0|3] ""  GW
 SG_ ARS_RDI_Quality_Clu_233 : 57|2@0+ (1,0) [0|3] ""  GW
 SG_ ARS_RDI_Range_Clu_233 : 71|12@0+ (0.0625,0) [0|255.9375] "m"  GW
 SG_ ARS_RDI_VradRel_Clu_233 : 75|11@0+ (0.1,-120) [-120|84.7] "m/s"  GW
 SG_ ARS_RDI_RCS_Clu_233 : 80|9@0+ (0.2,-51.2) [-51.2|51] "dBsm"  GW
 SG_ ARS_RDI_AzimuthAng_Clu_233 : 103|10@0+ (0.002,-1.022) [-1.022|1.024] "rad"  GW

BO_ 290 ARS_RDI_240_247: 64 FR
 SG_ ARS_RDI_Range_Clu_240 : 7|12@0+ (0.0625,0) [0|255.9375] "m"  GW
 SG_ ARS_RDI_ElevationAng_Clu_241 : 109|7@0+ (0.005,-0.315) [-0.315|0.32] "rad"  GW
 SG_ ARS_RDI_SNR_Clu_241 : 118|7@0+ (0.5,0) [0|63.5] "dB"  GW
 SG_ ARS_RDI_Range_Clu_242 : 127|12@0+ (0.0625,0) [0|255.9375] "m"  GW
 SG_ ARS_RDI_VradRel_Clu_240 : 11|11@0+ (0.1,-120) [-120|84.7] "m/s"  GW
 SG_ ARS_RDI_VradRel_Clu_242 : 131|11@0+ (0.1,-120) [-120|84.7] "m/s"  GW
 SG_ ARS_RDI_RCS_Clu_242 : 136|9@0+ (0.2,-51.2) [-51.2|51] "dBsm"  GW
 SG_ ARS_RDI_AzimuthAng_Clu_242 : 159|10@0+ (0.002,-1.022) [-1.022|1.024] "rad"  GW
 SG_ ARS_RDI_ElevationAng_Clu_242 : 165|7@0+ (0.005,-0.315) [-0.315|0.32] "rad"  GW
 SG_ ARS_RDI_SNR_Clu_242 : 174|7@0+ (0.5,0) [0|63.5] "dB"  GW
 SG_ ARS_RDI_DynProp_Clu_242 : 183|2@0+ (1,0) [0|3] ""  GW
 SG_ ARS_RDI_Quality_Clu_242 : 181|2@0+ (1,0) [0|3] ""  GW
 SG_ ARS_RDI_DynProp_Clu_243 : 179|2@0+ (1,0) [0|3] ""  GW
 SG_ ARS_RDI_Quality_Clu_243 : 177|2@0+ (1,0) [0|3] ""  GW
 SG_ ARS_RDI_Range_Clu_243 : 191|12@0+ (0.0625,0) [0|255.9375] "m"  GW
 SG_ ARS_RDI_VradRel_Clu_243 : 195|11@0+ (0.1,-120) [-120|84.7] "m/s"  GW
 SG_ ARS_RDI_RCS_Clu_243 : 200|9@0+ (0.2,-51.2) [-51.2|51] "dBsm"  GW
 SG_ ARS_RDI_AzimuthAng_Clu_243 : 223|10@0+ (0.002,-1.022) [-1.022|1.024] "rad"  GW
 SG_ ARS_RDI_ElevationAng_Clu_243 : 229|7@0+ (0.005,-0.315) [-0.315|0.32] "rad"  GW
 SG_ ARS_RDI_SNR_Clu_243 : 238|7@0+ (0.5,0) [0|63.5] "dB"  GW
 SG_ ARS_RDI_RCS_Clu_240 : 16|9@0+ (0.2,-51.2) [-51.2|51] "dBsm"  GW
 SG_ ARS_RDI_Range_Clu_244 : 247|12@0+ (0.0625,0) [0|255.9375] "m"  GW
 SG_ ARS_RDI_VradRel_Clu_244 : 251|11@0+ (0.1,-120) [-120|84.7] "m/s"  GW
 SG_ ARS_RDI_RCS_Clu_244 : 256|9@0+ (0.2,-51.2) [-51.2|51] "dBsm"  GW
 SG_ ARS_RDI_AzimuthAng_Clu_244 : 279|10@0+ (0.002,-1.022) [-1.022|1.024] "rad"  GW
 SG_ ARS_RDI_ElevationAng_Clu_244 : 285|7@0+ (0.005,-0.315) [-0.315|0.32] "rad"  GW
 SG_ ARS_RDI_SNR_Clu_244 : 294|7@0+ (0.5,0) [0|63.5] "dB"  GW
 SG_ ARS_RDI_DynProp_Clu_244 : 303|2@0+ (1,0) [0|3] ""  GW
 SG_ ARS_RDI_Quality_Clu_244 : 301|2@0+ (1,0) [0|3] ""  GW
 SG_ ARS_RDI_DynProp_Clu_245 : 299|2@0+ (1,0) [0|3] ""  GW
 SG_ ARS_RDI_Quality_Clu_245 : 297|2@0+ (1,0) [0|3] ""  GW
 SG_ ARS_RDI_Range_Clu_245 : 311|12@0+ (0.0625,0) [0|255.9375] "m"  GW
 SG_ ARS_RDI_VradRel_Clu_245 : 315|11@0+ (0.1,-120) [-120|84.7] "m/s"  GW
 SG_ ARS_RDI_RCS_Clu_245 : 320|9@0+ (0.2,-51.2) [-51.2|51] "dBsm"  GW
 SG_ ARS_RDI_AzimuthAng_Clu_240 : 39|10@0+ (0.002,-1.022) [-1.022|1.024] "rad"  GW
 SG_ ARS_RDI_AzimuthAng_Clu_245 : 343|10@0+ (0.002,-1.022) [-1.022|1.024] "rad"  GW
 SG_ ARS_RDI_ElevationAng_Clu_245 : 349|7@0+ (0.005,-0.315) [-0.315|0.32] "rad"  GW
 SG_ ARS_RDI_SNR_Clu_245 : 358|7@0+ (0.5,0) [0|63.5] "dB"  GW
 SG_ ARS_RDI_Range_Clu_246 : 367|12@0+ (0.0625,0) [0|255.9375] "m"  GW
 SG_ ARS_RDI_VradRel_Clu_246 : 371|11@0+ (0.1,-120) [-120|84.7] "m/s"  GW
 SG_ ARS_RDI_RCS_Clu_246 : 376|9@0+ (0.2,-51.2) [-51.2|51] "dBsm"  GW
 SG_ ARS_RDI_AzimuthAng_Clu_246 : 399|10@0+ (0.002,-1.022) [-1.022|1.024] "rad"  GW
 SG_ ARS_RDI_ElevationAng_Clu_246 : 405|7@0+ (0.005,-0.315) [-0.315|0.32] "rad"  GW
 SG_ ARS_RDI_SNR_Clu_246 : 414|7@0+ (0.5,0) [0|63.5] "dB"  GW
 SG_ ARS_RDI_DynProp_Clu_246 : 423|2@0+ (1,0) [0|3] ""  GW
 SG_ ARS_RDI_Quality_Clu_246 : 421|2@0+ (1,0) [0|3] ""  GW
 SG_ ARS_RDI_DynProp_Clu_247 : 419|2@0+ (1,0) [0|3] ""  GW
 SG_ ARS_RDI_Quality_Clu_247 : 417|2@0+ (1,0) [0|3] ""  GW
 SG_ ARS_RDI_Range_Clu_247 : 431|12@0+ (0.0625,0) [0|255.9375] "m"  GW
 SG_ ARS_RDI_ElevationAng_Clu_240 : 45|7@0+ (0.005,-0.315) [-0.315|0.32] "rad"  GW
 SG_ ARS_RDI_VradRel_Clu_247 : 435|11@0+ (0.1,-120) [-120|84.7] "m/s"  GW
 SG_ ARS_RDI_RCS_Clu_247 : 440|9@0+ (0.2,-51.2) [-51.2|51] "dBsm"  GW
 SG_ ARS_RDI_AzimuthAng_Clu_247 : 463|10@0+ (0.002,-1.022) [-1.022|1.024] "rad"  GW
 SG_ ARS_RDI_ElevationAng_Clu_247 : 469|7@0+ (0.005,-0.315) [-0.315|0.32] "rad"  GW
 SG_ ARS_RDI_SNR_Clu_247 : 478|7@0+ (0.5,0) [0|63.5] "dB"  GW
 SG_ ARS_RDI_MsgCounter_Clu_240_247 : 495|8@0+ (1,0) [0|255] ""  GW
 SG_ ARS_RDI_CRC16_Checksum_Clu_240_2 : 503|16@0+ (1,0) [0|65535] ""  GW
 SG_ ARS_RDI_SNR_Clu_240 : 54|7@0+ (0.5,0) [0|63.5] "dB"  GW
 SG_ ARS_RDI_DynProp_Clu_240 : 63|2@0+ (1,0) [0|3] ""  GW
 SG_ ARS_RDI_Quality_Clu_240 : 61|2@0+ (1,0) [0|3] ""  GW
 SG_ ARS_RDI_DynProp_Clu_241 : 59|2@0+ (1,0) [0|3] ""  GW
 SG_ ARS_RDI_Quality_Clu_241 : 57|2@0+ (1,0) [0|3] ""  GW
 SG_ ARS_RDI_Range_Clu_241 : 71|12@0+ (0.0625,0) [0|255.9375] "m"  GW
 SG_ ARS_RDI_VradRel_Clu_241 : 75|11@0+ (0.1,-120) [-120|84.7] "m/s"  GW
 SG_ ARS_RDI_RCS_Clu_241 : 80|9@0+ (0.2,-51.2) [-51.2|51] "dBsm"  GW
 SG_ ARS_RDI_AzimuthAng_Clu_241 : 103|10@0+ (0.002,-1.022) [-1.022|1.024] "rad"  GW

BO_ 291 ARS_RDI_248_255: 64 FR
 SG_ ARS_RDI_Range_Clu_248 : 7|12@0+ (0.0625,0) [0|255.9375] "m"  GW
 SG_ ARS_RDI_ElevationAng_Clu_249 : 109|7@0+ (0.005,-0.315) [-0.315|0.32] "rad"  GW
 SG_ ARS_RDI_SNR_Clu_249 : 118|7@0+ (0.5,0) [0|63.5] "dB"  GW
 SG_ ARS_RDI_Range_Clu_250 : 127|12@0+ (0.0625,0) [0|255.9375] "m"  GW
 SG_ ARS_RDI_VradRel_Clu_248 : 11|11@0+ (0.1,-120) [-120|84.7] "m/s"  GW
 SG_ ARS_RDI_VradRel_Clu_250 : 131|11@0+ (0.1,-120) [-120|84.7] "m/s"  GW
 SG_ ARS_RDI_RCS_Clu_250 : 136|9@0+ (0.2,-51.2) [-51.2|51] "dBsm"  GW
 SG_ ARS_RDI_AzimuthAng_Clu_250 : 159|10@0+ (0.002,-1.022) [-1.022|1.024] "rad"  GW
 SG_ ARS_RDI_ElevationAng_Clu_250 : 165|7@0+ (0.005,-0.315) [-0.315|0.32] "rad"  GW
 SG_ ARS_RDI_SNR_Clu_250 : 174|7@0+ (0.5,0) [0|63.5] "dB"  GW
 SG_ ARS_RDI_DynProp_Clu_250 : 183|2@0+ (1,0) [0|3] ""  GW
 SG_ ARS_RDI_Quality_Clu_250 : 181|2@0+ (1,0) [0|3] ""  GW
 SG_ ARS_RDI_DynProp_Clu_251 : 179|2@0+ (1,0) [0|3] ""  GW
 SG_ ARS_RDI_Quality_Clu_251 : 177|2@0+ (1,0) [0|3] ""  GW
 SG_ ARS_RDI_Range_Clu_251 : 191|12@0+ (0.0625,0) [0|255.9375] "m"  GW
 SG_ ARS_RDI_VradRel_Clu_251 : 195|11@0+ (0.1,-120) [-120|84.7] "m/s"  GW
 SG_ ARS_RDI_RCS_Clu_251 : 200|9@0+ (0.2,-51.2) [-51.2|51] "dBsm"  GW
 SG_ ARS_RDI_AzimuthAng_Clu_251 : 223|10@0+ (0.002,-1.022) [-1.022|1.024] "rad"  GW
 SG_ ARS_RDI_ElevationAng_Clu_251 : 229|7@0+ (0.005,-0.315) [-0.315|0.32] "rad"  GW
 SG_ ARS_RDI_SNR_Clu_251 : 238|7@0+ (0.5,0) [0|63.5] "dB"  GW
 SG_ ARS_RDI_RCS_Clu_248 : 16|9@0+ (0.2,-51.2) [-51.2|51] "dBsm"  GW
 SG_ ARS_RDI_Range_Clu_252 : 247|12@0+ (0.0625,0) [0|255.9375] "m"  GW
 SG_ ARS_RDI_VradRel_Clu_252 : 251|11@0+ (0.1,-120) [-120|84.7] "m/s"  GW
 SG_ ARS_RDI_RCS_Clu_252 : 256|9@0+ (0.2,-51.2) [-51.2|51] "dBsm"  GW
 SG_ ARS_RDI_AzimuthAng_Clu_252 : 279|10@0+ (0.002,-1.022) [-1.022|1.024] "rad"  GW
 SG_ ARS_RDI_ElevationAng_Clu_252 : 285|7@0+ (0.005,-0.315) [-0.315|0.32] "rad"  GW
 SG_ ARS_RDI_SNR_Clu_252 : 294|7@0+ (0.5,0) [0|63.5] "dB"  GW
 SG_ ARS_RDI_DynProp_Clu_252 : 303|2@0+ (1,0) [0|3] ""  GW
 SG_ ARS_RDI_Quality_Clu_252 : 301|2@0+ (1,0) [0|3] ""  GW
 SG_ ARS_RDI_DynProp_Clu_253 : 299|2@0+ (1,0) [0|3] ""  GW
 SG_ ARS_RDI_Quality_Clu_253 : 297|2@0+ (1,0) [0|3] ""  GW
 SG_ ARS_RDI_Range_Clu_253 : 311|12@0+ (0.0625,0) [0|255.9375] "m"  GW
 SG_ ARS_RDI_VradRel_Clu_253 : 315|11@0+ (0.1,-120) [-120|84.7] "m/s"  GW
 SG_ ARS_RDI_RCS_Clu_253 : 320|9@0+ (0.2,-51.2) [-51.2|51] "dBsm"  GW
 SG_ ARS_RDI_AzimuthAng_Clu_248 : 39|10@0+ (0.002,-1.022) [-1.022|1.024] "rad"  GW
 SG_ ARS_RDI_AzimuthAng_Clu_253 : 343|10@0+ (0.002,-1.022) [-1.022|1.024] "rad"  GW
 SG_ ARS_RDI_ElevationAng_Clu_253 : 349|7@0+ (0.005,-0.315) [-0.315|0.32] "rad"  GW
 SG_ ARS_RDI_SNR_Clu_253 : 358|7@0+ (0.5,0) [0|63.5] "dB"  GW
 SG_ ARS_RDI_Range_Clu_254 : 367|12@0+ (0.0625,0) [0|255.9375] "m"  GW
 SG_ ARS_RDI_VradRel_Clu_254 : 371|11@0+ (0.1,-120) [-120|84.7] "m/s"  GW
 SG_ ARS_RDI_RCS_Clu_254 : 376|9@0+ (0.2,-51.2) [-51.2|51] "dBsm"  GW
 SG_ ARS_RDI_AzimuthAng_Clu_254 : 399|10@0+ (0.002,-1.022) [-1.022|1.024] "rad"  GW
 SG_ ARS_RDI_ElevationAng_Clu_254 : 405|7@0+ (0.005,-0.315) [-0.315|0.32] "rad"  GW
 SG_ ARS_RDI_SNR_Clu_254 : 414|7@0+ (0.5,0) [0|63.5] "dB"  GW
 SG_ ARS_RDI_DynProp_Clu_254 : 423|2@0+ (1,0) [0|3] ""  GW
 SG_ ARS_RDI_Quality_Clu_254 : 421|2@0+ (1,0) [0|3] ""  GW
 SG_ ARS_RDI_DynProp_Clu_255 : 419|2@0+ (1,0) [0|3] ""  GW
 SG_ ARS_RDI_Quality_Clu_255 : 417|2@0+ (1,0) [0|3] ""  GW
 SG_ ARS_RDI_Range_Clu_255 : 431|12@0+ (0.0625,0) [0|255.9375] "m"  GW
 SG_ ARS_RDI_ElevationAng_Clu_248 : 45|7@0+ (0.005,-0.315) [-0.315|0.32] "rad"  GW
 SG_ ARS_RDI_VradRel_Clu_255 : 435|11@0+ (0.1,-120) [-120|84.7] "m/s"  GW
 SG_ ARS_RDI_RCS_Clu_255 : 440|9@0+ (0.2,-51.2) [-51.2|51] "dBsm"  GW
 SG_ ARS_RDI_AzimuthAng_Clu_255 : 463|10@0+ (0.002,-1.022) [-1.022|1.024] "rad"  GW
 SG_ ARS_RDI_ElevationAng_Clu_255 : 469|7@0+ (0.005,-0.315) [-0.315|0.32] "rad"  GW
 SG_ ARS_RDI_SNR_Clu_255 : 478|7@0+ (0.5,0) [0|63.5] "dB"  GW
 SG_ ARS_RDI_MsgCounter_Clu_248_255 : 495|8@0+ (1,0) [0|255] ""  GW
 SG_ ARS_RDI_CRC16_Checksum_Clu_248_2 : 503|16@0+ (1,0) [0|65535] ""  GW
 SG_ ARS_RDI_SNR_Clu_248 : 54|7@0+ (0.5,0) [0|63.5] "dB"  GW
 SG_ ARS_RDI_DynProp_Clu_248 : 63|2@0+ (1,0) [0|3] ""  GW
 SG_ ARS_RDI_Quality_Clu_248 : 61|2@0+ (1,0) [0|3] ""  GW
 SG_ ARS_RDI_DynProp_Clu_249 : 59|2@0+ (1,0) [0|3] ""  GW
 SG_ ARS_RDI_Quality_Clu_249 : 57|2@0+ (1,0) [0|3] ""  GW
 SG_ ARS_RDI_Range_Clu_249 : 71|12@0+ (0.0625,0) [0|255.9375] "m"  GW
 SG_ ARS_RDI_VradRel_Clu_249 : 75|11@0+ (0.1,-120) [-120|84.7] "m/s"  GW
 SG_ ARS_RDI_RCS_Clu_249 : 80|9@0+ (0.2,-51.2) [-51.2|51] "dBsm"  GW
 SG_ ARS_RDI_AzimuthAng_Clu_249 : 103|10@0+ (0.002,-1.022) [-1.022|1.024] "rad"  GW

BO_ 292 ARS_RDI_256_263: 64 FR
 SG_ ARS_RDI_Range_Clu_256 : 7|12@0+ (0.0625,0) [0|255.9375] "m"  GW
 SG_ ARS_RDI_ElevationAng_Clu_257 : 109|7@0+ (0.005,-0.315) [-0.315|0.32] "rad"  GW
 SG_ ARS_RDI_SNR_Clu_257 : 118|7@0+ (0.5,0) [0|63.5] "dB"  GW
 SG_ ARS_RDI_Range_Clu_258 : 127|12@0+ (0.0625,0) [0|255.9375] "m"  GW
 SG_ ARS_RDI_VradRel_Clu_256 : 11|11@0+ (0.1,-120) [-120|84.7] "m/s"  GW
 SG_ ARS_RDI_VradRel_Clu_258 : 131|11@0+ (0.1,-120) [-120|84.7] "m/s"  GW
 SG_ ARS_RDI_RCS_Clu_258 : 136|9@0+ (0.2,-51.2) [-51.2|51] "dBsm"  GW
 SG_ ARS_RDI_AzimuthAng_Clu_258 : 159|10@0+ (0.002,-1.022) [-1.022|1.024] "rad"  GW
 SG_ ARS_RDI_ElevationAng_Clu_258 : 165|7@0+ (0.005,-0.315) [-0.315|0.32] "rad"  GW
 SG_ ARS_RDI_SNR_Clu_258 : 174|7@0+ (0.5,0) [0|63.5] "dB"  GW
 SG_ ARS_RDI_DynProp_Clu_258 : 183|2@0+ (1,0) [0|3] ""  GW
 SG_ ARS_RDI_Quality_Clu_258 : 181|2@0+ (1,0) [0|3] ""  GW
 SG_ ARS_RDI_DynProp_Clu_259 : 179|2@0+ (1,0) [0|3] ""  GW
 SG_ ARS_RDI_Quality_Clu_259 : 177|2@0+ (1,0) [0|3] ""  GW
 SG_ ARS_RDI_Range_Clu_259 : 191|12@0+ (0.0625,0) [0|255.9375] "m"  GW
 SG_ ARS_RDI_VradRel_Clu_259 : 195|11@0+ (0.1,-120) [-120|84.7] "m/s"  GW
 SG_ ARS_RDI_RCS_Clu_259 : 200|9@0+ (0.2,-51.2) [-51.2|51] "dBsm"  GW
 SG_ ARS_RDI_AzimuthAng_Clu_259 : 223|10@0+ (0.002,-1.022) [-1.022|1.024] "rad"  GW
 SG_ ARS_RDI_ElevationAng_Clu_259 : 229|7@0+ (0.005,-0.315) [-0.315|0.32] "rad"  GW
 SG_ ARS_RDI_SNR_Clu_259 : 238|7@0+ (0.5,0) [0|63.5] "dB"  GW
 SG_ ARS_RDI_RCS_Clu_256 : 16|9@0+ (0.2,-51.2) [-51.2|51] "dBsm"  GW
 SG_ ARS_RDI_Range_Clu_260 : 247|12@0+ (0.0625,0) [0|255.9375] "m"  GW
 SG_ ARS_RDI_VradRel_Clu_260 : 251|11@0+ (0.1,-120) [-120|84.7] "m/s"  GW
 SG_ ARS_RDI_RCS_Clu_260 : 256|9@0+ (0.2,-51.2) [-51.2|51] "dBsm"  GW
 SG_ ARS_RDI_AzimuthAng_Clu_260 : 279|10@0+ (0.002,-1.022) [-1.022|1.024] "rad"  GW
 SG_ ARS_RDI_ElevationAng_Clu_260 : 285|7@0+ (0.005,-0.315) [-0.315|0.32] "rad"  GW
 SG_ ARS_RDI_SNR_Clu_260 : 294|7@0+ (0.5,0) [0|63.5] "dB"  GW
 SG_ ARS_RDI_DynProp_Clu_260 : 303|2@0+ (1,0) [0|3] ""  GW
 SG_ ARS_RDI_Quality_Clu_260 : 301|2@0+ (1,0) [0|3] ""  GW
 SG_ ARS_RDI_DynProp_Clu_261 : 299|2@0+ (1,0) [0|3] ""  GW
 SG_ ARS_RDI_Quality_Clu_261 : 297|2@0+ (1,0) [0|3] ""  GW
 SG_ ARS_RDI_Range_Clu_261 : 311|12@0+ (0.0625,0) [0|255.9375] "m"  GW
 SG_ ARS_RDI_VradRel_Clu_261 : 315|11@0+ (0.1,-120) [-120|84.7] "m/s"  GW
 SG_ ARS_RDI_RCS_Clu_261 : 320|9@0+ (0.2,-51.2) [-51.2|51] "dBsm"  GW
 SG_ ARS_RDI_AzimuthAng_Clu_256 : 39|10@0+ (0.002,-1.022) [-1.022|1.024] "rad"  GW
 SG_ ARS_RDI_AzimuthAng_Clu_261 : 343|10@0+ (0.002,-1.022) [-1.022|1.024] "rad"  GW
 SG_ ARS_RDI_ElevationAng_Clu_261 : 349|7@0+ (0.005,-0.315) [-0.315|0.32] "rad"  GW
 SG_ ARS_RDI_SNR_Clu_261 : 358|7@0+ (0.5,0) [0|63.5] "dB"  GW
 SG_ ARS_RDI_Range_Clu_262 : 367|12@0+ (0.0625,0) [0|255.9375] "m"  GW
 SG_ ARS_RDI_VradRel_Clu_262 : 371|11@0+ (0.1,-120) [-120|84.7] "m/s"  GW
 SG_ ARS_RDI_RCS_Clu_262 : 376|9@0+ (0.2,-51.2) [-51.2|51] "dBsm"  GW
 SG_ ARS_RDI_AzimuthAng_Clu_262 : 399|10@0+ (0.002,-1.022) [-1.022|1.024] "rad"  GW
 SG_ ARS_RDI_ElevationAng_Clu_262 : 405|7@0+ (0.005,-0.315) [-0.315|0.32] "rad"  GW
 SG_ ARS_RDI_SNR_Clu_262 : 414|7@0+ (0.5,0) [0|63.5] "dB"  GW
 SG_ ARS_RDI_DynProp_Clu_262 : 423|2@0+ (1,0) [0|3] ""  GW
 SG_ ARS_RDI_Quality_Clu_262 : 421|2@0+ (1,0) [0|3] ""  GW
 SG_ ARS_RDI_DynProp_Clu_263 : 419|2@0+ (1,0) [0|3] ""  GW
 SG_ ARS_RDI_Quality_Clu_263 : 417|2@0+ (1,0) [0|3] ""  GW
 SG_ ARS_RDI_Range_Clu_263 : 431|12@0+ (0.0625,0) [0|255.9375] "m"  GW
 SG_ ARS_RDI_ElevationAng_Clu_256 : 45|7@0+ (0.005,-0.315) [-0.315|0.32] "rad"  GW
 SG_ ARS_RDI_VradRel_Clu_263 : 435|11@0+ (0.1,-120) [-120|84.7] "m/s"  GW
 SG_ ARS_RDI_RCS_Clu_263 : 440|9@0+ (0.2,-51.2) [-51.2|51] "dBsm"  GW
 SG_ ARS_RDI_AzimuthAng_Clu_263 : 463|10@0+ (0.002,-1.022) [-1.022|1.024] "rad"  GW
 SG_ ARS_RDI_ElevationAng_Clu_263 : 469|7@0+ (0.005,-0.315) [-0.315|0.32] "rad"  GW
 SG_ ARS_RDI_SNR_Clu_263 : 478|7@0+ (0.5,0) [0|63.5] "dB"  GW
 SG_ ARS_RDI_MsgCounter_Clu_256_263 : 495|8@0+ (1,0) [0|255] ""  GW
 SG_ ARS_RDI_CRC16_Checksum_Clu_256_2 : 503|16@0+ (1,0) [0|65535] ""  GW
 SG_ ARS_RDI_SNR_Clu_256 : 54|7@0+ (0.5,0) [0|63.5] "dB"  GW
 SG_ ARS_RDI_DynProp_Clu_256 : 63|2@0+ (1,0) [0|3] ""  GW
 SG_ ARS_RDI_Quality_Clu_256 : 61|2@0+ (1,0) [0|3] ""  GW
 SG_ ARS_RDI_DynProp_Clu_257 : 59|2@0+ (1,0) [0|3] ""  GW
 SG_ ARS_RDI_Quality_Clu_257 : 57|2@0+ (1,0) [0|3] ""  GW
 SG_ ARS_RDI_Range_Clu_257 : 71|12@0+ (0.0625,0) [0|255.9375] "m"  GW
 SG_ ARS_RDI_VradRel_Clu_257 : 75|11@0+ (0.1,-120) [-120|84.7] "m/s"  GW
 SG_ ARS_RDI_RCS_Clu_257 : 80|9@0+ (0.2,-51.2) [-51.2|51] "dBsm"  GW
 SG_ ARS_RDI_AzimuthAng_Clu_257 : 103|10@0+ (0.002,-1.022) [-1.022|1.024] "rad"  GW

BO_ 293 ARS_RDI_264_271: 64 FR
 SG_ ARS_RDI_Range_Clu_264 : 7|12@0+ (0.0625,0) [0|255.9375] "m"  GW
 SG_ ARS_RDI_ElevationAng_Clu_265 : 109|7@0+ (0.005,-0.315) [-0.315|0.32] "rad"  GW
 SG_ ARS_RDI_SNR_Clu_265 : 118|7@0+ (0.5,0) [0|63.5] "dB"  GW
 SG_ ARS_RDI_Range_Clu_266 : 127|12@0+ (0.0625,0) [0|255.9375] "m"  GW
 SG_ ARS_RDI_VradRel_Clu_264 : 11|11@0+ (0.1,-120) [-120|84.7] "m/s"  GW
 SG_ ARS_RDI_VradRel_Clu_266 : 131|11@0+ (0.1,-120) [-120|84.7] "m/s"  GW
 SG_ ARS_RDI_RCS_Clu_266 : 136|9@0+ (0.2,-51.2) [-51.2|51] "dBsm"  GW
 SG_ ARS_RDI_AzimuthAng_Clu_266 : 159|10@0+ (0.002,-1.022) [-1.022|1.024] "rad"  GW
 SG_ ARS_RDI_ElevationAng_Clu_266 : 165|7@0+ (0.005,-0.315) [-0.315|0.32] "rad"  GW
 SG_ ARS_RDI_SNR_Clu_266 : 174|7@0+ (0.5,0) [0|63.5] "dB"  GW
 SG_ ARS_RDI_DynProp_Clu_266 : 183|2@0+ (1,0) [0|3] ""  GW
 SG_ ARS_RDI_Quality_Clu_266 : 181|2@0+ (1,0) [0|3] ""  GW
 SG_ ARS_RDI_DynProp_Clu_267 : 179|2@0+ (1,0) [0|3] ""  GW
 SG_ ARS_RDI_Quality_Clu_267 : 177|2@0+ (1,0) [0|3] ""  GW
 SG_ ARS_RDI_Range_Clu_267 : 191|12@0+ (0.0625,0) [0|255.9375] "m"  GW
 SG_ ARS_RDI_VradRel_Clu_267 : 195|11@0+ (0.1,-120) [-120|84.7] "m/s"  GW
 SG_ ARS_RDI_RCS_Clu_267 : 200|9@0+ (0.2,-51.2) [-51.2|51] "dBsm"  GW
 SG_ ARS_RDI_AzimuthAng_Clu_267 : 223|10@0+ (0.002,-1.022) [-1.022|1.024] "rad"  GW
 SG_ ARS_RDI_ElevationAng_Clu_267 : 229|7@0+ (0.005,-0.315) [-0.315|0.32] "rad"  GW
 SG_ ARS_RDI_SNR_Clu_267 : 238|7@0+ (0.5,0) [0|63.5] "dB"  GW
 SG_ ARS_RDI_RCS_Clu_264 : 16|9@0+ (0.2,-51.2) [-51.2|51] "dBsm"  GW
 SG_ ARS_RDI_Range_Clu_268 : 247|12@0+ (0.0625,0) [0|255.9375] "m"  GW
 SG_ ARS_RDI_VradRel_Clu_268 : 251|11@0+ (0.1,-120) [-120|84.7] "m/s"  GW
 SG_ ARS_RDI_RCS_Clu_268 : 256|9@0+ (0.2,-51.2) [-51.2|51] "dBsm"  GW
 SG_ ARS_RDI_AzimuthAng_Clu_268 : 279|10@0+ (0.002,-1.022) [-1.022|1.024] "rad"  GW
 SG_ ARS_RDI_ElevationAng_Clu_268 : 285|7@0+ (0.005,-0.315) [-0.315|0.32] "rad"  GW
 SG_ ARS_RDI_SNR_Clu_268 : 294|7@0+ (0.5,0) [0|63.5] "dB"  GW
 SG_ ARS_RDI_DynProp_Clu_268 : 303|2@0+ (1,0) [0|3] ""  GW
 SG_ ARS_RDI_Quality_Clu_268 : 301|2@0+ (1,0) [0|3] ""  GW
 SG_ ARS_RDI_DynProp_Clu_269 : 299|2@0+ (1,0) [0|3] ""  GW
 SG_ ARS_RDI_Quality_Clu_269 : 297|2@0+ (1,0) [0|3] ""  GW
 SG_ ARS_RDI_Range_Clu_269 : 311|12@0+ (0.0625,0) [0|255.9375] "m"  GW
 SG_ ARS_RDI_VradRel_Clu_269 : 315|11@0+ (0.1,-120) [-120|84.7] "m/s"  GW
 SG_ ARS_RDI_RCS_Clu_269 : 320|9@0+ (0.2,-51.2) [-51.2|51] "dBsm"  GW
 SG_ ARS_RDI_AzimuthAng_Clu_264 : 39|10@0+ (0.002,-1.022) [-1.022|1.024] "rad"  GW
 SG_ ARS_RDI_AzimuthAng_Clu_269 : 343|10@0+ (0.002,-1.022) [-1.022|1.024] "rad"  GW
 SG_ ARS_RDI_ElevationAng_Clu_269 : 349|7@0+ (0.005,-0.315) [-0.315|0.32] "rad"  GW
 SG_ ARS_RDI_SNR_Clu_269 : 358|7@0+ (0.5,0) [0|63.5] "dB"  GW
 SG_ ARS_RDI_Range_Clu_270 : 367|12@0+ (0.0625,0) [0|255.9375] "m"  GW
 SG_ ARS_RDI_VradRel_Clu_270 : 371|11@0+ (0.1,-120) [-120|84.7] "m/s"  GW
 SG_ ARS_RDI_RCS_Clu_270 : 376|9@0+ (0.2,-51.2) [-51.2|51] "dBsm"  GW
 SG_ ARS_RDI_AzimuthAng_Clu_270 : 399|10@0+ (0.002,-1.022) [-1.022|1.024] "rad"  GW
 SG_ ARS_RDI_ElevationAng_Clu_270 : 405|7@0+ (0.005,-0.315) [-0.315|0.32] "rad"  GW
 SG_ ARS_RDI_SNR_Clu_270 : 414|7@0+ (0.5,0) [0|63.5] "dB"  GW
 SG_ ARS_RDI_DynProp_Clu_270 : 423|2@0+ (1,0) [0|3] ""  GW
 SG_ ARS_RDI_Quality_Clu_270 : 421|2@0+ (1,0) [0|3] ""  GW
 SG_ ARS_RDI_DynProp_Clu_271 : 419|2@0+ (1,0) [0|3] ""  GW
 SG_ ARS_RDI_Quality_Clu_271 : 417|2@0+ (1,0) [0|3] ""  GW
 SG_ ARS_RDI_Range_Clu_271 : 431|12@0+ (0.0625,0) [0|255.9375] "m"  GW
 SG_ ARS_RDI_ElevationAng_Clu_264 : 45|7@0+ (0.005,-0.315) [-0.315|0.32] "rad"  GW
 SG_ ARS_RDI_VradRel_Clu_271 : 435|11@0+ (0.1,-120) [-120|84.7] "m/s"  GW
 SG_ ARS_RDI_RCS_Clu_271 : 440|9@0+ (0.2,-51.2) [-51.2|51] "dBsm"  GW
 SG_ ARS_RDI_AzimuthAng_Clu_271 : 463|10@0+ (0.002,-1.022) [-1.022|1.024] "rad"  GW
 SG_ ARS_RDI_ElevationAng_Clu_271 : 469|7@0+ (0.005,-0.315) [-0.315|0.32] "rad"  GW
 SG_ ARS_RDI_SNR_Clu_271 : 478|7@0+ (0.5,0) [0|63.5] "dB"  GW
 SG_ ARS_RDI_MsgCounter_Clu_264_271 : 495|8@0+ (1,0) [0|255] ""  GW
 SG_ ARS_RDI_CRC16_Checksum_Clu_264_2 : 503|16@0+ (1,0) [0|65535] ""  GW
 SG_ ARS_RDI_SNR_Clu_264 : 54|7@0+ (0.5,0) [0|63.5] "dB"  GW
 SG_ ARS_RDI_DynProp_Clu_264 : 63|2@0+ (1,0) [0|3] ""  GW
 SG_ ARS_RDI_Quality_Clu_264 : 61|2@0+ (1,0) [0|3] ""  GW
 SG_ ARS_RDI_DynProp_Clu_265 : 59|2@0+ (1,0) [0|3] ""  GW
 SG_ ARS_RDI_Quality_Clu_265 : 57|2@0+ (1,0) [0|3] ""  GW
 SG_ ARS_RDI_Range_Clu_265 : 71|12@0+ (0.0625,0) [0|255.9375] "m"  GW
 SG_ ARS_RDI_VradRel_Clu_265 : 75|11@0+ (0.1,-120) [-120|84.7] "m/s"  GW
 SG_ ARS_RDI_RCS_Clu_265 : 80|9@0+ (0.2,-51.2) [-51.2|51] "dBsm"  GW
 SG_ ARS_RDI_AzimuthAng_Clu_265 : 103|10@0+ (0.002,-1.022) [-1.022|1.024] "rad"  GW

BO_ 294 ARS_RDI_272_279: 64 FR
 SG_ ARS_RDI_Range_Clu_272 : 7|12@0+ (0.0625,0) [0|255.9375] "m"  GW
 SG_ ARS_RDI_ElevationAng_Clu_273 : 109|7@0+ (0.005,-0.315) [-0.315|0.32] "rad"  GW
 SG_ ARS_RDI_SNR_Clu_273 : 118|7@0+ (0.5,0) [0|63.5] "dB"  GW
 SG_ ARS_RDI_Range_Clu_274 : 127|12@0+ (0.0625,0) [0|255.9375] "m"  GW
 SG_ ARS_RDI_VradRel_Clu_272 : 11|11@0+ (0.1,-120) [-120|84.7] "m/s"  GW
 SG_ ARS_RDI_VradRel_Clu_274 : 131|11@0+ (0.1,-120) [-120|84.7] "m/s"  GW
 SG_ ARS_RDI_RCS_Clu_274 : 136|9@0+ (0.2,-51.2) [-51.2|51] "dBsm"  GW
 SG_ ARS_RDI_AzimuthAng_Clu_274 : 159|10@0+ (0.002,-1.022) [-1.022|1.024] "rad"  GW
 SG_ ARS_RDI_ElevationAng_Clu_274 : 165|7@0+ (0.005,-0.315) [-0.315|0.32] "rad"  GW
 SG_ ARS_RDI_SNR_Clu_274 : 174|7@0+ (0.5,0) [0|63.5] "dB"  GW
 SG_ ARS_RDI_DynProp_Clu_274 : 183|2@0+ (1,0) [0|3] ""  GW
 SG_ ARS_RDI_Quality_Clu_274 : 181|2@0+ (1,0) [0|3] ""  GW
 SG_ ARS_RDI_DynProp_Clu_275 : 179|2@0+ (1,0) [0|3] ""  GW
 SG_ ARS_RDI_Quality_Clu_275 : 177|2@0+ (1,0) [0|3] ""  GW
 SG_ ARS_RDI_Range_Clu_275 : 191|12@0+ (0.0625,0) [0|255.9375] "m"  GW
 SG_ ARS_RDI_VradRel_Clu_275 : 195|11@0+ (0.1,-120) [-120|84.7] "m/s"  GW
 SG_ ARS_RDI_RCS_Clu_275 : 200|9@0+ (0.2,-51.2) [-51.2|51] "dBsm"  GW
 SG_ ARS_RDI_AzimuthAng_Clu_275 : 223|10@0+ (0.002,-1.022) [-1.022|1.024] "rad"  GW
 SG_ ARS_RDI_ElevationAng_Clu_275 : 229|7@0+ (0.005,-0.315) [-0.315|0.32] "rad"  GW
 SG_ ARS_RDI_SNR_Clu_275 : 238|7@0+ (0.5,0) [0|63.5] "dB"  GW
 SG_ ARS_RDI_RCS_Clu_272 : 16|9@0+ (0.2,-51.2) [-51.2|51] "dBsm"  GW
 SG_ ARS_RDI_Range_Clu_276 : 247|12@0+ (0.0625,0) [0|255.9375] "m"  GW
 SG_ ARS_RDI_VradRel_Clu_276 : 251|11@0+ (0.1,-120) [-120|84.7] "m/s"  GW
 SG_ ARS_RDI_RCS_Clu_276 : 256|9@0+ (0.2,-51.2) [-51.2|51] "dBsm"  GW
 SG_ ARS_RDI_AzimuthAng_Clu_276 : 279|10@0+ (0.002,-1.022) [-1.022|1.024] "rad"  GW
 SG_ ARS_RDI_ElevationAng_Clu_276 : 285|7@0+ (0.005,-0.315) [-0.315|0.32] "rad"  GW
 SG_ ARS_RDI_SNR_Clu_276 : 294|7@0+ (0.5,0) [0|63.5] "dB"  GW
 SG_ ARS_RDI_DynProp_Clu_276 : 303|2@0+ (1,0) [0|3] ""  GW
 SG_ ARS_RDI_Quality_Clu_276 : 301|2@0+ (1,0) [0|3] ""  GW
 SG_ ARS_RDI_DynProp_Clu_277 : 299|2@0+ (1,0) [0|3] ""  GW
 SG_ ARS_RDI_Quality_Clu_277 : 297|2@0+ (1,0) [0|3] ""  GW
 SG_ ARS_RDI_Range_Clu_277 : 311|12@0+ (0.0625,0) [0|255.9375] "m"  GW
 SG_ ARS_RDI_VradRel_Clu_277 : 315|11@0+ (0.1,-120) [-120|84.7] "m/s"  GW
 SG_ ARS_RDI_RCS_Clu_277 : 320|9@0+ (0.2,-51.2) [-51.2|51] "dBsm"  GW
 SG_ ARS_RDI_AzimuthAng_Clu_272 : 39|10@0+ (0.002,-1.022) [-1.022|1.024] "rad"  GW
 SG_ ARS_RDI_AzimuthAng_Clu_277 : 343|10@0+ (0.002,-1.022) [-1.022|1.024] "rad"  GW
 SG_ ARS_RDI_ElevationAng_Clu_277 : 349|7@0+ (0.005,-0.315) [-0.315|0.32] "rad"  GW
 SG_ ARS_RDI_SNR_Clu_277 : 358|7@0+ (0.5,0) [0|63.5] "dB"  GW
 SG_ ARS_RDI_Range_Clu_278 : 367|12@0+ (0.0625,0) [0|255.9375] "m"  GW
 SG_ ARS_RDI_VradRel_Clu_278 : 371|11@0+ (0.1,-120) [-120|84.7] "m/s"  GW
 SG_ ARS_RDI_RCS_Clu_278 : 376|9@0+ (0.2,-51.2) [-51.2|51] "dBsm"  GW
 SG_ ARS_RDI_AzimuthAng_Clu_278 : 399|10@0+ (0.002,-1.022) [-1.022|1.024] "rad"  GW
 SG_ ARS_RDI_ElevationAng_Clu_278 : 405|7@0+ (0.005,-0.315) [-0.315|0.32] "rad"  GW
 SG_ ARS_RDI_SNR_Clu_278 : 414|7@0+ (0.5,0) [0|63.5] "dB"  GW
 SG_ ARS_RDI_DynProp_Clu_278 : 423|2@0+ (1,0) [0|3] ""  GW
 SG_ ARS_RDI_Quality_Clu_278 : 421|2@0+ (1,0) [0|3] ""  GW
 SG_ ARS_RDI_DynProp_Clu_279 : 419|2@0+ (1,0) [0|3] ""  GW
 SG_ ARS_RDI_Quality_Clu_279 : 417|2@0+ (1,0) [0|3] ""  GW
 SG_ ARS_RDI_Range_Clu_279 : 431|12@0+ (0.0625,0) [0|255.9375] "m"  GW
 SG_ ARS_RDI_ElevationAng_Clu_272 : 45|7@0+ (0.005,-0.315) [-0.315|0.32] "rad"  GW
 SG_ ARS_RDI_VradRel_Clu_279 : 435|11@0+ (0.1,-120) [-120|84.7] "m/s"  GW
 SG_ ARS_RDI_RCS_Clu_279 : 440|9@0+ (0.2,-51.2) [-51.2|51] "dBsm"  GW
 SG_ ARS_RDI_AzimuthAng_Clu_279 : 463|10@0+ (0.002,-1.022) [-1.022|1.024] "rad"  GW
 SG_ ARS_RDI_ElevationAng_Clu_279 : 469|7@0+ (0.005,-0.315) [-0.315|0.32] "rad"  GW
 SG_ ARS_RDI_SNR_Clu_279 : 478|7@0+ (0.5,0) [0|63.5] "dB"  GW
 SG_ ARS_RDI_MsgCounter_Clu_272_279 : 495|8@0+ (1,0) [0|255] ""  GW
 SG_ ARS_RDI_CRC16_Checksum_Clu_272_2 : 503|16@0+ (1,0) [0|65535] ""  GW
 SG_ ARS_RDI_SNR_Clu_272 : 54|7@0+ (0.5,0) [0|63.5] "dB"  GW
 SG_ ARS_RDI_DynProp_Clu_272 : 63|2@0+ (1,0) [0|3] ""  GW
 SG_ ARS_RDI_Quality_Clu_272 : 61|2@0+ (1,0) [0|3] ""  GW
 SG_ ARS_RDI_DynProp_Clu_273 : 59|2@0+ (1,0) [0|3] ""  GW
 SG_ ARS_RDI_Quality_Clu_273 : 57|2@0+ (1,0) [0|3] ""  GW
 SG_ ARS_RDI_Range_Clu_273 : 71|12@0+ (0.0625,0) [0|255.9375] "m"  GW
 SG_ ARS_RDI_VradRel_Clu_273 : 75|11@0+ (0.1,-120) [-120|84.7] "m/s"  GW
 SG_ ARS_RDI_RCS_Clu_273 : 80|9@0+ (0.2,-51.2) [-51.2|51] "dBsm"  GW
 SG_ ARS_RDI_AzimuthAng_Clu_273 : 103|10@0+ (0.002,-1.022) [-1.022|1.024] "rad"  GW

BO_ 295 ARS_RDI_280_287: 64 FR
 SG_ ARS_RDI_Range_Clu_280 : 7|12@0+ (0.0625,0) [0|255.9375] "m"  GW
 SG_ ARS_RDI_ElevationAng_Clu_281 : 109|7@0+ (0.005,-0.315) [-0.315|0.32] "rad"  GW
 SG_ ARS_RDI_SNR_Clu_281 : 118|7@0+ (0.5,0) [0|63.5] "dB"  GW
 SG_ ARS_RDI_Range_Clu_282 : 127|12@0+ (0.0625,0) [0|255.9375] "m"  GW
 SG_ ARS_RDI_VradRel_Clu_280 : 11|11@0+ (0.1,-120) [-120|84.7] "m/s"  GW
 SG_ ARS_RDI_VradRel_Clu_282 : 131|11@0+ (0.1,-120) [-120|84.7] "m/s"  GW
 SG_ ARS_RDI_RCS_Clu_282 : 136|9@0+ (0.2,-51.2) [-51.2|51] "dBsm"  GW
 SG_ ARS_RDI_AzimuthAng_Clu_282 : 159|10@0+ (0.002,-1.022) [-1.022|1.024] "rad"  GW
 SG_ ARS_RDI_ElevationAng_Clu_282 : 165|7@0+ (0.005,-0.315) [-0.315|0.32] "rad"  GW
 SG_ ARS_RDI_SNR_Clu_282 : 174|7@0+ (0.5,0) [0|63.5] "dB"  GW
 SG_ ARS_RDI_DynProp_Clu_282 : 183|2@0+ (1,0) [0|3] ""  GW
 SG_ ARS_RDI_Quality_Clu_282 : 181|2@0+ (1,0) [0|3] ""  GW
 SG_ ARS_RDI_DynProp_Clu_283 : 179|2@0+ (1,0) [0|3] ""  GW
 SG_ ARS_RDI_Quality_Clu_283 : 177|2@0+ (1,0) [0|3] ""  GW
 SG_ ARS_RDI_Range_Clu_283 : 191|12@0+ (0.0625,0) [0|255.9375] "m"  GW
 SG_ ARS_RDI_VradRel_Clu_283 : 195|11@0+ (0.1,-120) [-120|84.7] "m/s"  GW
 SG_ ARS_RDI_RCS_Clu_283 : 200|9@0+ (0.2,-51.2) [-51.2|51] "dBsm"  GW
 SG_ ARS_RDI_AzimuthAng_Clu_283 : 223|10@0+ (0.002,-1.022) [-1.022|1.024] "rad"  GW
 SG_ ARS_RDI_ElevationAng_Clu_283 : 229|7@0+ (0.005,-0.315) [-0.315|0.32] "rad"  GW
 SG_ ARS_RDI_SNR_Clu_283 : 238|7@0+ (0.5,0) [0|63.5] "dB"  GW
 SG_ ARS_RDI_RCS_Clu_280 : 16|9@0+ (0.2,-51.2) [-51.2|51] "dBsm"  GW
 SG_ ARS_RDI_Range_Clu_284 : 247|12@0+ (0.0625,0) [0|255.9375] "m"  GW
 SG_ ARS_RDI_VradRel_Clu_284 : 251|11@0+ (0.1,-120) [-120|84.7] "m/s"  GW
 SG_ ARS_RDI_RCS_Clu_284 : 256|9@0+ (0.2,-51.2) [-51.2|51] "dBsm"  GW
 SG_ ARS_RDI_AzimuthAng_Clu_284 : 279|10@0+ (0.002,-1.022) [-1.022|1.024] "rad"  GW
 SG_ ARS_RDI_ElevationAng_Clu_284 : 285|7@0+ (0.005,-0.315) [-0.315|0.32] "rad"  GW
 SG_ ARS_RDI_SNR_Clu_284 : 294|7@0+ (0.5,0) [0|63.5] "dB"  GW
 SG_ ARS_RDI_DynProp_Clu_284 : 303|2@0+ (1,0) [0|3] ""  GW
 SG_ ARS_RDI_Quality_Clu_284 : 301|2@0+ (1,0) [0|3] ""  GW
 SG_ ARS_RDI_DynProp_Clu_285 : 299|2@0+ (1,0) [0|3] ""  GW
 SG_ ARS_RDI_Quality_Clu_285 : 297|2@0+ (1,0) [0|3] ""  GW
 SG_ ARS_RDI_Range_Clu_285 : 311|12@0+ (0.0625,0) [0|255.9375] "m"  GW
 SG_ ARS_RDI_VradRel_Clu_285 : 315|11@0+ (0.1,-120) [-120|84.7] "m/s"  GW
 SG_ ARS_RDI_RCS_Clu_285 : 320|9@0+ (0.2,-51.2) [-51.2|51] "dBsm"  GW
 SG_ ARS_RDI_AzimuthAng_Clu_280 : 39|10@0+ (0.002,-1.022) [-1.022|1.024] "rad"  GW
 SG_ ARS_RDI_AzimuthAng_Clu_285 : 343|10@0+ (0.002,-1.022) [-1.022|1.024] "rad"  GW
 SG_ ARS_RDI_ElevationAng_Clu_285 : 349|7@0+ (0.005,-0.315) [-0.315|0.32] "rad"  GW
 SG_ ARS_RDI_SNR_Clu_285 : 358|7@0+ (0.5,0) [0|63.5] "dB"  GW
 SG_ ARS_RDI_Range_Clu_286 : 367|12@0+ (0.0625,0) [0|255.9375] "m"  GW
 SG_ ARS_RDI_VradRel_Clu_286 : 371|11@0+ (0.1,-120) [-120|84.7] "m/s"  GW
 SG_ ARS_RDI_RCS_Clu_286 : 376|9@0+ (0.2,-51.2) [-51.2|51] "dBsm"  GW
 SG_ ARS_RDI_AzimuthAng_Clu_286 : 399|10@0+ (0.002,-1.022) [-1.022|1.024] "rad"  GW
 SG_ ARS_RDI_ElevationAng_Clu_286 : 405|7@0+ (0.005,-0.315) [-0.315|0.32] "rad"  GW
 SG_ ARS_RDI_SNR_Clu_286 : 414|7@0+ (0.5,0) [0|63.5] "dB"  GW
 SG_ ARS_RDI_DynProp_Clu_286 : 423|2@0+ (1,0) [0|3] ""  GW
 SG_ ARS_RDI_Quality_Clu_286 : 421|2@0+ (1,0) [0|3] ""  GW
 SG_ ARS_RDI_DynProp_Clu_287 : 419|2@0+ (1,0) [0|3] ""  GW
 SG_ ARS_RDI_Quality_Clu_287 : 417|2@0+ (1,0) [0|3] ""  GW
 SG_ ARS_RDI_Range_Clu_287 : 431|12@0+ (0.0625,0) [0|255.9375] "m"  GW
 SG_ ARS_RDI_ElevationAng_Clu_280 : 45|7@0+ (0.005,-0.315) [-0.315|0.32] "rad"  GW
 SG_ ARS_RDI_VradRel_Clu_287 : 435|11@0+ (0.1,-120) [-120|84.7] "m/s"  GW
 SG_ ARS_RDI_RCS_Clu_287 : 440|9@0+ (0.2,-51.2) [-51.2|51] "dBsm"  GW
 SG_ ARS_RDI_AzimuthAng_Clu_287 : 463|10@0+ (0.002,-1.022) [-1.022|1.024] "rad"  GW
 SG_ ARS_RDI_ElevationAng_Clu_287 : 469|7@0+ (0.005,-0.315) [-0.315|0.32] "rad"  GW
 SG_ ARS_RDI_SNR_Clu_287 : 478|7@0+ (0.5,0) [0|63.5] "dB"  GW
 SG_ ARS_RDI_MsgCounter_Clu_280_287 : 495|8@0+ (1,0) [0|255] ""  GW
 SG_ ARS_RDI_CRC16_Checksum_Clu_280_2 : 503|16@0+ (1,0) [0|65535] ""  GW
 SG_ ARS_RDI_SNR_Clu_280 : 54|7@0+ (0.5,0) [0|63.5] "dB"  GW
 SG_ ARS_RDI_DynProp_Clu_280 : 63|2@0+ (1,0) [0|3] ""  GW
 SG_ ARS_RDI_Quality_Clu_280 : 61|2@0+ (1,0) [0|3] ""  GW
 SG_ ARS_RDI_DynProp_Clu_281 : 59|2@0+ (1,0) [0|3] ""  GW
 SG_ ARS_RDI_Quality_Clu_281 : 57|2@0+ (1,0) [0|3] ""  GW
 SG_ ARS_RDI_Range_Clu_281 : 71|12@0+ (0.0625,0) [0|255.9375] "m"  GW
 SG_ ARS_RDI_VradRel_Clu_281 : 75|11@0+ (0.1,-120) [-120|84.7] "m/s"  GW
 SG_ ARS_RDI_RCS_Clu_281 : 80|9@0+ (0.2,-51.2) [-51.2|51] "dBsm"  GW
 SG_ ARS_RDI_AzimuthAng_Clu_281 : 103|10@0+ (0.002,-1.022) [-1.022|1.024] "rad"  GW

BO_ 296 ARS_RDI_288_295: 64 FR
 SG_ ARS_RDI_Range_Clu_288 : 7|12@0+ (0.0625,0) [0|255.9375] "m"  GW
 SG_ ARS_RDI_ElevationAng_Clu_289 : 109|7@0+ (0.005,-0.315) [-0.315|0.32] "rad"  GW
 SG_ ARS_RDI_SNR_Clu_289 : 118|7@0+ (0.5,0) [0|63.5] "dB"  GW
 SG_ ARS_RDI_Range_Clu_290 : 127|12@0+ (0.0625,0) [0|255.9375] "m"  GW
 SG_ ARS_RDI_VradRel_Clu_288 : 11|11@0+ (0.1,-120) [-120|84.7] "m/s"  GW
 SG_ ARS_RDI_VradRel_Clu_290 : 131|11@0+ (0.1,-120) [-120|84.7] "m/s"  GW
 SG_ ARS_RDI_RCS_Clu_290 : 136|9@0+ (0.2,-51.2) [-51.2|51] "dBsm"  GW
 SG_ ARS_RDI_AzimuthAng_Clu_290 : 159|10@0+ (0.002,-1.022) [-1.022|1.024] "rad"  GW
 SG_ ARS_RDI_ElevationAng_Clu_290 : 165|7@0+ (0.005,-0.315) [-0.315|0.32] "rad"  GW
 SG_ ARS_RDI_SNR_Clu_290 : 174|7@0+ (0.5,0) [0|63.5] "dB"  GW
 SG_ ARS_RDI_DynProp_Clu_290 : 183|2@0+ (1,0) [0|3] ""  GW
 SG_ ARS_RDI_Quality_Clu_290 : 181|2@0+ (1,0) [0|3] ""  GW
 SG_ ARS_RDI_DynProp_Clu_291 : 179|2@0+ (1,0) [0|3] ""  GW
 SG_ ARS_RDI_Quality_Clu_291 : 177|2@0+ (1,0) [0|3] ""  GW
 SG_ ARS_RDI_Range_Clu_291 : 191|12@0+ (0.0625,0) [0|255.9375] "m"  GW
 SG_ ARS_RDI_VradRel_Clu_291 : 195|11@0+ (0.1,-120) [-120|84.7] "m/s"  GW
 SG_ ARS_RDI_RCS_Clu_291 : 200|9@0+ (0.2,-51.2) [-51.2|51] "dBsm"  GW
 SG_ ARS_RDI_AzimuthAng_Clu_291 : 223|10@0+ (0.002,-1.022) [-1.022|1.024] "rad"  GW
 SG_ ARS_RDI_ElevationAng_Clu_291 : 229|7@0+ (0.005,-0.315) [-0.315|0.32] "rad"  GW
 SG_ ARS_RDI_SNR_Clu_291 : 238|7@0+ (0.5,0) [0|63.5] "dB"  GW
 SG_ ARS_RDI_RCS_Clu_288 : 16|9@0+ (0.2,-51.2) [-51.2|51] "dBsm"  GW
 SG_ ARS_RDI_Range_Clu_292 : 247|12@0+ (0.0625,0) [0|255.9375] "m"  GW
 SG_ ARS_RDI_VradRel_Clu_292 : 251|11@0+ (0.1,-120) [-120|84.7] "m/s"  GW
 SG_ ARS_RDI_RCS_Clu_292 : 256|9@0+ (0.2,-51.2) [-51.2|51] "dBsm"  GW
 SG_ ARS_RDI_AzimuthAng_Clu_292 : 279|10@0+ (0.002,-1.022) [-1.022|1.024] "rad"  GW
 SG_ ARS_RDI_ElevationAng_Clu_292 : 285|7@0+ (0.005,-0.315) [-0.315|0.32] "rad"  GW
 SG_ ARS_RDI_SNR_Clu_292 : 294|7@0+ (0.5,0) [0|63.5] "dB"  GW
 SG_ ARS_RDI_DynProp_Clu_292 : 303|2@0+ (1,0) [0|3] ""  GW
 SG_ ARS_RDI_Quality_Clu_292 : 301|2@0+ (1,0) [0|3] ""  GW
 SG_ ARS_RDI_DynProp_Clu_293 : 299|2@0+ (1,0) [0|3] ""  GW
 SG_ ARS_RDI_Quality_Clu_293 : 297|2@0+ (1,0) [0|3] ""  GW
 SG_ ARS_RDI_Range_Clu_293 : 311|12@0+ (0.0625,0) [0|255.9375] "m"  GW
 SG_ ARS_RDI_VradRel_Clu_293 : 315|11@0+ (0.1,-120) [-120|84.7] "m/s"  GW
 SG_ ARS_RDI_RCS_Clu_293 : 320|9@0+ (0.2,-51.2) [-51.2|51] "dBsm"  GW
 SG_ ARS_RDI_AzimuthAng_Clu_288 : 39|10@0+ (0.002,-1.022) [-1.022|1.024] "rad"  GW
 SG_ ARS_RDI_AzimuthAng_Clu_293 : 343|10@0+ (0.002,-1.022) [-1.022|1.024] "rad"  GW
 SG_ ARS_RDI_ElevationAng_Clu_293 : 349|7@0+ (0.005,-0.315) [-0.315|0.32] "rad"  GW
 SG_ ARS_RDI_SNR_Clu_293 : 358|7@0+ (0.5,0) [0|63.5] "dB"  GW
 SG_ ARS_RDI_Range_Clu_294 : 367|12@0+ (0.0625,0) [0|255.9375] "m"  GW
 SG_ ARS_RDI_VradRel_Clu_294 : 371|11@0+ (0.1,-120) [-120|84.7] "m/s"  GW
 SG_ ARS_RDI_RCS_Clu_294 : 376|9@0+ (0.2,-51.2) [-51.2|51] "dBsm"  GW
 SG_ ARS_RDI_AzimuthAng_Clu_294 : 399|10@0+ (0.002,-1.022) [-1.022|1.024] "rad"  GW
 SG_ ARS_RDI_ElevationAng_Clu_294 : 405|7@0+ (0.005,-0.315) [-0.315|0.32] "rad"  GW
 SG_ ARS_RDI_SNR_Clu_294 : 414|7@0+ (0.5,0) [0|63.5] "dB"  GW
 SG_ ARS_RDI_DynProp_Clu_294 : 423|2@0+ (1,0) [0|3] ""  GW
 SG_ ARS_RDI_Quality_Clu_294 : 421|2@0+ (1,0) [0|3] ""  GW
 SG_ ARS_RDI_DynProp_Clu_295 : 419|2@0+ (1,0) [0|3] ""  GW
 SG_ ARS_RDI_Quality_Clu_295 : 417|2@0+ (1,0) [0|3] ""  GW
 SG_ ARS_RDI_Range_Clu_295 : 431|12@0+ (0.0625,0) [0|255.9375] "m"  GW
 SG_ ARS_RDI_ElevationAng_Clu_288 : 45|7@0+ (0.005,-0.315) [-0.315|0.32] "rad"  GW
 SG_ ARS_RDI_VradRel_Clu_295 : 435|11@0+ (0.1,-120) [-120|84.7] "m/s"  GW
 SG_ ARS_RDI_RCS_Clu_295 : 440|9@0+ (0.2,-51.2) [-51.2|51] "dBsm"  GW
 SG_ ARS_RDI_AzimuthAng_Clu_295 : 463|10@0+ (0.002,-1.022) [-1.022|1.024] "rad"  GW
 SG_ ARS_RDI_ElevationAng_Clu_295 : 469|7@0+ (0.005,-0.315) [-0.315|0.32] "rad"  GW
 SG_ ARS_RDI_SNR_Clu_295 : 478|7@0+ (0.5,0) [0|63.5] "dB"  GW
 SG_ ARS_RDI_MsgCounter_Clu_288_295 : 495|8@0+ (1,0) [0|255] ""  GW
 SG_ ARS_RDI_CRC16_Checksum_Clu_288_2 : 503|16@0+ (1,0) [0|65535] ""  GW
 SG_ ARS_RDI_SNR_Clu_288 : 54|7@0+ (0.5,0) [0|63.5] "dB"  GW
 SG_ ARS_RDI_DynProp_Clu_288 : 63|2@0+ (1,0) [0|3] ""  GW
 SG_ ARS_RDI_Quality_Clu_288 : 61|2@0+ (1,0) [0|3] ""  GW
 SG_ ARS_RDI_DynProp_Clu_289 : 59|2@0+ (1,0) [0|3] ""  GW
 SG_ ARS_RDI_Quality_Clu_289 : 57|2@0+ (1,0) [0|3] ""  GW
 SG_ ARS_RDI_Range_Clu_289 : 71|12@0+ (0.0625,0) [0|255.9375] "m"  GW
 SG_ ARS_RDI_VradRel_Clu_289 : 75|11@0+ (0.1,-120) [-120|84.7] "m/s"  GW
 SG_ ARS_RDI_RCS_Clu_289 : 80|9@0+ (0.2,-51.2) [-51.2|51] "dBsm"  GW
 SG_ ARS_RDI_AzimuthAng_Clu_289 : 103|10@0+ (0.002,-1.022) [-1.022|1.024] "rad"  GW

BO_ 297 ARS_RDI_296_303: 64 FR
 SG_ ARS_RDI_Range_Clu_296 : 7|12@0+ (0.0625,0) [0|255.9375] "m"  GW
 SG_ ARS_RDI_ElevationAng_Clu_297 : 109|7@0+ (0.005,-0.315) [-0.315|0.32] "rad"  GW
 SG_ ARS_RDI_SNR_Clu_297 : 118|7@0+ (0.5,0) [0|63.5] "dB"  GW
 SG_ ARS_RDI_Range_Clu_298 : 127|12@0+ (0.0625,0) [0|255.9375] "m"  GW
 SG_ ARS_RDI_VradRel_Clu_296 : 11|11@0+ (0.1,-120) [-120|84.7] "m/s"  GW
 SG_ ARS_RDI_VradRel_Clu_298 : 131|11@0+ (0.1,-120) [-120|84.7] "m/s"  GW
 SG_ ARS_RDI_RCS_Clu_298 : 136|9@0+ (0.2,-51.2) [-51.2|51] "dBsm"  GW
 SG_ ARS_RDI_AzimuthAng_Clu_298 : 159|10@0+ (0.002,-1.022) [-1.022|1.024] "rad"  GW
 SG_ ARS_RDI_ElevationAng_Clu_298 : 165|7@0+ (0.005,-0.315) [-0.315|0.32] "rad"  GW
 SG_ ARS_RDI_SNR_Clu_298 : 174|7@0+ (0.5,0) [0|63.5] "dB"  GW
 SG_ ARS_RDI_DynProp_Clu_298 : 183|2@0+ (1,0) [0|3] ""  GW
 SG_ ARS_RDI_Quality_Clu_298 : 181|2@0+ (1,0) [0|3] ""  GW
 SG_ ARS_RDI_DynProp_Clu_299 : 179|2@0+ (1,0) [0|3] ""  GW
 SG_ ARS_RDI_Quality_Clu_299 : 177|2@0+ (1,0) [0|3] ""  GW
 SG_ ARS_RDI_Range_Clu_299 : 191|12@0+ (0.0625,0) [0|255.9375] "m"  GW
 SG_ ARS_RDI_VradRel_Clu_299 : 195|11@0+ (0.1,-120) [-120|84.7] "m/s"  GW
 SG_ ARS_RDI_RCS_Clu_299 : 200|9@0+ (0.2,-51.2) [-51.2|51] "dBsm"  GW
 SG_ ARS_RDI_AzimuthAng_Clu_299 : 223|10@0+ (0.002,-1.022) [-1.022|1.024] "rad"  GW
 SG_ ARS_RDI_ElevationAng_Clu_299 : 229|7@0+ (0.005,-0.315) [-0.315|0.32] "rad"  GW
 SG_ ARS_RDI_SNR_Clu_299 : 238|7@0+ (0.5,0) [0|63.5] "dB"  GW
 SG_ ARS_RDI_RCS_Clu_296 : 16|9@0+ (0.2,-51.2) [-51.2|51] "dBsm"  GW
 SG_ ARS_RDI_Range_Clu_300 : 247|12@0+ (0.0625,0) [0|255.9375] "m"  GW
 SG_ ARS_RDI_VradRel_Clu_300 : 251|11@0+ (0.1,-120) [-120|84.7] "m/s"  GW
 SG_ ARS_RDI_RCS_Clu_300 : 256|9@0+ (0.2,-51.2) [-51.2|51] "dBsm"  GW
 SG_ ARS_RDI_AzimuthAng_Clu_300 : 279|10@0+ (0.002,-1.022) [-1.022|1.024] "rad"  GW
 SG_ ARS_RDI_ElevationAng_Clu_300 : 285|7@0+ (0.005,-0.315) [-0.315|0.32] "rad"  GW
 SG_ ARS_RDI_SNR_Clu_300 : 294|7@0+ (0.5,0) [0|63.5] "dB"  GW
 SG_ ARS_RDI_DynProp_Clu_300 : 303|2@0+ (1,0) [0|3] ""  GW
 SG_ ARS_RDI_Quality_Clu_300 : 301|2@0+ (1,0) [0|3] ""  GW
 SG_ ARS_RDI_DynProp_Clu_301 : 299|2@0+ (1,0) [0|3] ""  GW
 SG_ ARS_RDI_Quality_Clu_301 : 297|2@0+ (1,0) [0|3] ""  GW
 SG_ ARS_RDI_Range_Clu_301 : 311|12@0+ (0.0625,0) [0|255.9375] "m"  GW
 SG_ ARS_RDI_VradRel_Clu_301 : 315|11@0+ (0.1,-120) [-120|84.7] "m/s"  GW
 SG_ ARS_RDI_RCS_Clu_301 : 320|9@0+ (0.2,-51.2) [-51.2|51] "dBsm"  GW
 SG_ ARS_RDI_AzimuthAng_Clu_296 : 39|10@0+ (0.002,-1.022) [-1.022|1.024] "rad"  GW
 SG_ ARS_RDI_AzimuthAng_Clu_301 : 343|10@0+ (0.002,-1.022) [-1.022|1.024] "rad"  GW
 SG_ ARS_RDI_ElevationAng_Clu_301 : 349|7@0+ (0.005,-0.315) [-0.315|0.32] "rad"  GW
 SG_ ARS_RDI_SNR_Clu_301 : 358|7@0+ (0.5,0) [0|63.5] "dB"  GW
 SG_ ARS_RDI_Range_Clu_302 : 367|12@0+ (0.0625,0) [0|255.9375] "m"  GW
 SG_ ARS_RDI_VradRel_Clu_302 : 371|11@0+ (0.1,-120) [-120|84.7] "m/s"  GW
 SG_ ARS_RDI_RCS_Clu_302 : 376|9@0+ (0.2,-51.2) [-51.2|51] "dBsm"  GW
 SG_ ARS_RDI_AzimuthAng_Clu_302 : 399|10@0+ (0.002,-1.022) [-1.022|1.024] "rad"  GW
 SG_ ARS_RDI_ElevationAng_Clu_302 : 405|7@0+ (0.005,-0.315) [-0.315|0.32] "rad"  GW
 SG_ ARS_RDI_SNR_Clu_302 : 414|7@0+ (0.5,0) [0|63.5] "dB"  GW
 SG_ ARS_RDI_DynProp_Clu_302 : 423|2@0+ (1,0) [0|3] ""  GW
 SG_ ARS_RDI_Quality_Clu_302 : 421|2@0+ (1,0) [0|3] ""  GW
 SG_ ARS_RDI_DynProp_Clu_303 : 419|2@0+ (1,0) [0|3] ""  GW
 SG_ ARS_RDI_Quality_Clu_303 : 417|2@0+ (1,0) [0|3] ""  GW
 SG_ ARS_RDI_Range_Clu_303 : 431|12@0+ (0.0625,0) [0|255.9375] "m"  GW
 SG_ ARS_RDI_ElevationAng_Clu_296 : 45|7@0+ (0.005,-0.315) [-0.315|0.32] "rad"  GW
 SG_ ARS_RDI_VradRel_Clu_303 : 435|11@0+ (0.1,-120) [-120|84.7] "m/s"  GW
 SG_ ARS_RDI_RCS_Clu_303 : 440|9@0+ (0.2,-51.2) [-51.2|51] "dBsm"  GW
 SG_ ARS_RDI_AzimuthAng_Clu_303 : 463|10@0+ (0.002,-1.022) [-1.022|1.024] "rad"  GW
 SG_ ARS_RDI_ElevationAng_Clu_303 : 469|7@0+ (0.005,-0.315) [-0.315|0.32] "rad"  GW
 SG_ ARS_RDI_SNR_Clu_303 : 478|7@0+ (0.5,0) [0|63.5] "dB"  GW
 SG_ ARS_RDI_MsgCounter_Clu_296_303 : 495|8@0+ (1,0) [0|255] ""  GW
 SG_ ARS_RDI_CRC16_Checksum_Clu_296_3 : 503|16@0+ (1,0) [0|65535] ""  GW
 SG_ ARS_RDI_SNR_Clu_296 : 54|7@0+ (0.5,0) [0|63.5] "dB"  GW
 SG_ ARS_RDI_DynProp_Clu_296 : 63|2@0+ (1,0) [0|3] ""  GW
 SG_ ARS_RDI_Quality_Clu_296 : 61|2@0+ (1,0) [0|3] ""  GW
 SG_ ARS_RDI_DynProp_Clu_297 : 59|2@0+ (1,0) [0|3] ""  GW
 SG_ ARS_RDI_Quality_Clu_297 : 57|2@0+ (1,0) [0|3] ""  GW
 SG_ ARS_RDI_Range_Clu_297 : 71|12@0+ (0.0625,0) [0|255.9375] "m"  GW
 SG_ ARS_RDI_VradRel_Clu_297 : 75|11@0+ (0.1,-120) [-120|84.7] "m/s"  GW
 SG_ ARS_RDI_RCS_Clu_297 : 80|9@0+ (0.2,-51.2) [-51.2|51] "dBsm"  GW
 SG_ ARS_RDI_AzimuthAng_Clu_297 : 103|10@0+ (0.002,-1.022) [-1.022|1.024] "rad"  GW

BO_ 298 ARS_RDI_304_311: 64 FR
 SG_ ARS_RDI_Range_Clu_304 : 7|12@0+ (0.0625,0) [0|255.9375] "m"  GW
 SG_ ARS_RDI_ElevationAng_Clu_305 : 109|7@0+ (0.005,-0.315) [-0.315|0.32] "rad"  GW
 SG_ ARS_RDI_SNR_Clu_305 : 118|7@0+ (0.5,0) [0|63.5] "dB"  GW
 SG_ ARS_RDI_Range_Clu_306 : 127|12@0+ (0.0625,0) [0|255.9375] "m"  GW
 SG_ ARS_RDI_VradRel_Clu_304 : 11|11@0+ (0.1,-120) [-120|84.7] "m/s"  GW
 SG_ ARS_RDI_VradRel_Clu_306 : 131|11@0+ (0.1,-120) [-120|84.7] "m/s"  GW
 SG_ ARS_RDI_RCS_Clu_306 : 136|9@0+ (0.2,-51.2) [-51.2|51] "dBsm"  GW
 SG_ ARS_RDI_AzimuthAng_Clu_306 : 159|10@0+ (0.002,-1.022) [-1.022|1.024] "rad"  GW
 SG_ ARS_RDI_ElevationAng_Clu_306 : 165|7@0+ (0.005,-0.315) [-0.315|0.32] "rad"  GW
 SG_ ARS_RDI_SNR_Clu_306 : 174|7@0+ (0.5,0) [0|63.5] "dB"  GW
 SG_ ARS_RDI_DynProp_Clu_306 : 183|2@0+ (1,0) [0|3] ""  GW
 SG_ ARS_RDI_Quality_Clu_306 : 181|2@0+ (1,0) [0|3] ""  GW
 SG_ ARS_RDI_DynProp_Clu_307 : 179|2@0+ (1,0) [0|3] ""  GW
 SG_ ARS_RDI_Quality_Clu_307 : 177|2@0+ (1,0) [0|3] ""  GW
 SG_ ARS_RDI_Range_Clu_307 : 191|12@0+ (0.0625,0) [0|255.9375] "m"  GW
 SG_ ARS_RDI_VradRel_Clu_307 : 195|11@0+ (0.1,-120) [-120|84.7] "m/s"  GW
 SG_ ARS_RDI_RCS_Clu_307 : 200|9@0+ (0.2,-51.2) [-51.2|51] "dBsm"  GW
 SG_ ARS_RDI_AzimuthAng_Clu_307 : 223|10@0+ (0.002,-1.022) [-1.022|1.024] "rad"  GW
 SG_ ARS_RDI_ElevationAng_Clu_307 : 229|7@0+ (0.005,-0.315) [-0.315|0.32] "rad"  GW
 SG_ ARS_RDI_SNR_Clu_307 : 238|7@0+ (0.5,0) [0|63.5] "dB"  GW
 SG_ ARS_RDI_RCS_Clu_304 : 16|9@0+ (0.2,-51.2) [-51.2|51] "dBsm"  GW
 SG_ ARS_RDI_Range_Clu_308 : 247|12@0+ (0.0625,0) [0|255.9375] "m"  GW
 SG_ ARS_RDI_VradRel_Clu_308 : 251|11@0+ (0.1,-120) [-120|84.7] "m/s"  GW
 SG_ ARS_RDI_RCS_Clu_308 : 256|9@0+ (0.2,-51.2) [-51.2|51] "dBsm"  GW
 SG_ ARS_RDI_AzimuthAng_Clu_308 : 279|10@0+ (0.002,-1.022) [-1.022|1.024] "rad"  GW
 SG_ ARS_RDI_ElevationAng_Clu_308 : 285|7@0+ (0.005,-0.315) [-0.315|0.32] "rad"  GW
 SG_ ARS_RDI_SNR_Clu_308 : 294|7@0+ (0.5,0) [0|63.5] "dB"  GW
 SG_ ARS_RDI_DynProp_Clu_308 : 303|2@0+ (1,0) [0|3] ""  GW
 SG_ ARS_RDI_Quality_Clu_308 : 301|2@0+ (1,0) [0|3] ""  GW
 SG_ ARS_RDI_DynProp_Clu_309 : 299|2@0+ (1,0) [0|3] ""  GW
 SG_ ARS_RDI_Quality_Clu_309 : 297|2@0+ (1,0) [0|3] ""  GW
 SG_ ARS_RDI_Range_Clu_309 : 311|12@0+ (0.0625,0) [0|255.9375] "m"  GW
 SG_ ARS_RDI_VradRel_Clu_309 : 315|11@0+ (0.1,-120) [-120|84.7] "m/s"  GW
 SG_ ARS_RDI_RCS_Clu_309 : 320|9@0+ (0.2,-51.2) [-51.2|51] "dBsm"  GW
 SG_ ARS_RDI_AzimuthAng_Clu_304 : 39|10@0+ (0.002,-1.022) [-1.022|1.024] "rad"  GW
 SG_ ARS_RDI_AzimuthAng_Clu_309 : 343|10@0+ (0.002,-1.022) [-1.022|1.024] "rad"  GW
 SG_ ARS_RDI_ElevationAng_Clu_309 : 349|7@0+ (0.005,-0.315) [-0.315|0.32] "rad"  GW
 SG_ ARS_RDI_SNR_Clu_309 : 358|7@0+ (0.5,0) [0|63.5] "dB"  GW
 SG_ ARS_RDI_Range_Clu_310 : 367|12@0+ (0.0625,0) [0|255.9375] "m"  GW
 SG_ ARS_RDI_VradRel_Clu_310 : 371|11@0+ (0.1,-120) [-120|84.7] "m/s"  GW
 SG_ ARS_RDI_RCS_Clu_310 : 376|9@0+ (0.2,-51.2) [-51.2|51] "dBsm"  GW
 SG_ ARS_RDI_AzimuthAng_Clu_310 : 399|10@0+ (0.002,-1.022) [-1.022|1.024] "rad"  GW
 SG_ ARS_RDI_ElevationAng_Clu_310 : 405|7@0+ (0.005,-0.315) [-0.315|0.32] "rad"  GW
 SG_ ARS_RDI_SNR_Clu_310 : 414|7@0+ (0.5,0) [0|63.5] "dB"  GW
 SG_ ARS_RDI_DynProp_Clu_310 : 423|2@0+ (1,0) [0|3] ""  GW
 SG_ ARS_RDI_Quality_Clu_310 : 421|2@0+ (1,0) [0|3] ""  GW
 SG_ ARS_RDI_DynProp_Clu_311 : 419|2@0+ (1,0) [0|3] ""  GW
 SG_ ARS_RDI_Quality_Clu_311 : 417|2@0+ (1,0) [0|3] ""  GW
 SG_ ARS_RDI_Range_Clu_311 : 431|12@0+ (0.0625,0) [0|255.9375] "m"  GW
 SG_ ARS_RDI_ElevationAng_Clu_304 : 45|7@0+ (0.005,-0.315) [-0.315|0.32] "rad"  GW
 SG_ ARS_RDI_VradRel_Clu_311 : 435|11@0+ (0.1,-120) [-120|84.7] "m/s"  GW
 SG_ ARS_RDI_RCS_Clu_311 : 440|9@0+ (0.2,-51.2) [-51.2|51] "dBsm"  GW
 SG_ ARS_RDI_AzimuthAng_Clu_311 : 463|10@0+ (0.002,-1.022) [-1.022|1.024] "rad"  GW
 SG_ ARS_RDI_ElevationAng_Clu_311 : 469|7@0+ (0.005,-0.315) [-0.315|0.32] "rad"  GW
 SG_ ARS_RDI_SNR_Clu_311 : 478|7@0+ (0.5,0) [0|63.5] "dB"  GW
 SG_ ARS_RDI_MsgCounter_Clu_304_311 : 495|8@0+ (1,0) [0|255] ""  GW
 SG_ ARS_RDI_CRC16_Checksum_Clu_304_3 : 503|16@0+ (1,0) [0|65535] ""  GW
 SG_ ARS_RDI_SNR_Clu_304 : 54|7@0+ (0.5,0) [0|63.5] "dB"  GW
 SG_ ARS_RDI_DynProp_Clu_304 : 63|2@0+ (1,0) [0|3] ""  GW
 SG_ ARS_RDI_Quality_Clu_304 : 61|2@0+ (1,0) [0|3] ""  GW
 SG_ ARS_RDI_DynProp_Clu_305 : 59|2@0+ (1,0) [0|3] ""  GW
 SG_ ARS_RDI_Quality_Clu_305 : 57|2@0+ (1,0) [0|3] ""  GW
 SG_ ARS_RDI_Range_Clu_305 : 71|12@0+ (0.0625,0) [0|255.9375] "m"  GW
 SG_ ARS_RDI_VradRel_Clu_305 : 75|11@0+ (0.1,-120) [-120|84.7] "m/s"  GW
 SG_ ARS_RDI_RCS_Clu_305 : 80|9@0+ (0.2,-51.2) [-51.2|51] "dBsm"  GW
 SG_ ARS_RDI_AzimuthAng_Clu_305 : 103|10@0+ (0.002,-1.022) [-1.022|1.024] "rad"  GW

BO_ 299 ARS_RDI_312_319: 64 FR
 SG_ ARS_RDI_Range_Clu_312 : 7|12@0+ (0.0625,0) [0|255.9375] "m"  GW
 SG_ ARS_RDI_ElevationAng_Clu_313 : 109|7@0+ (0.005,-0.315) [-0.315|0.32] "rad"  GW
 SG_ ARS_RDI_SNR_Clu_313 : 118|7@0+ (0.5,0) [0|63.5] "dB"  GW
 SG_ ARS_RDI_Range_Clu_314 : 127|12@0+ (0.0625,0) [0|255.9375] "m"  GW
 SG_ ARS_RDI_VradRel_Clu_312 : 11|11@0+ (0.1,-120) [-120|84.7] "m/s"  GW
 SG_ ARS_RDI_VradRel_Clu_314 : 131|11@0+ (0.1,-120) [-120|84.7] "m/s"  GW
 SG_ ARS_RDI_RCS_Clu_314 : 136|9@0+ (0.2,-51.2) [-51.2|51] "dBsm"  GW
 SG_ ARS_RDI_AzimuthAng_Clu_314 : 159|10@0+ (0.002,-1.022) [-1.022|1.024] "rad"  GW
 SG_ ARS_RDI_ElevationAng_Clu_314 : 165|7@0+ (0.005,-0.315) [-0.315|0.32] "rad"  GW
 SG_ ARS_RDI_SNR_Clu_314 : 174|7@0+ (0.5,0) [0|63.5] "dB"  GW
 SG_ ARS_RDI_DynProp_Clu_314 : 183|2@0+ (1,0) [0|3] ""  GW
 SG_ ARS_RDI_Quality_Clu_314 : 181|2@0+ (1,0) [0|3] ""  GW
 SG_ ARS_RDI_DynProp_Clu_315 : 179|2@0+ (1,0) [0|3] ""  GW
 SG_ ARS_RDI_Quality_Clu_315 : 177|2@0+ (1,0) [0|3] ""  GW
 SG_ ARS_RDI_Range_Clu_315 : 191|12@0+ (0.0625,0) [0|255.9375] "m"  GW
 SG_ ARS_RDI_VradRel_Clu_315 : 195|11@0+ (0.1,-120) [-120|84.7] "m/s"  GW
 SG_ ARS_RDI_RCS_Clu_315 : 200|9@0+ (0.2,-51.2) [-51.2|51] "dBsm"  GW
 SG_ ARS_RDI_AzimuthAng_Clu_315 : 223|10@0+ (0.002,-1.022) [-1.022|1.024] "rad"  GW
 SG_ ARS_RDI_ElevationAng_Clu_315 : 229|7@0+ (0.005,-0.315) [-0.315|0.32] "rad"  GW
 SG_ ARS_RDI_SNR_Clu_315 : 238|7@0+ (0.5,0) [0|63.5] "dB"  GW
 SG_ ARS_RDI_RCS_Clu_312 : 16|9@0+ (0.2,-51.2) [-51.2|51] "dBsm"  GW
 SG_ ARS_RDI_Range_Clu_316 : 247|12@0+ (0.0625,0) [0|255.9375] "m"  GW
 SG_ ARS_RDI_VradRel_Clu_316 : 251|11@0+ (0.1,-120) [-120|84.7] "m/s"  GW
 SG_ ARS_RDI_RCS_Clu_316 : 256|9@0+ (0.2,-51.2) [-51.2|51] "dBsm"  GW
 SG_ ARS_RDI_AzimuthAng_Clu_316 : 279|10@0+ (0.002,-1.022) [-1.022|1.024] "rad"  GW
 SG_ ARS_RDI_ElevationAng_Clu_316 : 285|7@0+ (0.005,-0.315) [-0.315|0.32] "rad"  GW
 SG_ ARS_RDI_SNR_Clu_316 : 294|7@0+ (0.5,0) [0|63.5] "dB"  GW
 SG_ ARS_RDI_DynProp_Clu_316 : 303|2@0+ (1,0) [0|3] ""  GW
 SG_ ARS_RDI_Quality_Clu_316 : 301|2@0+ (1,0) [0|3] ""  GW
 SG_ ARS_RDI_DynProp_Clu_317 : 299|2@0+ (1,0) [0|3] ""  GW
 SG_ ARS_RDI_Quality_Clu_317 : 297|2@0+ (1,0) [0|3] ""  GW
 SG_ ARS_RDI_Range_Clu_317 : 311|12@0+ (0.0625,0) [0|255.9375] "m"  GW
 SG_ ARS_RDI_VradRel_Clu_317 : 315|11@0+ (0.1,-120) [-120|84.7] "m/s"  GW
 SG_ ARS_RDI_RCS_Clu_317 : 320|9@0+ (0.2,-51.2) [-51.2|51] "dBsm"  GW
 SG_ ARS_RDI_AzimuthAng_Clu_312 : 39|10@0+ (0.002,-1.022) [-1.022|1.024] "rad"  GW
 SG_ ARS_RDI_AzimuthAng_Clu_317 : 343|10@0+ (0.002,-1.022) [-1.022|1.024] "rad"  GW
 SG_ ARS_RDI_ElevationAng_Clu_317 : 349|7@0+ (0.005,-0.315) [-0.315|0.32] "rad"  GW
 SG_ ARS_RDI_SNR_Clu_317 : 358|7@0+ (0.5,0) [0|63.5] "dB"  GW
 SG_ ARS_RDI_Range_Clu_318 : 367|12@0+ (0.0625,0) [0|255.9375] "m"  GW
 SG_ ARS_RDI_VradRel_Clu_318 : 371|11@0+ (0.1,-120) [-120|84.7] "m/s"  GW
 SG_ ARS_RDI_RCS_Clu_318 : 376|9@0+ (0.2,-51.2) [-51.2|51] "dBsm"  GW
 SG_ ARS_RDI_AzimuthAng_Clu_318 : 399|10@0+ (0.002,-1.022) [-1.022|1.024] "rad"  GW
 SG_ ARS_RDI_ElevationAng_Clu_318 : 405|7@0+ (0.005,-0.315) [-0.315|0.32] "rad"  GW
 SG_ ARS_RDI_SNR_Clu_318 : 414|7@0+ (0.5,0) [0|63.5] "dB"  GW
 SG_ ARS_RDI_DynProp_Clu_318 : 423|2@0+ (1,0) [0|3] ""  GW
 SG_ ARS_RDI_Quality_Clu_318 : 421|2@0+ (1,0) [0|3] ""  GW
 SG_ ARS_RDI_DynProp_Clu_319 : 419|2@0+ (1,0) [0|3] ""  GW
 SG_ ARS_RDI_Quality_Clu_319 : 417|2@0+ (1,0) [0|3] ""  GW
 SG_ ARS_RDI_Range_Clu_319 : 431|12@0+ (0.0625,0) [0|255.9375] "m"  GW
 SG_ ARS_RDI_ElevationAng_Clu_312 : 45|7@0+ (0.005,-0.315) [-0.315|0.32] "rad"  GW
 SG_ ARS_RDI_VradRel_Clu_319 : 435|11@0+ (0.1,-120) [-120|84.7] "m/s"  GW
 SG_ ARS_RDI_RCS_Clu_319 : 440|9@0+ (0.2,-51.2) [-51.2|51] "dBsm"  GW
 SG_ ARS_RDI_AzimuthAng_Clu_319 : 463|10@0+ (0.002,-1.022) [-1.022|1.024] "rad"  GW
 SG_ ARS_RDI_ElevationAng_Clu_319 : 469|7@0+ (0.005,-0.315) [-0.315|0.32] "rad"  GW
 SG_ ARS_RDI_SNR_Clu_319 : 478|7@0+ (0.5,0) [0|63.5] "dB"  GW
 SG_ ARS_RDI_MsgCounter_Clu_312_319 : 495|8@0+ (1,0) [0|255] ""  GW
 SG_ ARS_RDI_CRC16_Checksum_Clu_312_3 : 503|16@0+ (1,0) [0|65535] ""  GW
 SG_ ARS_RDI_SNR_Clu_312 : 54|7@0+ (0.5,0) [0|63.5] "dB"  GW
 SG_ ARS_RDI_DynProp_Clu_312 : 63|2@0+ (1,0) [0|3] ""  GW
 SG_ ARS_RDI_Quality_Clu_312 : 61|2@0+ (1,0) [0|3] ""  GW
 SG_ ARS_RDI_DynProp_Clu_313 : 59|2@0+ (1,0) [0|3] ""  GW
 SG_ ARS_RDI_Quality_Clu_313 : 57|2@0+ (1,0) [0|3] ""  GW
 SG_ ARS_RDI_Range_Clu_313 : 71|12@0+ (0.0625,0) [0|255.9375] "m"  GW
 SG_ ARS_RDI_VradRel_Clu_313 : 75|11@0+ (0.1,-120) [-120|84.7] "m/s"  GW
 SG_ ARS_RDI_RCS_Clu_313 : 80|9@0+ (0.2,-51.2) [-51.2|51] "dBsm"  GW
 SG_ ARS_RDI_AzimuthAng_Clu_313 : 103|10@0+ (0.002,-1.022) [-1.022|1.024] "rad"  GW

BO_ 300 ARS_RDI_320_327: 64 FR
 SG_ ARS_RDI_Range_Clu_320 : 7|12@0+ (0.0625,0) [0|255.9375] "m"  GW
 SG_ ARS_RDI_ElevationAng_Clu_321 : 109|7@0+ (0.005,-0.315) [-0.315|0.32] "rad"  GW
 SG_ ARS_RDI_SNR_Clu_321 : 118|7@0+ (0.5,0) [0|63.5] "dB"  GW
 SG_ ARS_RDI_Range_Clu_322 : 127|12@0+ (0.0625,0) [0|255.9375] "m"  GW
 SG_ ARS_RDI_VradRel_Clu_320 : 11|11@0+ (0.1,-120) [-120|84.7] "m/s"  GW
 SG_ ARS_RDI_VradRel_Clu_322 : 131|11@0+ (0.1,-120) [-120|84.7] "m/s"  GW
 SG_ ARS_RDI_RCS_Clu_322 : 136|9@0+ (0.2,-51.2) [-51.2|51] "dBsm"  GW
 SG_ ARS_RDI_AzimuthAng_Clu_322 : 159|10@0+ (0.002,-1.022) [-1.022|1.024] "rad"  GW
 SG_ ARS_RDI_ElevationAng_Clu_322 : 165|7@0+ (0.005,-0.315) [-0.315|0.32] "rad"  GW
 SG_ ARS_RDI_SNR_Clu_322 : 174|7@0+ (0.5,0) [0|63.5] "dB"  GW
 SG_ ARS_RDI_DynProp_Clu_322 : 183|2@0+ (1,0) [0|3] ""  GW
 SG_ ARS_RDI_Quality_Clu_322 : 181|2@0+ (1,0) [0|3] ""  GW
 SG_ ARS_RDI_DynProp_Clu_323 : 179|2@0+ (1,0) [0|3] ""  GW
 SG_ ARS_RDI_Quality_Clu_323 : 177|2@0+ (1,0) [0|3] ""  GW
 SG_ ARS_RDI_Range_Clu_323 : 191|12@0+ (0.0625,0) [0|255.9375] "m"  GW
 SG_ ARS_RDI_VradRel_Clu_323 : 195|11@0+ (0.1,-120) [-120|84.7] "m/s"  GW
 SG_ ARS_RDI_RCS_Clu_323 : 200|9@0+ (0.2,-51.2) [-51.2|51] "dBsm"  GW
 SG_ ARS_RDI_AzimuthAng_Clu_323 : 223|10@0+ (0.002,-1.022) [-1.022|1.024] "rad"  GW
 SG_ ARS_RDI_ElevationAng_Clu_323 : 229|7@0+ (0.005,-0.315) [-0.315|0.32] "rad"  GW
 SG_ ARS_RDI_SNR_Clu_323 : 238|7@0+ (0.5,0) [0|63.5] "dB"  GW
 SG_ ARS_RDI_RCS_Clu_320 : 16|9@0+ (0.2,-51.2) [-51.2|51] "dBsm"  GW
 SG_ ARS_RDI_Range_Clu_324 : 247|12@0+ (0.0625,0) [0|255.9375] "m"  GW
 SG_ ARS_RDI_VradRel_Clu_324 : 251|11@0+ (0.1,-120) [-120|84.7] "m/s"  GW
 SG_ ARS_RDI_RCS_Clu_324 : 256|9@0+ (0.2,-51.2) [-51.2|51] "dBsm"  GW
 SG_ ARS_RDI_AzimuthAng_Clu_324 : 279|10@0+ (0.002,-1.022) [-1.022|1.024] "rad"  GW
 SG_ ARS_RDI_ElevationAng_Clu_324 : 285|7@0+ (0.005,-0.315) [-0.315|0.32] "rad"  GW
 SG_ ARS_RDI_SNR_Clu_324 : 294|7@0+ (0.5,0) [0|63.5] "dB"  GW
 SG_ ARS_RDI_DynProp_Clu_324 : 303|2@0+ (1,0) [0|3] ""  GW
 SG_ ARS_RDI_Quality_Clu_324 : 301|2@0+ (1,0) [0|3] ""  GW
 SG_ ARS_RDI_DynProp_Clu_325 : 299|2@0+ (1,0) [0|3] ""  GW
 SG_ ARS_RDI_Quality_Clu_325 : 297|2@0+ (1,0) [0|3] ""  GW
 SG_ ARS_RDI_Range_Clu_325 : 311|12@0+ (0.0625,0) [0|255.9375] "m"  GW
 SG_ ARS_RDI_VradRel_Clu_325 : 315|11@0+ (0.1,-120) [-120|84.7] "m/s"  GW
 SG_ ARS_RDI_RCS_Clu_325 : 320|9@0+ (0.2,-51.2) [-51.2|51] "dBsm"  GW
 SG_ ARS_RDI_AzimuthAng_Clu_320 : 39|10@0+ (0.002,-1.022) [-1.022|1.024] "rad"  GW
 SG_ ARS_RDI_AzimuthAng_Clu_325 : 343|10@0+ (0.002,-1.022) [-1.022|1.024] "rad"  GW
 SG_ ARS_RDI_ElevationAng_Clu_325 : 349|7@0+ (0.005,-0.315) [-0.315|0.32] "rad"  GW
 SG_ ARS_RDI_SNR_Clu_325 : 358|7@0+ (0.5,0) [0|63.5] "dB"  GW
 SG_ ARS_RDI_Range_Clu_326 : 367|12@0+ (0.0625,0) [0|255.9375] "m"  GW
 SG_ ARS_RDI_VradRel_Clu_326 : 371|11@0+ (0.1,-120) [-120|84.7] "m/s"  GW
 SG_ ARS_RDI_RCS_Clu_326 : 376|9@0+ (0.2,-51.2) [-51.2|51] "dBsm"  GW
 SG_ ARS_RDI_AzimuthAng_Clu_326 : 399|10@0+ (0.002,-1.022) [-1.022|1.024] "rad"  GW
 SG_ ARS_RDI_ElevationAng_Clu_326 : 405|7@0+ (0.005,-0.315) [-0.315|0.32] "rad"  GW
 SG_ ARS_RDI_SNR_Clu_326 : 414|7@0+ (0.5,0) [0|63.5] "dB"  GW
 SG_ ARS_RDI_DynProp_Clu_326 : 423|2@0+ (1,0) [0|3] ""  GW
 SG_ ARS_RDI_Quality_Clu_326 : 421|2@0+ (1,0) [0|3] ""  GW
 SG_ ARS_RDI_DynProp_Clu_327 : 419|2@0+ (1,0) [0|3] ""  GW
 SG_ ARS_RDI_Quality_Clu_327 : 417|2@0+ (1,0) [0|3] ""  GW
 SG_ ARS_RDI_Range_Clu_327 : 431|12@0+ (0.0625,0) [0|255.9375] "m"  GW
 SG_ ARS_RDI_ElevationAng_Clu_320 : 45|7@0+ (0.005,-0.315) [-0.315|0.32] "rad"  GW
 SG_ ARS_RDI_VradRel_Clu_327 : 435|11@0+ (0.1,-120) [-120|84.7] "m/s"  GW
 SG_ ARS_RDI_RCS_Clu_327 : 440|9@0+ (0.2,-51.2) [-51.2|51] "dBsm"  GW
 SG_ ARS_RDI_AzimuthAng_Clu_327 : 463|10@0+ (0.002,-1.022) [-1.022|1.024] "rad"  GW
 SG_ ARS_RDI_ElevationAng_Clu_327 : 469|7@0+ (0.005,-0.315) [-0.315|0.32] "rad"  GW
 SG_ ARS_RDI_SNR_Clu_327 : 478|7@0+ (0.5,0) [0|63.5] "dB"  GW
 SG_ ARS_RDI_MsgCounter_Clu_320_327 : 495|8@0+ (1,0) [0|255] ""  GW
 SG_ ARS_RDI_CRC16_Checksum_Clu_320_3 : 503|16@0+ (1,0) [0|65535] ""  GW
 SG_ ARS_RDI_SNR_Clu_320 : 54|7@0+ (0.5,0) [0|63.5] "dB"  GW
 SG_ ARS_RDI_DynProp_Clu_320 : 63|2@0+ (1,0) [0|3] ""  GW
 SG_ ARS_RDI_Quality_Clu_320 : 61|2@0+ (1,0) [0|3] ""  GW
 SG_ ARS_RDI_DynProp_Clu_321 : 59|2@0+ (1,0) [0|3] ""  GW
 SG_ ARS_RDI_Quality_Clu_321 : 57|2@0+ (1,0) [0|3] ""  GW
 SG_ ARS_RDI_Range_Clu_321 : 71|12@0+ (0.0625,0) [0|255.9375] "m"  GW
 SG_ ARS_RDI_VradRel_Clu_321 : 75|11@0+ (0.1,-120) [-120|84.7] "m/s"  GW
 SG_ ARS_RDI_RCS_Clu_321 : 80|9@0+ (0.2,-51.2) [-51.2|51] "dBsm"  GW
 SG_ ARS_RDI_AzimuthAng_Clu_321 : 103|10@0+ (0.002,-1.022) [-1.022|1.024] "rad"  GW

BO_ 301 ARS_RDI_328_335: 64 FR
 SG_ ARS_RDI_Range_Clu_328 : 7|12@0+ (0.0625,0) [0|255.9375] "m"  GW
 SG_ ARS_RDI_ElevationAng_Clu_329 : 109|7@0+ (0.005,-0.315) [-0.315|0.32] "rad"  GW
 SG_ ARS_RDI_SNR_Clu_329 : 118|7@0+ (0.5,0) [0|63.5] "dB"  GW
 SG_ ARS_RDI_Range_Clu_330 : 127|12@0+ (0.0625,0) [0|255.9375] "m"  GW
 SG_ ARS_RDI_VradRel_Clu_328 : 11|11@0+ (0.1,-120) [-120|84.7] "m/s"  GW
 SG_ ARS_RDI_VradRel_Clu_330 : 131|11@0+ (0.1,-120) [-120|84.7] "m/s"  GW
 SG_ ARS_RDI_RCS_Clu_330 : 136|9@0+ (0.2,-51.2) [-51.2|51] "dBsm"  GW
 SG_ ARS_RDI_AzimuthAng_Clu_330 : 159|10@0+ (0.002,-1.022) [-1.022|1.024] "rad"  GW
 SG_ ARS_RDI_ElevationAng_Clu_330 : 165|7@0+ (0.005,-0.315) [-0.315|0.32] "rad"  GW
 SG_ ARS_RDI_SNR_Clu_330 : 174|7@0+ (0.5,0) [0|63.5] "dB"  GW
 SG_ ARS_RDI_DynProp_Clu_330 : 183|2@0+ (1,0) [0|3] ""  GW
 SG_ ARS_RDI_Quality_Clu_330 : 181|2@0+ (1,0) [0|3] ""  GW
 SG_ ARS_RDI_DynProp_Clu_331 : 179|2@0+ (1,0) [0|3] ""  GW
 SG_ ARS_RDI_Quality_Clu_331 : 177|2@0+ (1,0) [0|3] ""  GW
 SG_ ARS_RDI_Range_Clu_331 : 191|12@0+ (0.0625,0) [0|255.9375] "m"  GW
 SG_ ARS_RDI_VradRel_Clu_331 : 195|11@0+ (0.1,-120) [-120|84.7] "m/s"  GW
 SG_ ARS_RDI_RCS_Clu_331 : 200|9@0+ (0.2,-51.2) [-51.2|51] "dBsm"  GW
 SG_ ARS_RDI_AzimuthAng_Clu_331 : 223|10@0+ (0.002,-1.022) [-1.022|1.024] "rad"  GW
 SG_ ARS_RDI_ElevationAng_Clu_331 : 229|7@0+ (0.005,-0.315) [-0.315|0.32] "rad"  GW
 SG_ ARS_RDI_SNR_Clu_331 : 238|7@0+ (0.5,0) [0|63.5] "dB"  GW
 SG_ ARS_RDI_RCS_Clu_328 : 16|9@0+ (0.2,-51.2) [-51.2|51] "dBsm"  GW
 SG_ ARS_RDI_Range_Clu_332 : 247|12@0+ (0.0625,0) [0|255.9375] "m"  GW
 SG_ ARS_RDI_VradRel_Clu_332 : 251|11@0+ (0.1,-120) [-120|84.7] "m/s"  GW
 SG_ ARS_RDI_RCS_Clu_332 : 256|9@0+ (0.2,-51.2) [-51.2|51] "dBsm"  GW
 SG_ ARS_RDI_AzimuthAng_Clu_332 : 279|10@0+ (0.002,-1.022) [-1.022|1.024] "rad"  GW
 SG_ ARS_RDI_ElevationAng_Clu_332 : 285|7@0+ (0.005,-0.315) [-0.315|0.32] "rad"  GW
 SG_ ARS_RDI_SNR_Clu_332 : 294|7@0+ (0.5,0) [0|63.5] "dB"  GW
 SG_ ARS_RDI_DynProp_Clu_332 : 303|2@0+ (1,0) [0|3] ""  GW
 SG_ ARS_RDI_Quality_Clu_332 : 301|2@0+ (1,0) [0|3] ""  GW
 SG_ ARS_RDI_DynProp_Clu_333 : 299|2@0+ (1,0) [0|3] ""  GW
 SG_ ARS_RDI_Quality_Clu_333 : 297|2@0+ (1,0) [0|3] ""  GW
 SG_ ARS_RDI_Range_Clu_333 : 311|12@0+ (0.0625,0) [0|255.9375] "m"  GW
 SG_ ARS_RDI_VradRel_Clu_333 : 315|11@0+ (0.1,-120) [-120|84.7] "m/s"  GW
 SG_ ARS_RDI_RCS_Clu_333 : 320|9@0+ (0.2,-51.2) [-51.2|51] "dBsm"  GW
 SG_ ARS_RDI_AzimuthAng_Clu_328 : 39|10@0+ (0.002,-1.022) [-1.022|1.024] "rad"  GW
 SG_ ARS_RDI_AzimuthAng_Clu_333 : 343|10@0+ (0.002,-1.022) [-1.022|1.024] "rad"  GW
 SG_ ARS_RDI_ElevationAng_Clu_333 : 349|7@0+ (0.005,-0.315) [-0.315|0.32] "rad"  GW
 SG_ ARS_RDI_SNR_Clu_333 : 358|7@0+ (0.5,0) [0|63.5] "dB"  GW
 SG_ ARS_RDI_Range_Clu_334 : 367|12@0+ (0.0625,0) [0|255.9375] "m"  GW
 SG_ ARS_RDI_VradRel_Clu_334 : 371|11@0+ (0.1,-120) [-120|84.7] "m/s"  GW
 SG_ ARS_RDI_RCS_Clu_334 : 376|9@0+ (0.2,-51.2) [-51.2|51] "dBsm"  GW
 SG_ ARS_RDI_AzimuthAng_Clu_334 : 399|10@0+ (0.002,-1.022) [-1.022|1.024] "rad"  GW
 SG_ ARS_RDI_ElevationAng_Clu_334 : 405|7@0+ (0.005,-0.315) [-0.315|0.32] "rad"  GW
 SG_ ARS_RDI_SNR_Clu_334 : 414|7@0+ (0.5,0) [0|63.5] "dB"  GW
 SG_ ARS_RDI_DynProp_Clu_334 : 423|2@0+ (1,0) [0|3] ""  GW
 SG_ ARS_RDI_Quality_Clu_334 : 421|2@0+ (1,0) [0|3] ""  GW
 SG_ ARS_RDI_DynProp_Clu_335 : 419|2@0+ (1,0) [0|3] ""  GW
 SG_ ARS_RDI_Quality_Clu_335 : 417|2@0+ (1,0) [0|3] ""  GW
 SG_ ARS_RDI_Range_Clu_335 : 431|12@0+ (0.0625,0) [0|255.9375] "m"  GW
 SG_ ARS_RDI_ElevationAng_Clu_328 : 45|7@0+ (0.005,-0.315) [-0.315|0.32] "rad"  GW
 SG_ ARS_RDI_VradRel_Clu_335 : 435|11@0+ (0.1,-120) [-120|84.7] "m/s"  GW
 SG_ ARS_RDI_RCS_Clu_335 : 440|9@0+ (0.2,-51.2) [-51.2|51] "dBsm"  GW
 SG_ ARS_RDI_AzimuthAng_Clu_335 : 463|10@0+ (0.002,-1.022) [-1.022|1.024] "rad"  GW
 SG_ ARS_RDI_ElevationAng_Clu_335 : 469|7@0+ (0.005,-0.315) [-0.315|0.32] "rad"  GW
 SG_ ARS_RDI_SNR_Clu_335 : 478|7@0+ (0.5,0) [0|63.5] "dB"  GW
 SG_ ARS_RDI_MsgCounter_Clu_328_335 : 495|8@0+ (1,0) [0|255] ""  GW
 SG_ ARS_RDI_CRC16_Checksum_Clu_328_3 : 503|16@0+ (1,0) [0|65535] ""  GW
 SG_ ARS_RDI_SNR_Clu_328 : 54|7@0+ (0.5,0) [0|63.5] "dB"  GW
 SG_ ARS_RDI_DynProp_Clu_328 : 63|2@0+ (1,0) [0|3] ""  GW
 SG_ ARS_RDI_Quality_Clu_328 : 61|2@0+ (1,0) [0|3] ""  GW
 SG_ ARS_RDI_DynProp_Clu_329 : 59|2@0+ (1,0) [0|3] ""  GW
 SG_ ARS_RDI_Quality_Clu_329 : 57|2@0+ (1,0) [0|3] ""  GW
 SG_ ARS_RDI_Range_Clu_329 : 71|12@0+ (0.0625,0) [0|255.9375] "m"  GW
 SG_ ARS_RDI_VradRel_Clu_329 : 75|11@0+ (0.1,-120) [-120|84.7] "m/s"  GW
 SG_ ARS_RDI_RCS_Clu_329 : 80|9@0+ (0.2,-51.2) [-51.2|51] "dBsm"  GW
 SG_ ARS_RDI_AzimuthAng_Clu_329 : 103|10@0+ (0.002,-1.022) [-1.022|1.024] "rad"  GW

BO_ 302 ARS_RDI_336_343: 64 FR
 SG_ ARS_RDI_Range_Clu_336 : 7|12@0+ (0.0625,0) [0|255.9375] "m"  GW
 SG_ ARS_RDI_ElevationAng_Clu_337 : 109|7@0+ (0.005,-0.315) [-0.315|0.32] "rad"  GW
 SG_ ARS_RDI_SNR_Clu_337 : 118|7@0+ (0.5,0) [0|63.5] "dB"  GW
 SG_ ARS_RDI_Range_Clu_338 : 127|12@0+ (0.0625,0) [0|255.9375] "m"  GW
 SG_ ARS_RDI_VradRel_Clu_336 : 11|11@0+ (0.1,-120) [-120|84.7] "m/s"  GW
 SG_ ARS_RDI_VradRel_Clu_338 : 131|11@0+ (0.1,-120) [-120|84.7] "m/s"  GW
 SG_ ARS_RDI_RCS_Clu_338 : 136|9@0+ (0.2,-51.2) [-51.2|51] "dBsm"  GW
 SG_ ARS_RDI_AzimuthAng_Clu_338 : 159|10@0+ (0.002,-1.022) [-1.022|1.024] "rad"  GW
 SG_ ARS_RDI_ElevationAng_Clu_338 : 165|7@0+ (0.005,-0.315) [-0.315|0.32] "rad"  GW
 SG_ ARS_RDI_SNR_Clu_338 : 174|7@0+ (0.5,0) [0|63.5] "dB"  GW
 SG_ ARS_RDI_DynProp_Clu_338 : 183|2@0+ (1,0) [0|3] ""  GW
 SG_ ARS_RDI_Quality_Clu_338 : 181|2@0+ (1,0) [0|3] ""  GW
 SG_ ARS_RDI_DynProp_Clu_339 : 179|2@0+ (1,0) [0|3] ""  GW
 SG_ ARS_RDI_Quality_Clu_339 : 177|2@0+ (1,0) [0|3] ""  GW
 SG_ ARS_RDI_Range_Clu_339 : 191|12@0+ (0.0625,0) [0|255.9375] "m"  GW
 SG_ ARS_RDI_VradRel_Clu_339 : 195|11@0+ (0.1,-120) [-120|84.7] "m/s"  GW
 SG_ ARS_RDI_RCS_Clu_339 : 200|9@0+ (0.2,-51.2) [-51.2|51] "dBsm"  GW
 SG_ ARS_RDI_AzimuthAng_Clu_339 : 223|10@0+ (0.002,-1.022) [-1.022|1.024] "rad"  GW
 SG_ ARS_RDI_ElevationAng_Clu_339 : 229|7@0+ (0.005,-0.315) [-0.315|0.32] "rad"  GW
 SG_ ARS_RDI_SNR_Clu_339 : 238|7@0+ (0.5,0) [0|63.5] "dB"  GW
 SG_ ARS_RDI_RCS_Clu_336 : 16|9@0+ (0.2,-51.2) [-51.2|51] "dBsm"  GW
 SG_ ARS_RDI_Range_Clu_340 : 247|12@0+ (0.0625,0) [0|255.9375] "m"  GW
 SG_ ARS_RDI_VradRel_Clu_340 : 251|11@0+ (0.1,-120) [-120|84.7] "m/s"  GW
 SG_ ARS_RDI_RCS_Clu_340 : 256|9@0+ (0.2,-51.2) [-51.2|51] "dBsm"  GW
 SG_ ARS_RDI_AzimuthAng_Clu_340 : 279|10@0+ (0.002,-1.022) [-1.022|1.024] "rad"  GW
 SG_ ARS_RDI_ElevationAng_Clu_340 : 285|7@0+ (0.005,-0.315) [-0.315|0.32] "rad"  GW
 SG_ ARS_RDI_SNR_Clu_340 : 294|7@0+ (0.5,0) [0|63.5] "dB"  GW
 SG_ ARS_RDI_DynProp_Clu_340 : 303|2@0+ (1,0) [0|3] ""  GW
 SG_ ARS_RDI_Quality_Clu_340 : 301|2@0+ (1,0) [0|3] ""  GW
 SG_ ARS_RDI_DynProp_Clu_341 : 299|2@0+ (1,0) [0|3] ""  GW
 SG_ ARS_RDI_Quality_Clu_341 : 297|2@0+ (1,0) [0|3] ""  GW
 SG_ ARS_RDI_Range_Clu_341 : 311|12@0+ (0.0625,0) [0|255.9375] "m"  GW
 SG_ ARS_RDI_VradRel_Clu_341 : 315|11@0+ (0.1,-120) [-120|84.7] "m/s"  GW
 SG_ ARS_RDI_RCS_Clu_341 : 320|9@0+ (0.2,-51.2) [-51.2|51] "dBsm"  GW
 SG_ ARS_RDI_AzimuthAng_Clu_336 : 39|10@0+ (0.002,-1.022) [-1.022|1.024] "rad"  GW
 SG_ ARS_RDI_AzimuthAng_Clu_341 : 343|10@0+ (0.002,-1.022) [-1.022|1.024] "rad"  GW
 SG_ ARS_RDI_ElevationAng_Clu_341 : 349|7@0+ (0.005,-0.315) [-0.315|0.32] "rad"  GW
 SG_ ARS_RDI_SNR_Clu_341 : 358|7@0+ (0.5,0) [0|63.5] "dB"  GW
 SG_ ARS_RDI_Range_Clu_342 : 367|12@0+ (0.0625,0) [0|255.9375] "m"  GW
 SG_ ARS_RDI_VradRel_Clu_342 : 371|11@0+ (0.1,-120) [-120|84.7] "m/s"  GW
 SG_ ARS_RDI_RCS_Clu_342 : 376|9@0+ (0.2,-51.2) [-51.2|51] "dBsm"  GW
 SG_ ARS_RDI_AzimuthAng_Clu_342 : 399|10@0+ (0.002,-1.022) [-1.022|1.024] "rad"  GW
 SG_ ARS_RDI_ElevationAng_Clu_342 : 405|7@0+ (0.005,-0.315) [-0.315|0.32] "rad"  GW
 SG_ ARS_RDI_SNR_Clu_342 : 414|7@0+ (0.5,0) [0|63.5] "dB"  GW
 SG_ ARS_RDI_DynProp_Clu_342 : 423|2@0+ (1,0) [0|3] ""  GW
 SG_ ARS_RDI_Quality_Clu_342 : 421|2@0+ (1,0) [0|3] ""  GW
 SG_ ARS_RDI_DynProp_Clu_343 : 419|2@0+ (1,0) [0|3] ""  GW
 SG_ ARS_RDI_Quality_Clu_343 : 417|2@0+ (1,0) [0|3] ""  GW
 SG_ ARS_RDI_Range_Clu_343 : 431|12@0+ (0.0625,0) [0|255.9375] "m"  GW
 SG_ ARS_RDI_ElevationAng_Clu_336 : 45|7@0+ (0.005,-0.315) [-0.315|0.32] "rad"  GW
 SG_ ARS_RDI_VradRel_Clu_343 : 435|11@0+ (0.1,-120) [-120|84.7] "m/s"  GW
 SG_ ARS_RDI_RCS_Clu_343 : 440|9@0+ (0.2,-51.2) [-51.2|51] "dBsm"  GW
 SG_ ARS_RDI_AzimuthAng_Clu_343 : 463|10@0+ (0.002,-1.022) [-1.022|1.024] "rad"  GW
 SG_ ARS_RDI_ElevationAng_Clu_343 : 469|7@0+ (0.005,-0.315) [-0.315|0.32] "rad"  GW
 SG_ ARS_RDI_SNR_Clu_343 : 478|7@0+ (0.5,0) [0|63.5] "dB"  GW
 SG_ ARS_RDI_MsgCounter_Clu_336_343 : 495|8@0+ (1,0) [0|255] ""  GW
 SG_ ARS_RDI_CRC16_Checksum_Clu_336_3 : 503|16@0+ (1,0) [0|65535] ""  GW
 SG_ ARS_RDI_SNR_Clu_336 : 54|7@0+ (0.5,0) [0|63.5] "dB"  GW
 SG_ ARS_RDI_DynProp_Clu_336 : 63|2@0+ (1,0) [0|3] ""  GW
 SG_ ARS_RDI_Quality_Clu_336 : 61|2@0+ (1,0) [0|3] ""  GW
 SG_ ARS_RDI_DynProp_Clu_337 : 59|2@0+ (1,0) [0|3] ""  GW
 SG_ ARS_RDI_Quality_Clu_337 : 57|2@0+ (1,0) [0|3] ""  GW
 SG_ ARS_RDI_Range_Clu_337 : 71|12@0+ (0.0625,0) [0|255.9375] "m"  GW
 SG_ ARS_RDI_VradRel_Clu_337 : 75|11@0+ (0.1,-120) [-120|84.7] "m/s"  GW
 SG_ ARS_RDI_RCS_Clu_337 : 80|9@0+ (0.2,-51.2) [-51.2|51] "dBsm"  GW
 SG_ ARS_RDI_AzimuthAng_Clu_337 : 103|10@0+ (0.002,-1.022) [-1.022|1.024] "rad"  GW

BO_ 303 ARS_RDI_344_351: 64 FR
 SG_ ARS_RDI_Range_Clu_344 : 7|12@0+ (0.0625,0) [0|255.9375] "m"  GW
 SG_ ARS_RDI_ElevationAng_Clu_345 : 109|7@0+ (0.005,-0.315) [-0.315|0.32] "rad"  GW
 SG_ ARS_RDI_SNR_Clu_345 : 118|7@0+ (0.5,0) [0|63.5] "dB"  GW
 SG_ ARS_RDI_Range_Clu_346 : 127|12@0+ (0.0625,0) [0|255.9375] "m"  GW
 SG_ ARS_RDI_VradRel_Clu_344 : 11|11@0+ (0.1,-120) [-120|84.7] "m/s"  GW
 SG_ ARS_RDI_VradRel_Clu_346 : 131|11@0+ (0.1,-120) [-120|84.7] "m/s"  GW
 SG_ ARS_RDI_RCS_Clu_346 : 136|9@0+ (0.2,-51.2) [-51.2|51] "dBsm"  GW
 SG_ ARS_RDI_AzimuthAng_Clu_346 : 159|10@0+ (0.002,-1.022) [-1.022|1.024] "rad"  GW
 SG_ ARS_RDI_ElevationAng_Clu_346 : 165|7@0+ (0.005,-0.315) [-0.315|0.32] "rad"  GW
 SG_ ARS_RDI_SNR_Clu_346 : 174|7@0+ (0.5,0) [0|63.5] "dB"  GW
 SG_ ARS_RDI_DynProp_Clu_346 : 183|2@0+ (1,0) [0|3] ""  GW
 SG_ ARS_RDI_Quality_Clu_346 : 181|2@0+ (1,0) [0|3] ""  GW
 SG_ ARS_RDI_DynProp_Clu_347 : 179|2@0+ (1,0) [0|3] ""  GW
 SG_ ARS_RDI_Quality_Clu_347 : 177|2@0+ (1,0) [0|3] ""  GW
 SG_ ARS_RDI_Range_Clu_347 : 191|12@0+ (0.0625,0) [0|255.9375] "m"  GW
 SG_ ARS_RDI_VradRel_Clu_347 : 195|11@0+ (0.1,-120) [-120|84.7] "m/s"  GW
 SG_ ARS_RDI_RCS_Clu_347 : 200|9@0+ (0.2,-51.2) [-51.2|51] "dBsm"  GW
 SG_ ARS_RDI_AzimuthAng_Clu_347 : 223|10@0+ (0.002,-1.022) [-1.022|1.024] "rad"  GW
 SG_ ARS_RDI_ElevationAng_Clu_347 : 229|7@0+ (0.005,-0.315) [-0.315|0.32] "rad"  GW
 SG_ ARS_RDI_SNR_Clu_347 : 238|7@0+ (0.5,0) [0|63.5] "dB"  GW
 SG_ ARS_RDI_RCS_Clu_344 : 16|9@0+ (0.2,-51.2) [-51.2|51] "dBsm"  GW
 SG_ ARS_RDI_Range_Clu_348 : 247|12@0+ (0.0625,0) [0|255.9375] "m"  GW
 SG_ ARS_RDI_VradRel_Clu_348 : 251|11@0+ (0.1,-120) [-120|84.7] "m/s"  GW
 SG_ ARS_RDI_RCS_Clu_348 : 256|9@0+ (0.2,-51.2) [-51.2|51] "dBsm"  GW
 SG_ ARS_RDI_AzimuthAng_Clu_348 : 279|10@0+ (0.002,-1.022) [-1.022|1.024] "rad"  GW
 SG_ ARS_RDI_ElevationAng_Clu_348 : 285|7@0+ (0.005,-0.315) [-0.315|0.32] "rad"  GW
 SG_ ARS_RDI_SNR_Clu_348 : 294|7@0+ (0.5,0) [0|63.5] "dB"  GW
 SG_ ARS_RDI_DynProp_Clu_348 : 303|2@0+ (1,0) [0|3] ""  GW
 SG_ ARS_RDI_Quality_Clu_348 : 301|2@0+ (1,0) [0|3] ""  GW
 SG_ ARS_RDI_DynProp_Clu_349 : 299|2@0+ (1,0) [0|3] ""  GW
 SG_ ARS_RDI_Quality_Clu_349 : 297|2@0+ (1,0) [0|3] ""  GW
 SG_ ARS_RDI_Range_Clu_349 : 311|12@0+ (0.0625,0) [0|255.9375] "m"  GW
 SG_ ARS_RDI_VradRel_Clu_349 : 315|11@0+ (0.1,-120) [-120|84.7] "m/s"  GW
 SG_ ARS_RDI_RCS_Clu_349 : 320|9@0+ (0.2,-51.2) [-51.2|51] "dBsm"  GW
 SG_ ARS_RDI_AzimuthAng_Clu_344 : 39|10@0+ (0.002,-1.022) [-1.022|1.024] "rad"  GW
 SG_ ARS_RDI_AzimuthAng_Clu_349 : 343|10@0+ (0.002,-1.022) [-1.022|1.024] "rad"  GW
 SG_ ARS_RDI_ElevationAng_Clu_349 : 349|7@0+ (0.005,-0.315) [-0.315|0.32] "rad"  GW
 SG_ ARS_RDI_SNR_Clu_349 : 358|7@0+ (0.5,0) [0|63.5] "dB"  GW
 SG_ ARS_RDI_Range_Clu_350 : 367|12@0+ (0.0625,0) [0|255.9375] "m"  GW
 SG_ ARS_RDI_VradRel_Clu_350 : 371|11@0+ (0.1,-120) [-120|84.7] "m/s"  GW
 SG_ ARS_RDI_RCS_Clu_350 : 376|9@0+ (0.2,-51.2) [-51.2|51] "dBsm"  GW
 SG_ ARS_RDI_AzimuthAng_Clu_350 : 399|10@0+ (0.002,-1.022) [-1.022|1.024] "rad"  GW
 SG_ ARS_RDI_ElevationAng_Clu_350 : 405|7@0+ (0.005,-0.315) [-0.315|0.32] "rad"  GW
 SG_ ARS_RDI_SNR_Clu_350 : 414|7@0+ (0.5,0) [0|63.5] "dB"  GW
 SG_ ARS_RDI_DynProp_Clu_350 : 423|2@0+ (1,0) [0|3] ""  GW
 SG_ ARS_RDI_Quality_Clu_350 : 421|2@0+ (1,0) [0|3] ""  GW
 SG_ ARS_RDI_DynProp_Clu_351 : 419|2@0+ (1,0) [0|3] ""  GW
 SG_ ARS_RDI_Quality_Clu_351 : 417|2@0+ (1,0) [0|3] ""  GW
 SG_ ARS_RDI_Range_Clu_351 : 431|12@0+ (0.0625,0) [0|255.9375] "m"  GW
 SG_ ARS_RDI_ElevationAng_Clu_344 : 45|7@0+ (0.005,-0.315) [-0.315|0.32] "rad"  GW
 SG_ ARS_RDI_VradRel_Clu_351 : 435|11@0+ (0.1,-120) [-120|84.7] "m/s"  GW
 SG_ ARS_RDI_RCS_Clu_351 : 440|9@0+ (0.2,-51.2) [-51.2|51] "dBsm"  GW
 SG_ ARS_RDI_AzimuthAng_Clu_351 : 463|10@0+ (0.002,-1.022) [-1.022|1.024] "rad"  GW
 SG_ ARS_RDI_ElevationAng_Clu_351 : 469|7@0+ (0.005,-0.315) [-0.315|0.32] "rad"  GW
 SG_ ARS_RDI_SNR_Clu_351 : 478|7@0+ (0.5,0) [0|63.5] "dB"  GW
 SG_ ARS_RDI_MsgCounter_Clu_344_351 : 495|8@0+ (1,0) [0|255] ""  GW
 SG_ ARS_RDI_CRC16_Checksum_Clu_344_3 : 503|16@0+ (1,0) [0|65535] ""  GW
 SG_ ARS_RDI_SNR_Clu_344 : 54|7@0+ (0.5,0) [0|63.5] "dB"  GW
 SG_ ARS_RDI_DynProp_Clu_344 : 63|2@0+ (1,0) [0|3] ""  GW
 SG_ ARS_RDI_Quality_Clu_344 : 61|2@0+ (1,0) [0|3] ""  GW
 SG_ ARS_RDI_DynProp_Clu_345 : 59|2@0+ (1,0) [0|3] ""  GW
 SG_ ARS_RDI_Quality_Clu_345 : 57|2@0+ (1,0) [0|3] ""  GW
 SG_ ARS_RDI_Range_Clu_345 : 71|12@0+ (0.0625,0) [0|255.9375] "m"  GW
 SG_ ARS_RDI_VradRel_Clu_345 : 75|11@0+ (0.1,-120) [-120|84.7] "m/s"  GW
 SG_ ARS_RDI_RCS_Clu_345 : 80|9@0+ (0.2,-51.2) [-51.2|51] "dBsm"  GW
 SG_ ARS_RDI_AzimuthAng_Clu_345 : 103|10@0+ (0.002,-1.022) [-1.022|1.024] "rad"  GW

BO_ 304 ARS_RDI_352_359: 64 FR
 SG_ ARS_RDI_Range_Clu_352 : 7|12@0+ (0.0625,0) [0|255.9375] "m"  GW
 SG_ ARS_RDI_ElevationAng_Clu_353 : 109|7@0+ (0.005,-0.315) [-0.315|0.32] "rad"  GW
 SG_ ARS_RDI_SNR_Clu_353 : 118|7@0+ (0.5,0) [0|63.5] "dB"  GW
 SG_ ARS_RDI_Range_Clu_354 : 127|12@0+ (0.0625,0) [0|255.9375] "m"  GW
 SG_ ARS_RDI_VradRel_Clu_352 : 11|11@0+ (0.1,-120) [-120|84.7] "m/s"  GW
 SG_ ARS_RDI_VradRel_Clu_354 : 131|11@0+ (0.1,-120) [-120|84.7] "m/s"  GW
 SG_ ARS_RDI_RCS_Clu_354 : 136|9@0+ (0.2,-51.2) [-51.2|51] "dBsm"  GW
 SG_ ARS_RDI_AzimuthAng_Clu_354 : 159|10@0+ (0.002,-1.022) [-1.022|1.024] "rad"  GW
 SG_ ARS_RDI_ElevationAng_Clu_354 : 165|7@0+ (0.005,-0.315) [-0.315|0.32] "rad"  GW
 SG_ ARS_RDI_SNR_Clu_354 : 174|7@0+ (0.5,0) [0|63.5] "dB"  GW
 SG_ ARS_RDI_DynProp_Clu_354 : 183|2@0+ (1,0) [0|3] ""  GW
 SG_ ARS_RDI_Quality_Clu_354 : 181|2@0+ (1,0) [0|3] ""  GW
 SG_ ARS_RDI_DynProp_Clu_355 : 179|2@0+ (1,0) [0|3] ""  GW
 SG_ ARS_RDI_Quality_Clu_355 : 177|2@0+ (1,0) [0|3] ""  GW
 SG_ ARS_RDI_Range_Clu_355 : 191|12@0+ (0.0625,0) [0|255.9375] "m"  GW
 SG_ ARS_RDI_VradRel_Clu_355 : 195|11@0+ (0.1,-120) [-120|84.7] "m/s"  GW
 SG_ ARS_RDI_RCS_Clu_355 : 200|9@0+ (0.2,-51.2) [-51.2|51] "dBsm"  GW
 SG_ ARS_RDI_AzimuthAng_Clu_355 : 223|10@0+ (0.002,-1.022) [-1.022|1.024] "rad"  GW
 SG_ ARS_RDI_ElevationAng_Clu_355 : 229|7@0+ (0.005,-0.315) [-0.315|0.32] "rad"  GW
 SG_ ARS_RDI_SNR_Clu_355 : 238|7@0+ (0.5,0) [0|63.5] "dB"  GW
 SG_ ARS_RDI_RCS_Clu_352 : 16|9@0+ (0.2,-51.2) [-51.2|51] "dBsm"  GW
 SG_ ARS_RDI_Range_Clu_356 : 247|12@0+ (0.0625,0) [0|255.9375] "m"  GW
 SG_ ARS_RDI_VradRel_Clu_356 : 251|11@0+ (0.1,-120) [-120|84.7] "m/s"  GW
 SG_ ARS_RDI_RCS_Clu_356 : 256|9@0+ (0.2,-51.2) [-51.2|51] "dBsm"  GW
 SG_ ARS_RDI_AzimuthAng_Clu_356 : 279|10@0+ (0.002,-1.022) [-1.022|1.024] "rad"  GW
 SG_ ARS_RDI_ElevationAng_Clu_356 : 285|7@0+ (0.005,-0.315) [-0.315|0.32] "rad"  GW
 SG_ ARS_RDI_SNR_Clu_356 : 294|7@0+ (0.5,0) [0|63.5] "dB"  GW
 SG_ ARS_RDI_DynProp_Clu_356 : 303|2@0+ (1,0) [0|3] ""  GW
 SG_ ARS_RDI_Quality_Clu_356 : 301|2@0+ (1,0) [0|3] ""  GW
 SG_ ARS_RDI_DynProp_Clu_357 : 299|2@0+ (1,0) [0|3] ""  GW
 SG_ ARS_RDI_Quality_Clu_357 : 297|2@0+ (1,0) [0|3] ""  GW
 SG_ ARS_RDI_Range_Clu_357 : 311|12@0+ (0.0625,0) [0|255.9375] "m"  GW
 SG_ ARS_RDI_VradRel_Clu_357 : 315|11@0+ (0.1,-120) [-120|84.7] "m/s"  GW
 SG_ ARS_RDI_RCS_Clu_357 : 320|9@0+ (0.2,-51.2) [-51.2|51] "dBsm"  GW
 SG_ ARS_RDI_AzimuthAng_Clu_352 : 39|10@0+ (0.002,-1.022) [-1.022|1.024] "rad"  GW
 SG_ ARS_RDI_AzimuthAng_Clu_357 : 343|10@0+ (0.002,-1.022) [-1.022|1.024] "rad"  GW
 SG_ ARS_RDI_ElevationAng_Clu_357 : 349|7@0+ (0.005,-0.315) [-0.315|0.32] "rad"  GW
 SG_ ARS_RDI_SNR_Clu_357 : 358|7@0+ (0.5,0) [0|63.5] "dB"  GW
 SG_ ARS_RDI_Range_Clu_358 : 367|12@0+ (0.0625,0) [0|255.9375] "m"  GW
 SG_ ARS_RDI_VradRel_Clu_358 : 371|11@0+ (0.1,-120) [-120|84.7] "m/s"  GW
 SG_ ARS_RDI_RCS_Clu_358 : 376|9@0+ (0.2,-51.2) [-51.2|51] "dBsm"  GW
 SG_ ARS_RDI_AzimuthAng_Clu_358 : 399|10@0+ (0.002,-1.022) [-1.022|1.024] "rad"  GW
 SG_ ARS_RDI_ElevationAng_Clu_358 : 405|7@0+ (0.005,-0.315) [-0.315|0.32] "rad"  GW
 SG_ ARS_RDI_SNR_Clu_358 : 414|7@0+ (0.5,0) [0|63.5] "dB"  GW
 SG_ ARS_RDI_DynProp_Clu_358 : 423|2@0+ (1,0) [0|3] ""  GW
 SG_ ARS_RDI_Quality_Clu_358 : 421|2@0+ (1,0) [0|3] ""  GW
 SG_ ARS_RDI_DynProp_Clu_359 : 419|2@0+ (1,0) [0|3] ""  GW
 SG_ ARS_RDI_Quality_Clu_359 : 417|2@0+ (1,0) [0|3] ""  GW
 SG_ ARS_RDI_Range_Clu_359 : 431|12@0+ (0.0625,0) [0|255.9375] "m"  GW
 SG_ ARS_RDI_ElevationAng_Clu_352 : 45|7@0+ (0.005,-0.315) [-0.315|0.32] "rad"  GW
 SG_ ARS_RDI_VradRel_Clu_359 : 435|11@0+ (0.1,-120) [-120|84.7] "m/s"  GW
 SG_ ARS_RDI_RCS_Clu_359 : 440|9@0+ (0.2,-51.2) [-51.2|51] "dBsm"  GW
 SG_ ARS_RDI_AzimuthAng_Clu_359 : 463|10@0+ (0.002,-1.022) [-1.022|1.024] "rad"  GW
 SG_ ARS_RDI_ElevationAng_Clu_359 : 469|7@0+ (0.005,-0.315) [-0.315|0.32] "rad"  GW
 SG_ ARS_RDI_SNR_Clu_359 : 478|7@0+ (0.5,0) [0|63.5] "dB"  GW
 SG_ ARS_RDI_MsgCounter_Clu_352_359 : 495|8@0+ (1,0) [0|255] ""  GW
 SG_ ARS_RDI_CRC16_Checksum_Clu_352_3 : 503|16@0+ (1,0) [0|65535] ""  GW
 SG_ ARS_RDI_SNR_Clu_352 : 54|7@0+ (0.5,0) [0|63.5] "dB"  GW
 SG_ ARS_RDI_DynProp_Clu_352 : 63|2@0+ (1,0) [0|3] ""  GW
 SG_ ARS_RDI_Quality_Clu_352 : 61|2@0+ (1,0) [0|3] ""  GW
 SG_ ARS_RDI_DynProp_Clu_353 : 59|2@0+ (1,0) [0|3] ""  GW
 SG_ ARS_RDI_Quality_Clu_353 : 57|2@0+ (1,0) [0|3] ""  GW
 SG_ ARS_RDI_Range_Clu_353 : 71|12@0+ (0.0625,0) [0|255.9375] "m"  GW
 SG_ ARS_RDI_VradRel_Clu_353 : 75|11@0+ (0.1,-120) [-120|84.7] "m/s"  GW
 SG_ ARS_RDI_RCS_Clu_353 : 80|9@0+ (0.2,-51.2) [-51.2|51] "dBsm"  GW
 SG_ ARS_RDI_AzimuthAng_Clu_353 : 103|10@0+ (0.002,-1.022) [-1.022|1.024] "rad"  GW

BO_ 305 ARS_RDI_360_367: 64 FR
 SG_ ARS_RDI_Range_Clu_360 : 7|12@0+ (0.0625,0) [0|255.9375] "m"  GW
 SG_ ARS_RDI_ElevationAng_Clu_361 : 109|7@0+ (0.005,-0.315) [-0.315|0.32] "rad"  GW
 SG_ ARS_RDI_SNR_Clu_361 : 118|7@0+ (0.5,0) [0|63.5] "dB"  GW
 SG_ ARS_RDI_Range_Clu_362 : 127|12@0+ (0.0625,0) [0|255.9375] "m"  GW
 SG_ ARS_RDI_VradRel_Clu_360 : 11|11@0+ (0.1,-120) [-120|84.7] "m/s"  GW
 SG_ ARS_RDI_VradRel_Clu_362 : 131|11@0+ (0.1,-120) [-120|84.7] "m/s"  GW
 SG_ ARS_RDI_RCS_Clu_362 : 136|9@0+ (0.2,-51.2) [-51.2|51] "dBsm"  GW
 SG_ ARS_RDI_AzimuthAng_Clu_362 : 159|10@0+ (0.002,-1.022) [-1.022|1.024] "rad"  GW
 SG_ ARS_RDI_ElevationAng_Clu_362 : 165|7@0+ (0.005,-0.315) [-0.315|0.32] "rad"  GW
 SG_ ARS_RDI_SNR_Clu_362 : 174|7@0+ (0.5,0) [0|63.5] "dB"  GW
 SG_ ARS_RDI_DynProp_Clu_362 : 183|2@0+ (1,0) [0|3] ""  GW
 SG_ ARS_RDI_Quality_Clu_362 : 181|2@0+ (1,0) [0|3] ""  GW
 SG_ ARS_RDI_DynProp_Clu_363 : 179|2@0+ (1,0) [0|3] ""  GW
 SG_ ARS_RDI_Quality_Clu_363 : 177|2@0+ (1,0) [0|3] ""  GW
 SG_ ARS_RDI_Range_Clu_363 : 191|12@0+ (0.0625,0) [0|255.9375] "m"  GW
 SG_ ARS_RDI_VradRel_Clu_363 : 195|11@0+ (0.1,-120) [-120|84.7] "m/s"  GW
 SG_ ARS_RDI_RCS_Clu_363 : 200|9@0+ (0.2,-51.2) [-51.2|51] "dBsm"  GW
 SG_ ARS_RDI_AzimuthAng_Clu_363 : 223|10@0+ (0.002,-1.022) [-1.022|1.024] "rad"  GW
 SG_ ARS_RDI_ElevationAng_Clu_363 : 229|7@0+ (0.005,-0.315) [-0.315|0.32] "rad"  GW
 SG_ ARS_RDI_SNR_Clu_363 : 238|7@0+ (0.5,0) [0|63.5] "dB"  GW
 SG_ ARS_RDI_RCS_Clu_360 : 16|9@0+ (0.2,-51.2) [-51.2|51] "dBsm"  GW
 SG_ ARS_RDI_Range_Clu_364 : 247|12@0+ (0.0625,0) [0|255.9375] "m"  GW
 SG_ ARS_RDI_VradRel_Clu_364 : 251|11@0+ (0.1,-120) [-120|84.7] "m/s"  GW
 SG_ ARS_RDI_RCS_Clu_364 : 256|9@0+ (0.2,-51.2) [-51.2|51] "dBsm"  GW
 SG_ ARS_RDI_AzimuthAng_Clu_364 : 279|10@0+ (0.002,-1.022) [-1.022|1.024] "rad"  GW
 SG_ ARS_RDI_ElevationAng_Clu_364 : 285|7@0+ (0.005,-0.315) [-0.315|0.32] "rad"  GW
 SG_ ARS_RDI_SNR_Clu_364 : 294|7@0+ (0.5,0) [0|63.5] "dB"  GW
 SG_ ARS_RDI_DynProp_Clu_364 : 303|2@0+ (1,0) [0|3] ""  GW
 SG_ ARS_RDI_Quality_Clu_364 : 301|2@0+ (1,0) [0|3] ""  GW
 SG_ ARS_RDI_DynProp_Clu_365 : 299|2@0+ (1,0) [0|3] ""  GW
 SG_ ARS_RDI_Quality_Clu_365 : 297|2@0+ (1,0) [0|3] ""  GW
 SG_ ARS_RDI_Range_Clu_365 : 311|12@0+ (0.0625,0) [0|255.9375] "m"  GW
 SG_ ARS_RDI_VradRel_Clu_365 : 315|11@0+ (0.1,-120) [-120|84.7] "m/s"  GW
 SG_ ARS_RDI_RCS_Clu_365 : 320|9@0+ (0.2,-51.2) [-51.2|51] "dBsm"  GW
 SG_ ARS_RDI_AzimuthAng_Clu_360 : 39|10@0+ (0.002,-1.022) [-1.022|1.024] "rad"  GW
 SG_ ARS_RDI_AzimuthAng_Clu_365 : 343|10@0+ (0.002,-1.022) [-1.022|1.024] "rad"  GW
 SG_ ARS_RDI_ElevationAng_Clu_365 : 349|7@0+ (0.005,-0.315) [-0.315|0.32] "rad"  GW
 SG_ ARS_RDI_SNR_Clu_365 : 358|7@0+ (0.5,0) [0|63.5] "dB"  GW
 SG_ ARS_RDI_Range_Clu_366 : 367|12@0+ (0.0625,0) [0|255.9375] "m"  GW
 SG_ ARS_RDI_VradRel_Clu_366 : 371|11@0+ (0.1,-120) [-120|84.7] "m/s"  GW
 SG_ ARS_RDI_RCS_Clu_366 : 376|9@0+ (0.2,-51.2) [-51.2|51] "dBsm"  GW
 SG_ ARS_RDI_AzimuthAng_Clu_366 : 399|10@0+ (0.002,-1.022) [-1.022|1.024] "rad"  GW
 SG_ ARS_RDI_ElevationAng_Clu_366 : 405|7@0+ (0.005,-0.315) [-0.315|0.32] "rad"  GW
 SG_ ARS_RDI_SNR_Clu_366 : 414|7@0+ (0.5,0) [0|63.5] "dB"  GW
 SG_ ARS_RDI_DynProp_Clu_366 : 423|2@0+ (1,0) [0|3] ""  GW
 SG_ ARS_RDI_Quality_Clu_366 : 421|2@0+ (1,0) [0|3] ""  GW
 SG_ ARS_RDI_DynProp_Clu_367 : 419|2@0+ (1,0) [0|3] ""  GW
 SG_ ARS_RDI_Quality_Clu_367 : 417|2@0+ (1,0) [0|3] ""  GW
 SG_ ARS_RDI_Range_Clu_367 : 431|12@0+ (0.0625,0) [0|255.9375] "m"  GW
 SG_ ARS_RDI_ElevationAng_Clu_360 : 45|7@0+ (0.005,-0.315) [-0.315|0.32] "rad"  GW
 SG_ ARS_RDI_VradRel_Clu_367 : 435|11@0+ (0.1,-120) [-120|84.7] "m/s"  GW
 SG_ ARS_RDI_RCS_Clu_367 : 440|9@0+ (0.2,-51.2) [-51.2|51] "dBsm"  GW
 SG_ ARS_RDI_AzimuthAng_Clu_367 : 463|10@0+ (0.002,-1.022) [-1.022|1.024] "rad"  GW
 SG_ ARS_RDI_ElevationAng_Clu_367 : 469|7@0+ (0.005,-0.315) [-0.315|0.32] "rad"  GW
 SG_ ARS_RDI_SNR_Clu_367 : 478|7@0+ (0.5,0) [0|63.5] "dB"  GW
 SG_ ARS_RDI_MsgCounter_Clu_360_367 : 495|8@0+ (1,0) [0|255] ""  GW
 SG_ ARS_RDI_CRC16_Checksum_Clu_360_3 : 503|16@0+ (1,0) [0|65535] ""  GW
 SG_ ARS_RDI_SNR_Clu_360 : 54|7@0+ (0.5,0) [0|63.5] "dB"  GW
 SG_ ARS_RDI_DynProp_Clu_360 : 63|2@0+ (1,0) [0|3] ""  GW
 SG_ ARS_RDI_Quality_Clu_360 : 61|2@0+ (1,0) [0|3] ""  GW
 SG_ ARS_RDI_DynProp_Clu_361 : 59|2@0+ (1,0) [0|3] ""  GW
 SG_ ARS_RDI_Quality_Clu_361 : 57|2@0+ (1,0) [0|3] ""  GW
 SG_ ARS_RDI_Range_Clu_361 : 71|12@0+ (0.0625,0) [0|255.9375] "m"  GW
 SG_ ARS_RDI_VradRel_Clu_361 : 75|11@0+ (0.1,-120) [-120|84.7] "m/s"  GW
 SG_ ARS_RDI_RCS_Clu_361 : 80|9@0+ (0.2,-51.2) [-51.2|51] "dBsm"  GW
 SG_ ARS_RDI_AzimuthAng_Clu_361 : 103|10@0+ (0.002,-1.022) [-1.022|1.024] "rad"  GW

BO_ 306 ARS_RDI_368_375: 64 FR
 SG_ ARS_RDI_Range_Clu_368 : 7|12@0+ (0.0625,0) [0|255.9375] "m"  GW
 SG_ ARS_RDI_ElevationAng_Clu_369 : 109|7@0+ (0.005,-0.315) [-0.315|0.32] "rad"  GW
 SG_ ARS_RDI_SNR_Clu_369 : 118|7@0+ (0.5,0) [0|63.5] "dB"  GW
 SG_ ARS_RDI_Range_Clu_370 : 127|12@0+ (0.0625,0) [0|255.9375] "m"  GW
 SG_ ARS_RDI_VradRel_Clu_368 : 11|11@0+ (0.1,-120) [-120|84.7] "m/s"  GW
 SG_ ARS_RDI_VradRel_Clu_370 : 131|11@0+ (0.1,-120) [-120|84.7] "m/s"  GW
 SG_ ARS_RDI_RCS_Clu_370 : 136|9@0+ (0.2,-51.2) [-51.2|51] "dBsm"  GW
 SG_ ARS_RDI_AzimuthAng_Clu_370 : 159|10@0+ (0.002,-1.022) [-1.022|1.024] "rad"  GW
 SG_ ARS_RDI_ElevationAng_Clu_370 : 165|7@0+ (0.005,-0.315) [-0.315|0.32] "rad"  GW
 SG_ ARS_RDI_SNR_Clu_370 : 174|7@0+ (0.5,0) [0|63.5] "dB"  GW
 SG_ ARS_RDI_DynProp_Clu_370 : 183|2@0+ (1,0) [0|3] ""  GW
 SG_ ARS_RDI_Quality_Clu_370 : 181|2@0+ (1,0) [0|3] ""  GW
 SG_ ARS_RDI_DynProp_Clu_371 : 179|2@0+ (1,0) [0|3] ""  GW
 SG_ ARS_RDI_Quality_Clu_371 : 177|2@0+ (1,0) [0|3] ""  GW
 SG_ ARS_RDI_Range_Clu_371 : 191|12@0+ (0.0625,0) [0|255.9375] "m"  GW
 SG_ ARS_RDI_VradRel_Clu_371 : 195|11@0+ (0.1,-120) [-120|84.7] "m/s"  GW
 SG_ ARS_RDI_RCS_Clu_371 : 200|9@0+ (0.2,-51.2) [-51.2|51] "dBsm"  GW
 SG_ ARS_RDI_AzimuthAng_Clu_371 : 223|10@0+ (0.002,-1.022) [-1.022|1.024] "rad"  GW
 SG_ ARS_RDI_ElevationAng_Clu_371 : 229|7@0+ (0.005,-0.315) [-0.315|0.32] "rad"  GW
 SG_ ARS_RDI_SNR_Clu_371 : 238|7@0+ (0.5,0) [0|63.5] "dB"  GW
 SG_ ARS_RDI_RCS_Clu_368 : 16|9@0+ (0.2,-51.2) [-51.2|51] "dBsm"  GW
 SG_ ARS_RDI_Range_Clu_372 : 247|12@0+ (0.0625,0) [0|255.9375] "m"  GW
 SG_ ARS_RDI_VradRel_Clu_372 : 251|11@0+ (0.1,-120) [-120|84.7] "m/s"  GW
 SG_ ARS_RDI_RCS_Clu_372 : 256|9@0+ (0.2,-51.2) [-51.2|51] "dBsm"  GW
 SG_ ARS_RDI_AzimuthAng_Clu_372 : 279|10@0+ (0.002,-1.022) [-1.022|1.024] "rad"  GW
 SG_ ARS_RDI_ElevationAng_Clu_372 : 285|7@0+ (0.005,-0.315) [-0.315|0.32] "rad"  GW
 SG_ ARS_RDI_SNR_Clu_372 : 294|7@0+ (0.5,0) [0|63.5] "dB"  GW
 SG_ ARS_RDI_DynProp_Clu_372 : 303|2@0+ (1,0) [0|3] ""  GW
 SG_ ARS_RDI_Quality_Clu_372 : 301|2@0+ (1,0) [0|3] ""  GW
 SG_ ARS_RDI_DynProp_Clu_373 : 299|2@0+ (1,0) [0|3] ""  GW
 SG_ ARS_RDI_Quality_Clu_373 : 297|2@0+ (1,0) [0|3] ""  GW
 SG_ ARS_RDI_Range_Clu_373 : 311|12@0+ (0.0625,0) [0|255.9375] "m"  GW
 SG_ ARS_RDI_VradRel_Clu_373 : 315|11@0+ (0.1,-120) [-120|84.7] "m/s"  GW
 SG_ ARS_RDI_RCS_Clu_373 : 320|9@0+ (0.2,-51.2) [-51.2|51] "dBsm"  GW
 SG_ ARS_RDI_AzimuthAng_Clu_368 : 39|10@0+ (0.002,-1.022) [-1.022|1.024] "rad"  GW
 SG_ ARS_RDI_AzimuthAng_Clu_373 : 343|10@0+ (0.002,-1.022) [-1.022|1.024] "rad"  GW
 SG_ ARS_RDI_ElevationAng_Clu_373 : 349|7@0+ (0.005,-0.315) [-0.315|0.32] "rad"  GW
 SG_ ARS_RDI_SNR_Clu_373 : 358|7@0+ (0.5,0) [0|63.5] "dB"  GW
 SG_ ARS_RDI_Range_Clu_374 : 367|12@0+ (0.0625,0) [0|255.9375] "m"  GW
 SG_ ARS_RDI_VradRel_Clu_374 : 371|11@0+ (0.1,-120) [-120|84.7] "m/s"  GW
 SG_ ARS_RDI_RCS_Clu_374 : 376|9@0+ (0.2,-51.2) [-51.2|51] "dBsm"  GW
 SG_ ARS_RDI_AzimuthAng_Clu_374 : 399|10@0+ (0.002,-1.022) [-1.022|1.024] "rad"  GW
 SG_ ARS_RDI_ElevationAng_Clu_374 : 405|7@0+ (0.005,-0.315) [-0.315|0.32] "rad"  GW
 SG_ ARS_RDI_SNR_Clu_374 : 414|7@0+ (0.5,0) [0|63.5] "dB"  GW
 SG_ ARS_RDI_DynProp_Clu_374 : 423|2@0+ (1,0) [0|3] ""  GW
 SG_ ARS_RDI_Quality_Clu_374 : 421|2@0+ (1,0) [0|3] ""  GW
 SG_ ARS_RDI_DynProp_Clu_375 : 419|2@0+ (1,0) [0|3] ""  GW
 SG_ ARS_RDI_Quality_Clu_375 : 417|2@0+ (1,0) [0|3] ""  GW
 SG_ ARS_RDI_Range_Clu_375 : 431|12@0+ (0.0625,0) [0|255.9375] "m"  GW
 SG_ ARS_RDI_ElevationAng_Clu_368 : 45|7@0+ (0.005,-0.315) [-0.315|0.32] "rad"  GW
 SG_ ARS_RDI_VradRel_Clu_375 : 435|11@0+ (0.1,-120) [-120|84.7] "m/s"  GW
 SG_ ARS_RDI_RCS_Clu_375 : 440|9@0+ (0.2,-51.2) [-51.2|51] "dBsm"  GW
 SG_ ARS_RDI_AzimuthAng_Clu_375 : 463|10@0+ (0.002,-1.022) [-1.022|1.024] "rad"  GW
 SG_ ARS_RDI_ElevationAng_Clu_375 : 469|7@0+ (0.005,-0.315) [-0.315|0.32] "rad"  GW
 SG_ ARS_RDI_SNR_Clu_375 : 478|7@0+ (0.5,0) [0|63.5] "dB"  GW
 SG_ ARS_RDI_MsgCounter_Clu_368_375 : 495|8@0+ (1,0) [0|255] ""  GW
 SG_ ARS_RDI_CRC16_Checksum_Clu_368_3 : 503|16@0+ (1,0) [0|65535] ""  GW
 SG_ ARS_RDI_SNR_Clu_368 : 54|7@0+ (0.5,0) [0|63.5] "dB"  GW
 SG_ ARS_RDI_DynProp_Clu_368 : 63|2@0+ (1,0) [0|3] ""  GW
 SG_ ARS_RDI_Quality_Clu_368 : 61|2@0+ (1,0) [0|3] ""  GW
 SG_ ARS_RDI_DynProp_Clu_369 : 59|2@0+ (1,0) [0|3] ""  GW
 SG_ ARS_RDI_Quality_Clu_369 : 57|2@0+ (1,0) [0|3] ""  GW
 SG_ ARS_RDI_Range_Clu_369 : 71|12@0+ (0.0625,0) [0|255.9375] "m"  GW
 SG_ ARS_RDI_VradRel_Clu_369 : 75|11@0+ (0.1,-120) [-120|84.7] "m/s"  GW
 SG_ ARS_RDI_RCS_Clu_369 : 80|9@0+ (0.2,-51.2) [-51.2|51] "dBsm"  GW
 SG_ ARS_RDI_AzimuthAng_Clu_369 : 103|10@0+ (0.002,-1.022) [-1.022|1.024] "rad"  GW

BA_DEF_ BO_  "DiagRequest" ENUM  "no","yes";
BA_DEF_ BO_  "DiagResponse" ENUM  "no","yes";
BA_DEF_ BO_  "GenMsgCycleTime" INT 0 0;
BA_DEF_ BO_  "GenMsgSendType" ENUM  "Cyclic","NotUsed","Event","NotUsed","NotUsed","NotUsed","NotUsed","IfActive","NoMsgSendType","NotUsed";
BA_DEF_ BO_  "VFrameFormat" ENUM  "StandardCAN","ExtendedCAN","RESERVED","RESERVED","RESERVED","RESERVED","RESERVED","RESERVED","RESERVED","RESERVED","RESERVED","RESERVED","RESERVED","RESERVED","StandardCAN_FD","ExtendedCAN_FD";
BA_DEF_ SG_  "GenSigSendType" ENUM  "Cyclic","OnWrite","OnWriteWithRepetition","OnChange","OnChangeWithRepetition","IfActive","IfActiveWithRepetition","NoSigSendType","NotUsed","NotUsed","NotUsed","NotUsed","NotUsed";
BA_DEF_ SG_  "GenSigStartValue" INT 0 0;
BA_DEF_ SG_  "SystemSignalLongSymbol" STRING ;
BA_DEF_DEF_  "DiagRequest" "no";
BA_DEF_DEF_  "DiagResponse" "no";
BA_DEF_DEF_  "GenMsgCycleTime" 0;
BA_DEF_DEF_  "GenMsgSendType" "Cyclic";
BA_DEF_DEF_  "VFrameFormat" "ExtendedCAN_FD";
BA_DEF_DEF_  "GenSigSendType" "Cyclic";
BA_DEF_DEF_  "GenSigStartValue" 0;
BA_DEF_DEF_  "SystemSignalLongSymbol" "";
BA_ "GenMsgSendType" BO_ 288 2;
BA_ "VFrameFormat" BO_ 288 14;
BA_ "GenMsgSendType" BO_ 289 2;
BA_ "VFrameFormat" BO_ 289 14;
BA_ "GenMsgSendType" BO_ 290 2;
BA_ "VFrameFormat" BO_ 290 14;
BA_ "GenMsgSendType" BO_ 291 2;
BA_ "VFrameFormat" BO_ 291 14;
BA_ "GenMsgSendType" BO_ 292 2;
BA_ "VFrameFormat" BO_ 292 14;
BA_ "GenMsgSendType" BO_ 293 2;
BA_ "VFrameFormat" BO_ 293 14;
BA_ "GenMsgSendType" BO_ 294 2;
BA_ "VFrameFormat" BO_ 294 14;
BA_ "GenMsgSendType" BO_ 295 2;
BA_ "VFrameFormat" BO_ 295 14;
BA_ "GenMsgSendType" BO_ 296 2;
BA_ "VFrameFormat" BO_ 296 14;
BA_ "GenMsgSendType" BO_ 297 2;
BA_ "VFrameFormat" BO_ 297 14;
BA_ "GenMsgSendType" BO_ 298 2;
BA_ "VFrameFormat" BO_ 298 14;
BA_ "GenMsgSendType" BO_ 299 2;
BA_ "VFrameFormat" BO_ 299 14;
BA_ "GenMsgSendType" BO_ 300 2;
BA_ "VFrameFormat" BO_ 300 14;
BA_ "GenMsgSendType" BO_ 301 2;
BA_ "VFrameFormat" BO_ 301 14;
BA_ "GenMsgSendType" BO_ 302 2;
BA_ "VFrameFormat" BO_ 302 14;
BA_ "GenMsgSendType" BO_ 303 2;
BA_ "VFrameFormat" BO_ 303 14;
BA_ "GenMsgSendType" BO_ 304 2;
BA_ "VFrameFormat" BO_ 304 14;
BA_ "GenMsgSendType" BO_ 305 2;
BA_ "VFrameFormat" BO_ 305 14;
BA_ "GenMsgSendType" BO_ 306 2;
BA_ "VFrameFormat" BO_ 306 14;
BA_ "GenSigStartValue" SG_ 288 ARS_RDI_ElevationAng_Clu_225 63;
BA_ "GenSigStartValue" SG_ 288 ARS_RDI_VradRel_Clu_224 1200;
BA_ "GenSigStartValue" SG_ 288 ARS_RDI_VradRel_Clu_226 1200;
BA_ "GenSigStartValue" SG_ 288 ARS_RDI_RCS_Clu_226 256;
BA_ "GenSigStartValue" SG_ 288 ARS_RDI_AzimuthAng_Clu_226 511;
BA_ "GenSigStartValue" SG_ 288 ARS_RDI_ElevationAng_Clu_226 63;
BA_ "GenSigStartValue" SG_ 288 ARS_RDI_VradRel_Clu_227 1200;
BA_ "GenSigStartValue" SG_ 288 ARS_RDI_RCS_Clu_227 256;
BA_ "GenSigStartValue" SG_ 288 ARS_RDI_AzimuthAng_Clu_227 511;
BA_ "GenSigStartValue" SG_ 288 ARS_RDI_ElevationAng_Clu_227 63;
BA_ "GenSigStartValue" SG_ 288 ARS_RDI_RCS_Clu_224 256;
BA_ "GenSigStartValue" SG_ 288 ARS_RDI_VradRel_Clu_228 1200;
BA_ "GenSigStartValue" SG_ 288 ARS_RDI_RCS_Clu_228 256;
BA_ "GenSigStartValue" SG_ 288 ARS_RDI_AzimuthAng_Clu_228 511;
BA_ "GenSigStartValue" SG_ 288 ARS_RDI_ElevationAng_Clu_228 63;
BA_ "GenSigStartValue" SG_ 288 ARS_RDI_VradRel_Clu_229 1200;
BA_ "GenSigStartValue" SG_ 288 ARS_RDI_RCS_Clu_229 256;
BA_ "GenSigStartValue" SG_ 288 ARS_RDI_AzimuthAng_Clu_224 511;
BA_ "GenSigStartValue" SG_ 288 ARS_RDI_AzimuthAng_Clu_229 511;
BA_ "GenSigStartValue" SG_ 288 ARS_RDI_ElevationAng_Clu_229 63;
BA_ "GenSigStartValue" SG_ 288 ARS_RDI_VradRel_Clu_230 1200;
BA_ "GenSigStartValue" SG_ 288 ARS_RDI_RCS_Clu_230 256;
BA_ "GenSigStartValue" SG_ 288 ARS_RDI_AzimuthAng_Clu_230 511;
BA_ "GenSigStartValue" SG_ 288 ARS_RDI_ElevationAng_Clu_230 63;
BA_ "GenSigStartValue" SG_ 288 ARS_RDI_ElevationAng_Clu_224 63;
BA_ "GenSigStartValue" SG_ 288 ARS_RDI_VradRel_Clu_231 1200;
BA_ "GenSigStartValue" SG_ 288 ARS_RDI_RCS_Clu_231 256;
BA_ "GenSigStartValue" SG_ 288 ARS_RDI_AzimuthAng_Clu_231 511;
BA_ "GenSigStartValue" SG_ 288 ARS_RDI_ElevationAng_Clu_231 63;
BA_ "SystemSignalLongSymbol" SG_ 288 ARS_RDI_CRC16_Checksum_Clu_224_2 "ARS_RDI_CRC16_Checksum_Clu_224_231";
BA_ "GenSigStartValue" SG_ 288 ARS_RDI_VradRel_Clu_225 1200;
BA_ "GenSigStartValue" SG_ 288 ARS_RDI_RCS_Clu_225 256;
BA_ "GenSigStartValue" SG_ 288 ARS_RDI_AzimuthAng_Clu_225 511;
BA_ "GenSigStartValue" SG_ 289 ARS_RDI_ElevationAng_Clu_233 63;
BA_ "GenSigStartValue" SG_ 289 ARS_RDI_VradRel_Clu_232 1200;
BA_ "GenSigStartValue" SG_ 289 ARS_RDI_VradRel_Clu_234 1200;
BA_ "GenSigStartValue" SG_ 289 ARS_RDI_RCS_Clu_234 256;
BA_ "GenSigStartValue" SG_ 289 ARS_RDI_AzimuthAng_Clu_234 511;
BA_ "GenSigStartValue" SG_ 289 ARS_RDI_ElevationAng_Clu_234 63;
BA_ "GenSigStartValue" SG_ 289 ARS_RDI_VradRel_Clu_235 1200;
BA_ "GenSigStartValue" SG_ 289 ARS_RDI_RCS_Clu_235 256;
BA_ "GenSigStartValue" SG_ 289 ARS_RDI_AzimuthAng_Clu_235 511;
BA_ "GenSigStartValue" SG_ 289 ARS_RDI_ElevationAng_Clu_235 63;
BA_ "GenSigStartValue" SG_ 289 ARS_RDI_RCS_Clu_232 256;
BA_ "GenSigStartValue" SG_ 289 ARS_RDI_VradRel_Clu_236 1200;
BA_ "GenSigStartValue" SG_ 289 ARS_RDI_RCS_Clu_236 256;
BA_ "GenSigStartValue" SG_ 289 ARS_RDI_AzimuthAng_Clu_236 511;
BA_ "GenSigStartValue" SG_ 289 ARS_RDI_ElevationAng_Clu_236 63;
BA_ "GenSigStartValue" SG_ 289 ARS_RDI_VradRel_Clu_237 1200;
BA_ "GenSigStartValue" SG_ 289 ARS_RDI_RCS_Clu_237 256;
BA_ "GenSigStartValue" SG_ 289 ARS_RDI_AzimuthAng_Clu_232 511;
BA_ "GenSigStartValue" SG_ 289 ARS_RDI_AzimuthAng_Clu_237 511;
BA_ "GenSigStartValue" SG_ 289 ARS_RDI_ElevationAng_Clu_237 63;
BA_ "GenSigStartValue" SG_ 289 ARS_RDI_VradRel_Clu_238 1200;
BA_ "GenSigStartValue" SG_ 289 ARS_RDI_RCS_Clu_238 256;
BA_ "GenSigStartValue" SG_ 289 ARS_RDI_AzimuthAng_Clu_238 511;
BA_ "GenSigStartValue" SG_ 289 ARS_RDI_ElevationAng_Clu_238 63;
BA_ "GenSigStartValue" SG_ 289 ARS_RDI_ElevationAng_Clu_232 63;
BA_ "GenSigStartValue" SG_ 289 ARS_RDI_VradRel_Clu_239 1200;
BA_ "GenSigStartValue" SG_ 289 ARS_RDI_RCS_Clu_239 256;
BA_ "GenSigStartValue" SG_ 289 ARS_RDI_AzimuthAng_Clu_239 511;
BA_ "GenSigStartValue" SG_ 289 ARS_RDI_ElevationAng_Clu_239 63;
BA_ "SystemSignalLongSymbol" SG_ 289 ARS_RDI_CRC16_Checksum_Clu_232_2 "ARS_RDI_CRC16_Checksum_Clu_232_239";
BA_ "GenSigStartValue" SG_ 289 ARS_RDI_VradRel_Clu_233 1200;
BA_ "GenSigStartValue" SG_ 289 ARS_RDI_RCS_Clu_233 256;
BA_ "GenSigStartValue" SG_ 289 ARS_RDI_AzimuthAng_Clu_233 511;
BA_ "GenSigStartValue" SG_ 290 ARS_RDI_ElevationAng_Clu_241 63;
BA_ "GenSigStartValue" SG_ 290 ARS_RDI_VradRel_Clu_240 1200;
BA_ "GenSigStartValue" SG_ 290 ARS_RDI_VradRel_Clu_242 1200;
BA_ "GenSigStartValue" SG_ 290 ARS_RDI_RCS_Clu_242 256;
BA_ "GenSigStartValue" SG_ 290 ARS_RDI_AzimuthAng_Clu_242 511;
BA_ "GenSigStartValue" SG_ 290 ARS_RDI_ElevationAng_Clu_242 63;
BA_ "GenSigStartValue" SG_ 290 ARS_RDI_VradRel_Clu_243 1200;
BA_ "GenSigStartValue" SG_ 290 ARS_RDI_RCS_Clu_243 256;
BA_ "GenSigStartValue" SG_ 290 ARS_RDI_AzimuthAng_Clu_243 511;
BA_ "GenSigStartValue" SG_ 290 ARS_RDI_ElevationAng_Clu_243 63;
BA_ "GenSigStartValue" SG_ 290 ARS_RDI_RCS_Clu_240 256;
BA_ "GenSigStartValue" SG_ 290 ARS_RDI_VradRel_Clu_244 1200;
BA_ "GenSigStartValue" SG_ 290 ARS_RDI_RCS_Clu_244 256;
BA_ "GenSigStartValue" SG_ 290 ARS_RDI_AzimuthAng_Clu_244 511;
BA_ "GenSigStartValue" SG_ 290 ARS_RDI_ElevationAng_Clu_244 63;
BA_ "GenSigStartValue" SG_ 290 ARS_RDI_VradRel_Clu_245 1200;
BA_ "GenSigStartValue" SG_ 290 ARS_RDI_RCS_Clu_245 256;
BA_ "GenSigStartValue" SG_ 290 ARS_RDI_AzimuthAng_Clu_240 511;
BA_ "GenSigStartValue" SG_ 290 ARS_RDI_AzimuthAng_Clu_245 511;
BA_ "GenSigStartValue" SG_ 290 ARS_RDI_ElevationAng_Clu_245 63;
BA_ "GenSigStartValue" SG_ 290 ARS_RDI_VradRel_Clu_246 1200;
BA_ "GenSigStartValue" SG_ 290 ARS_RDI_RCS_Clu_246 256;
BA_ "GenSigStartValue" SG_ 290 ARS_RDI_AzimuthAng_Clu_246 511;
BA_ "GenSigStartValue" SG_ 290 ARS_RDI_ElevationAng_Clu_246 63;
BA_ "GenSigStartValue" SG_ 290 ARS_RDI_ElevationAng_Clu_240 63;
BA_ "GenSigStartValue" SG_ 290 ARS_RDI_VradRel_Clu_247 1200;
BA_ "GenSigStartValue" SG_ 290 ARS_RDI_RCS_Clu_247 256;
BA_ "GenSigStartValue" SG_ 290 ARS_RDI_AzimuthAng_Clu_247 511;
BA_ "GenSigStartValue" SG_ 290 ARS_RDI_ElevationAng_Clu_247 63;
BA_ "SystemSignalLongSymbol" SG_ 290 ARS_RDI_CRC16_Checksum_Clu_240_2 "ARS_RDI_CRC16_Checksum_Clu_240_247";
BA_ "GenSigStartValue" SG_ 290 ARS_RDI_VradRel_Clu_241 1200;
BA_ "GenSigStartValue" SG_ 290 ARS_RDI_RCS_Clu_241 256;
BA_ "GenSigStartValue" SG_ 290 ARS_RDI_AzimuthAng_Clu_241 511;
BA_ "GenSigStartValue" SG_ 291 ARS_RDI_ElevationAng_Clu_249 63;
BA_ "GenSigStartValue" SG_ 291 ARS_RDI_VradRel_Clu_248 1200;
BA_ "GenSigStartValue" SG_ 291 ARS_RDI_VradRel_Clu_250 1200;
BA_ "GenSigStartValue" SG_ 291 ARS_RDI_RCS_Clu_250 256;
BA_ "GenSigStartValue" SG_ 291 ARS_RDI_AzimuthAng_Clu_250 511;
BA_ "GenSigStartValue" SG_ 291 ARS_RDI_ElevationAng_Clu_250 63;
BA_ "GenSigStartValue" SG_ 291 ARS_RDI_VradRel_Clu_251 1200;
BA_ "GenSigStartValue" SG_ 291 ARS_RDI_RCS_Clu_251 256;
BA_ "GenSigStartValue" SG_ 291 ARS_RDI_AzimuthAng_Clu_251 511;
BA_ "GenSigStartValue" SG_ 291 ARS_RDI_ElevationAng_Clu_251 63;
BA_ "GenSigStartValue" SG_ 291 ARS_RDI_RCS_Clu_248 256;
BA_ "GenSigStartValue" SG_ 291 ARS_RDI_VradRel_Clu_252 1200;
BA_ "GenSigStartValue" SG_ 291 ARS_RDI_RCS_Clu_252 256;
BA_ "GenSigStartValue" SG_ 291 ARS_RDI_AzimuthAng_Clu_252 511;
BA_ "GenSigStartValue" SG_ 291 ARS_RDI_ElevationAng_Clu_252 63;
BA_ "GenSigStartValue" SG_ 291 ARS_RDI_VradRel_Clu_253 1200;
BA_ "GenSigStartValue" SG_ 291 ARS_RDI_RCS_Clu_253 256;
BA_ "GenSigStartValue" SG_ 291 ARS_RDI_AzimuthAng_Clu_248 511;
BA_ "GenSigStartValue" SG_ 291 ARS_RDI_AzimuthAng_Clu_253 511;
BA_ "GenSigStartValue" SG_ 291 ARS_RDI_ElevationAng_Clu_253 63;
BA_ "GenSigStartValue" SG_ 291 ARS_RDI_VradRel_Clu_254 1200;
BA_ "GenSigStartValue" SG_ 291 ARS_RDI_RCS_Clu_254 256;
BA_ "GenSigStartValue" SG_ 291 ARS_RDI_AzimuthAng_Clu_254 511;
BA_ "GenSigStartValue" SG_ 291 ARS_RDI_ElevationAng_Clu_254 63;
BA_ "GenSigStartValue" SG_ 291 ARS_RDI_ElevationAng_Clu_248 63;
BA_ "GenSigStartValue" SG_ 291 ARS_RDI_VradRel_Clu_255 1200;
BA_ "GenSigStartValue" SG_ 291 ARS_RDI_RCS_Clu_255 256;
BA_ "GenSigStartValue" SG_ 291 ARS_RDI_AzimuthAng_Clu_255 511;
BA_ "GenSigStartValue" SG_ 291 ARS_RDI_ElevationAng_Clu_255 63;
BA_ "SystemSignalLongSymbol" SG_ 291 ARS_RDI_CRC16_Checksum_Clu_248_2 "ARS_RDI_CRC16_Checksum_Clu_248_255";
BA_ "GenSigStartValue" SG_ 291 ARS_RDI_VradRel_Clu_249 1200;
BA_ "GenSigStartValue" SG_ 291 ARS_RDI_RCS_Clu_249 256;
BA_ "GenSigStartValue" SG_ 291 ARS_RDI_AzimuthAng_Clu_249 511;
BA_ "GenSigStartValue" SG_ 292 ARS_RDI_ElevationAng_Clu_257 63;
BA_ "GenSigStartValue" SG_ 292 ARS_RDI_VradRel_Clu_256 1200;
BA_ "GenSigStartValue" SG_ 292 ARS_RDI_VradRel_Clu_258 1200;
BA_ "GenSigStartValue" SG_ 292 ARS_RDI_RCS_Clu_258 256;
BA_ "GenSigStartValue" SG_ 292 ARS_RDI_AzimuthAng_Clu_258 511;
BA_ "GenSigStartValue" SG_ 292 ARS_RDI_ElevationAng_Clu_258 63;
BA_ "GenSigStartValue" SG_ 292 ARS_RDI_VradRel_Clu_259 1200;
BA_ "GenSigStartValue" SG_ 292 ARS_RDI_RCS_Clu_259 256;
BA_ "GenSigStartValue" SG_ 292 ARS_RDI_AzimuthAng_Clu_259 511;
BA_ "GenSigStartValue" SG_ 292 ARS_RDI_ElevationAng_Clu_259 63;
BA_ "GenSigStartValue" SG_ 292 ARS_RDI_RCS_Clu_256 256;
BA_ "GenSigStartValue" SG_ 292 ARS_RDI_VradRel_Clu_260 1200;
BA_ "GenSigStartValue" SG_ 292 ARS_RDI_RCS_Clu_260 256;
BA_ "GenSigStartValue" SG_ 292 ARS_RDI_AzimuthAng_Clu_260 511;
BA_ "GenSigStartValue" SG_ 292 ARS_RDI_ElevationAng_Clu_260 63;
BA_ "GenSigStartValue" SG_ 292 ARS_RDI_VradRel_Clu_261 1200;
BA_ "GenSigStartValue" SG_ 292 ARS_RDI_RCS_Clu_261 256;
BA_ "GenSigStartValue" SG_ 292 ARS_RDI_AzimuthAng_Clu_256 511;
BA_ "GenSigStartValue" SG_ 292 ARS_RDI_AzimuthAng_Clu_261 511;
BA_ "GenSigStartValue" SG_ 292 ARS_RDI_ElevationAng_Clu_261 63;
BA_ "GenSigStartValue" SG_ 292 ARS_RDI_VradRel_Clu_262 1200;
BA_ "GenSigStartValue" SG_ 292 ARS_RDI_RCS_Clu_262 256;
BA_ "GenSigStartValue" SG_ 292 ARS_RDI_AzimuthAng_Clu_262 511;
BA_ "GenSigStartValue" SG_ 292 ARS_RDI_ElevationAng_Clu_262 63;
BA_ "GenSigStartValue" SG_ 292 ARS_RDI_ElevationAng_Clu_256 63;
BA_ "GenSigStartValue" SG_ 292 ARS_RDI_VradRel_Clu_263 1200;
BA_ "GenSigStartValue" SG_ 292 ARS_RDI_RCS_Clu_263 256;
BA_ "GenSigStartValue" SG_ 292 ARS_RDI_AzimuthAng_Clu_263 511;
BA_ "GenSigStartValue" SG_ 292 ARS_RDI_ElevationAng_Clu_263 63;
BA_ "SystemSignalLongSymbol" SG_ 292 ARS_RDI_CRC16_Checksum_Clu_256_2 "ARS_RDI_CRC16_Checksum_Clu_256_263";
BA_ "GenSigStartValue" SG_ 292 ARS_RDI_VradRel_Clu_257 1200;
BA_ "GenSigStartValue" SG_ 292 ARS_RDI_RCS_Clu_257 256;
BA_ "GenSigStartValue" SG_ 292 ARS_RDI_AzimuthAng_Clu_257 511;
BA_ "GenSigStartValue" SG_ 293 ARS_RDI_ElevationAng_Clu_265 63;
BA_ "GenSigStartValue" SG_ 293 ARS_RDI_VradRel_Clu_264 1200;
BA_ "GenSigStartValue" SG_ 293 ARS_RDI_VradRel_Clu_266 1200;
BA_ "GenSigStartValue" SG_ 293 ARS_RDI_RCS_Clu_266 256;
BA_ "GenSigStartValue" SG_ 293 ARS_RDI_AzimuthAng_Clu_266 511;
BA_ "GenSigStartValue" SG_ 293 ARS_RDI_ElevationAng_Clu_266 63;
BA_ "GenSigStartValue" SG_ 293 ARS_RDI_VradRel_Clu_267 1200;
BA_ "GenSigStartValue" SG_ 293 ARS_RDI_RCS_Clu_267 256;
BA_ "GenSigStartValue" SG_ 293 ARS_RDI_AzimuthAng_Clu_267 511;
BA_ "GenSigStartValue" SG_ 293 ARS_RDI_ElevationAng_Clu_267 63;
BA_ "GenSigStartValue" SG_ 293 ARS_RDI_RCS_Clu_264 256;
BA_ "GenSigStartValue" SG_ 293 ARS_RDI_VradRel_Clu_268 1200;
BA_ "GenSigStartValue" SG_ 293 ARS_RDI_RCS_Clu_268 256;
BA_ "GenSigStartValue" SG_ 293 ARS_RDI_AzimuthAng_Clu_268 511;
BA_ "GenSigStartValue" SG_ 293 ARS_RDI_ElevationAng_Clu_268 63;
BA_ "GenSigStartValue" SG_ 293 ARS_RDI_VradRel_Clu_269 1200;
BA_ "GenSigStartValue" SG_ 293 ARS_RDI_RCS_Clu_269 256;
BA_ "GenSigStartValue" SG_ 293 ARS_RDI_AzimuthAng_Clu_264 511;
BA_ "GenSigStartValue" SG_ 293 ARS_RDI_AzimuthAng_Clu_269 511;
BA_ "GenSigStartValue" SG_ 293 ARS_RDI_ElevationAng_Clu_269 63;
BA_ "GenSigStartValue" SG_ 293 ARS_RDI_VradRel_Clu_270 1200;
BA_ "GenSigStartValue" SG_ 293 ARS_RDI_RCS_Clu_270 256;
BA_ "GenSigStartValue" SG_ 293 ARS_RDI_AzimuthAng_Clu_270 511;
BA_ "GenSigStartValue" SG_ 293 ARS_RDI_ElevationAng_Clu_270 63;
BA_ "GenSigStartValue" SG_ 293 ARS_RDI_ElevationAng_Clu_264 63;
BA_ "GenSigStartValue" SG_ 293 ARS_RDI_VradRel_Clu_271 1200;
BA_ "GenSigStartValue" SG_ 293 ARS_RDI_RCS_Clu_271 256;
BA_ "GenSigStartValue" SG_ 293 ARS_RDI_AzimuthAng_Clu_271 511;
BA_ "GenSigStartValue" SG_ 293 ARS_RDI_ElevationAng_Clu_271 63;
BA_ "SystemSignalLongSymbol" SG_ 293 ARS_RDI_CRC16_Checksum_Clu_264_2 "ARS_RDI_CRC16_Checksum_Clu_264_271";
BA_ "GenSigStartValue" SG_ 293 ARS_RDI_VradRel_Clu_265 1200;
BA_ "GenSigStartValue" SG_ 293 ARS_RDI_RCS_Clu_265 256;
BA_ "GenSigStartValue" SG_ 293 ARS_RDI_AzimuthAng_Clu_265 511;
BA_ "GenSigStartValue" SG_ 294 ARS_RDI_ElevationAng_Clu_273 63;
BA_ "GenSigStartValue" SG_ 294 ARS_RDI_VradRel_Clu_272 1200;
BA_ "GenSigStartValue" SG_ 294 ARS_RDI_VradRel_Clu_274 1200;
BA_ "GenSigStartValue" SG_ 294 ARS_RDI_RCS_Clu_274 256;
BA_ "GenSigStartValue" SG_ 294 ARS_RDI_AzimuthAng_Clu_274 511;
BA_ "GenSigStartValue" SG_ 294 ARS_RDI_ElevationAng_Clu_274 63;
BA_ "GenSigStartValue" SG_ 294 ARS_RDI_VradRel_Clu_275 1200;
BA_ "GenSigStartValue" SG_ 294 ARS_RDI_RCS_Clu_275 256;
BA_ "GenSigStartValue" SG_ 294 ARS_RDI_AzimuthAng_Clu_275 511;
BA_ "GenSigStartValue" SG_ 294 ARS_RDI_ElevationAng_Clu_275 63;
BA_ "GenSigStartValue" SG_ 294 ARS_RDI_RCS_Clu_272 256;
BA_ "GenSigStartValue" SG_ 294 ARS_RDI_VradRel_Clu_276 1200;
BA_ "GenSigStartValue" SG_ 294 ARS_RDI_RCS_Clu_276 256;
BA_ "GenSigStartValue" SG_ 294 ARS_RDI_AzimuthAng_Clu_276 511;
BA_ "GenSigStartValue" SG_ 294 ARS_RDI_ElevationAng_Clu_276 63;
BA_ "GenSigStartValue" SG_ 294 ARS_RDI_VradRel_Clu_277 1200;
BA_ "GenSigStartValue" SG_ 294 ARS_RDI_RCS_Clu_277 256;
BA_ "GenSigStartValue" SG_ 294 ARS_RDI_AzimuthAng_Clu_272 511;
BA_ "GenSigStartValue" SG_ 294 ARS_RDI_AzimuthAng_Clu_277 511;
BA_ "GenSigStartValue" SG_ 294 ARS_RDI_ElevationAng_Clu_277 63;
BA_ "GenSigStartValue" SG_ 294 ARS_RDI_VradRel_Clu_278 1200;
BA_ "GenSigStartValue" SG_ 294 ARS_RDI_RCS_Clu_278 256;
BA_ "GenSigStartValue" SG_ 294 ARS_RDI_AzimuthAng_Clu_278 511;
BA_ "GenSigStartValue" SG_ 294 ARS_RDI_ElevationAng_Clu_278 63;
BA_ "GenSigStartValue" SG_ 294 ARS_RDI_ElevationAng_Clu_272 63;
BA_ "GenSigStartValue" SG_ 294 ARS_RDI_VradRel_Clu_279 1200;
BA_ "GenSigStartValue" SG_ 294 ARS_RDI_RCS_Clu_279 256;
BA_ "GenSigStartValue" SG_ 294 ARS_RDI_AzimuthAng_Clu_279 511;
BA_ "GenSigStartValue" SG_ 294 ARS_RDI_ElevationAng_Clu_279 63;
BA_ "SystemSignalLongSymbol" SG_ 294 ARS_RDI_CRC16_Checksum_Clu_272_2 "ARS_RDI_CRC16_Checksum_Clu_272_279";
BA_ "GenSigStartValue" SG_ 294 ARS_RDI_VradRel_Clu_273 1200;
BA_ "GenSigStartValue" SG_ 294 ARS_RDI_RCS_Clu_273 256;
BA_ "GenSigStartValue" SG_ 294 ARS_RDI_AzimuthAng_Clu_273 511;
BA_ "GenSigStartValue" SG_ 295 ARS_RDI_ElevationAng_Clu_281 63;
BA_ "GenSigStartValue" SG_ 295 ARS_RDI_VradRel_Clu_280 1200;
BA_ "GenSigStartValue" SG_ 295 ARS_RDI_VradRel_Clu_282 1200;
BA_ "GenSigStartValue" SG_ 295 ARS_RDI_RCS_Clu_282 256;
BA_ "GenSigStartValue" SG_ 295 ARS_RDI_AzimuthAng_Clu_282 511;
BA_ "GenSigStartValue" SG_ 295 ARS_RDI_ElevationAng_Clu_282 63;
BA_ "GenSigStartValue" SG_ 295 ARS_RDI_VradRel_Clu_283 1200;
BA_ "GenSigStartValue" SG_ 295 ARS_RDI_RCS_Clu_283 256;
BA_ "GenSigStartValue" SG_ 295 ARS_RDI_AzimuthAng_Clu_283 511;
BA_ "GenSigStartValue" SG_ 295 ARS_RDI_ElevationAng_Clu_283 63;
BA_ "GenSigStartValue" SG_ 295 ARS_RDI_RCS_Clu_280 256;
BA_ "GenSigStartValue" SG_ 295 ARS_RDI_VradRel_Clu_284 1200;
BA_ "GenSigStartValue" SG_ 295 ARS_RDI_RCS_Clu_284 256;
BA_ "GenSigStartValue" SG_ 295 ARS_RDI_AzimuthAng_Clu_284 511;
BA_ "GenSigStartValue" SG_ 295 ARS_RDI_ElevationAng_Clu_284 63;
BA_ "GenSigStartValue" SG_ 295 ARS_RDI_VradRel_Clu_285 1200;
BA_ "GenSigStartValue" SG_ 295 ARS_RDI_RCS_Clu_285 256;
BA_ "GenSigStartValue" SG_ 295 ARS_RDI_AzimuthAng_Clu_280 511;
BA_ "GenSigStartValue" SG_ 295 ARS_RDI_AzimuthAng_Clu_285 511;
BA_ "GenSigStartValue" SG_ 295 ARS_RDI_ElevationAng_Clu_285 63;
BA_ "GenSigStartValue" SG_ 295 ARS_RDI_VradRel_Clu_286 1200;
BA_ "GenSigStartValue" SG_ 295 ARS_RDI_RCS_Clu_286 256;
BA_ "GenSigStartValue" SG_ 295 ARS_RDI_AzimuthAng_Clu_286 511;
BA_ "GenSigStartValue" SG_ 295 ARS_RDI_ElevationAng_Clu_286 63;
BA_ "GenSigStartValue" SG_ 295 ARS_RDI_ElevationAng_Clu_280 63;
BA_ "GenSigStartValue" SG_ 295 ARS_RDI_VradRel_Clu_287 1200;
BA_ "GenSigStartValue" SG_ 295 ARS_RDI_RCS_Clu_287 256;
BA_ "GenSigStartValue" SG_ 295 ARS_RDI_AzimuthAng_Clu_287 511;
BA_ "GenSigStartValue" SG_ 295 ARS_RDI_ElevationAng_Clu_287 63;
BA_ "SystemSignalLongSymbol" SG_ 295 ARS_RDI_CRC16_Checksum_Clu_280_2 "ARS_RDI_CRC16_Checksum_Clu_280_287";
BA_ "GenSigStartValue" SG_ 295 ARS_RDI_VradRel_Clu_281 1200;
BA_ "GenSigStartValue" SG_ 295 ARS_RDI_RCS_Clu_281 256;
BA_ "GenSigStartValue" SG_ 295 ARS_RDI_AzimuthAng_Clu_281 511;
BA_ "GenSigStartValue" SG_ 296 ARS_RDI_ElevationAng_Clu_289 63;
BA_ "GenSigStartValue" SG_ 296 ARS_RDI_VradRel_Clu_288 1200;
BA_ "GenSigStartValue" SG_ 296 ARS_RDI_VradRel_Clu_290 1200;
BA_ "GenSigStartValue" SG_ 296 ARS_RDI_RCS_Clu_290 256;
BA_ "GenSigStartValue" SG_ 296 ARS_RDI_AzimuthAng_Clu_290 511;
BA_ "GenSigStartValue" SG_ 296 ARS_RDI_ElevationAng_Clu_290 63;
BA_ "GenSigStartValue" SG_ 296 ARS_RDI_VradRel_Clu_291 1200;
BA_ "GenSigStartValue" SG_ 296 ARS_RDI_RCS_Clu_291 256;
BA_ "GenSigStartValue" SG_ 296 ARS_RDI_AzimuthAng_Clu_291 511;
BA_ "GenSigStartValue" SG_ 296 ARS_RDI_ElevationAng_Clu_291 63;
BA_ "GenSigStartValue" SG_ 296 ARS_RDI_RCS_Clu_288 256;
BA_ "GenSigStartValue" SG_ 296 ARS_RDI_VradRel_Clu_292 1200;
BA_ "GenSigStartValue" SG_ 296 ARS_RDI_RCS_Clu_292 256;
BA_ "GenSigStartValue" SG_ 296 ARS_RDI_AzimuthAng_Clu_292 511;
BA_ "GenSigStartValue" SG_ 296 ARS_RDI_ElevationAng_Clu_292 63;
BA_ "GenSigStartValue" SG_ 296 ARS_RDI_VradRel_Clu_293 1200;
BA_ "GenSigStartValue" SG_ 296 ARS_RDI_RCS_Clu_293 256;
BA_ "GenSigStartValue" SG_ 296 ARS_RDI_AzimuthAng_Clu_288 511;
BA_ "GenSigStartValue" SG_ 296 ARS_RDI_AzimuthAng_Clu_293 511;
BA_ "GenSigStartValue" SG_ 296 ARS_RDI_ElevationAng_Clu_293 63;
BA_ "GenSigStartValue" SG_ 296 ARS_RDI_VradRel_Clu_294 1200;
BA_ "GenSigStartValue" SG_ 296 ARS_RDI_RCS_Clu_294 256;
BA_ "GenSigStartValue" SG_ 296 ARS_RDI_AzimuthAng_Clu_294 511;
BA_ "GenSigStartValue" SG_ 296 ARS_RDI_ElevationAng_Clu_294 63;
BA_ "GenSigStartValue" SG_ 296 ARS_RDI_ElevationAng_Clu_288 63;
BA_ "GenSigStartValue" SG_ 296 ARS_RDI_VradRel_Clu_295 1200;
BA_ "GenSigStartValue" SG_ 296 ARS_RDI_RCS_Clu_295 256;
BA_ "GenSigStartValue" SG_ 296 ARS_RDI_AzimuthAng_Clu_295 511;
BA_ "GenSigStartValue" SG_ 296 ARS_RDI_ElevationAng_Clu_295 63;
BA_ "SystemSignalLongSymbol" SG_ 296 ARS_RDI_CRC16_Checksum_Clu_288_2 "ARS_RDI_CRC16_Checksum_Clu_288_295";
BA_ "GenSigStartValue" SG_ 296 ARS_RDI_VradRel_Clu_289 1200;
BA_ "GenSigStartValue" SG_ 296 ARS_RDI_RCS_Clu_289 256;
BA_ "GenSigStartValue" SG_ 296 ARS_RDI_AzimuthAng_Clu_289 511;
BA_ "GenSigStartValue" SG_ 297 ARS_RDI_ElevationAng_Clu_297 63;
BA_ "GenSigStartValue" SG_ 297 ARS_RDI_VradRel_Clu_296 1200;
BA_ "GenSigStartValue" SG_ 297 ARS_RDI_VradRel_Clu_298 1200;
BA_ "GenSigStartValue" SG_ 297 ARS_RDI_RCS_Clu_298 256;
BA_ "GenSigStartValue" SG_ 297 ARS_RDI_AzimuthAng_Clu_298 511;
BA_ "GenSigStartValue" SG_ 297 ARS_RDI_ElevationAng_Clu_298 63;
BA_ "GenSigStartValue" SG_ 297 ARS_RDI_VradRel_Clu_299 1200;
BA_ "GenSigStartValue" SG_ 297 ARS_RDI_RCS_Clu_299 256;
BA_ "GenSigStartValue" SG_ 297 ARS_RDI_AzimuthAng_Clu_299 511;
BA_ "GenSigStartValue" SG_ 297 ARS_RDI_ElevationAng_Clu_299 63;
BA_ "GenSigStartValue" SG_ 297 ARS_RDI_RCS_Clu_296 256;
BA_ "GenSigStartValue" SG_ 297 ARS_RDI_VradRel_Clu_300 1200;
BA_ "GenSigStartValue" SG_ 297 ARS_RDI_RCS_Clu_300 256;
BA_ "GenSigStartValue" SG_ 297 ARS_RDI_AzimuthAng_Clu_300 511;
BA_ "GenSigStartValue" SG_ 297 ARS_RDI_ElevationAng_Clu_300 63;
BA_ "GenSigStartValue" SG_ 297 ARS_RDI_VradRel_Clu_301 1200;
BA_ "GenSigStartValue" SG_ 297 ARS_RDI_RCS_Clu_301 256;
BA_ "GenSigStartValue" SG_ 297 ARS_RDI_AzimuthAng_Clu_296 511;
BA_ "GenSigStartValue" SG_ 297 ARS_RDI_AzimuthAng_Clu_301 511;
BA_ "GenSigStartValue" SG_ 297 ARS_RDI_ElevationAng_Clu_301 63;
BA_ "GenSigStartValue" SG_ 297 ARS_RDI_VradRel_Clu_302 1200;
BA_ "GenSigStartValue" SG_ 297 ARS_RDI_RCS_Clu_302 256;
BA_ "GenSigStartValue" SG_ 297 ARS_RDI_AzimuthAng_Clu_302 511;
BA_ "GenSigStartValue" SG_ 297 ARS_RDI_ElevationAng_Clu_302 63;
BA_ "GenSigStartValue" SG_ 297 ARS_RDI_ElevationAng_Clu_296 63;
BA_ "GenSigStartValue" SG_ 297 ARS_RDI_VradRel_Clu_303 1200;
BA_ "GenSigStartValue" SG_ 297 ARS_RDI_RCS_Clu_303 256;
BA_ "GenSigStartValue" SG_ 297 ARS_RDI_AzimuthAng_Clu_303 511;
BA_ "GenSigStartValue" SG_ 297 ARS_RDI_ElevationAng_Clu_303 63;
BA_ "SystemSignalLongSymbol" SG_ 297 ARS_RDI_CRC16_Checksum_Clu_296_3 "ARS_RDI_CRC16_Checksum_Clu_296_303";
BA_ "GenSigStartValue" SG_ 297 ARS_RDI_VradRel_Clu_297 1200;
BA_ "GenSigStartValue" SG_ 297 ARS_RDI_RCS_Clu_297 256;
BA_ "GenSigStartValue" SG_ 297 ARS_RDI_AzimuthAng_Clu_297 511;
BA_ "GenSigStartValue" SG_ 298 ARS_RDI_ElevationAng_Clu_305 63;
BA_ "GenSigStartValue" SG_ 298 ARS_RDI_VradRel_Clu_304 1200;
BA_ "GenSigStartValue" SG_ 298 ARS_RDI_VradRel_Clu_306 1200;
BA_ "GenSigStartValue" SG_ 298 ARS_RDI_RCS_Clu_306 256;
BA_ "GenSigStartValue" SG_ 298 ARS_RDI_AzimuthAng_Clu_306 511;
BA_ "GenSigStartValue" SG_ 298 ARS_RDI_ElevationAng_Clu_306 63;
BA_ "GenSigStartValue" SG_ 298 ARS_RDI_VradRel_Clu_307 1200;
BA_ "GenSigStartValue" SG_ 298 ARS_RDI_RCS_Clu_307 256;
BA_ "GenSigStartValue" SG_ 298 ARS_RDI_AzimuthAng_Clu_307 511;
BA_ "GenSigStartValue" SG_ 298 ARS_RDI_ElevationAng_Clu_307 63;
BA_ "GenSigStartValue" SG_ 298 ARS_RDI_RCS_Clu_304 256;
BA_ "GenSigStartValue" SG_ 298 ARS_RDI_VradRel_Clu_308 1200;
BA_ "GenSigStartValue" SG_ 298 ARS_RDI_RCS_Clu_308 256;
BA_ "GenSigStartValue" SG_ 298 ARS_RDI_AzimuthAng_Clu_308 511;
BA_ "GenSigStartValue" SG_ 298 ARS_RDI_ElevationAng_Clu_308 63;
BA_ "GenSigStartValue" SG_ 298 ARS_RDI_VradRel_Clu_309 1200;
BA_ "GenSigStartValue" SG_ 298 ARS_RDI_RCS_Clu_309 256;
BA_ "GenSigStartValue" SG_ 298 ARS_RDI_AzimuthAng_Clu_304 511;
BA_ "GenSigStartValue" SG_ 298 ARS_RDI_AzimuthAng_Clu_309 511;
BA_ "GenSigStartValue" SG_ 298 ARS_RDI_ElevationAng_Clu_309 63;
BA_ "GenSigStartValue" SG_ 298 ARS_RDI_VradRel_Clu_310 1200;
BA_ "GenSigStartValue" SG_ 298 ARS_RDI_RCS_Clu_310 256;
BA_ "GenSigStartValue" SG_ 298 ARS_RDI_AzimuthAng_Clu_310 511;
BA_ "GenSigStartValue" SG_ 298 ARS_RDI_ElevationAng_Clu_310 63;
BA_ "GenSigStartValue" SG_ 298 ARS_RDI_ElevationAng_Clu_304 63;
BA_ "GenSigStartValue" SG_ 298 ARS_RDI_VradRel_Clu_311 1200;
BA_ "GenSigStartValue" SG_ 298 ARS_RDI_RCS_Clu_311 256;
BA_ "GenSigStartValue" SG_ 298 ARS_RDI_AzimuthAng_Clu_311 511;
BA_ "GenSigStartValue" SG_ 298 ARS_RDI_ElevationAng_Clu_311 63;
BA_ "SystemSignalLongSymbol" SG_ 298 ARS_RDI_CRC16_Checksum_Clu_304_3 "ARS_RDI_CRC16_Checksum_Clu_304_311";
BA_ "GenSigStartValue" SG_ 298 ARS_RDI_VradRel_Clu_305 1200;
BA_ "GenSigStartValue" SG_ 298 ARS_RDI_RCS_Clu_305 256;
BA_ "GenSigStartValue" SG_ 298 ARS_RDI_AzimuthAng_Clu_305 511;
BA_ "GenSigStartValue" SG_ 299 ARS_RDI_ElevationAng_Clu_313 63;
BA_ "GenSigStartValue" SG_ 299 ARS_RDI_VradRel_Clu_312 1200;
BA_ "GenSigStartValue" SG_ 299 ARS_RDI_VradRel_Clu_314 1200;
BA_ "GenSigStartValue" SG_ 299 ARS_RDI_RCS_Clu_314 256;
BA_ "GenSigStartValue" SG_ 299 ARS_RDI_AzimuthAng_Clu_314 511;
BA_ "GenSigStartValue" SG_ 299 ARS_RDI_ElevationAng_Clu_314 63;
BA_ "GenSigStartValue" SG_ 299 ARS_RDI_VradRel_Clu_315 1200;
BA_ "GenSigStartValue" SG_ 299 ARS_RDI_RCS_Clu_315 256;
BA_ "GenSigStartValue" SG_ 299 ARS_RDI_AzimuthAng_Clu_315 511;
BA_ "GenSigStartValue" SG_ 299 ARS_RDI_ElevationAng_Clu_315 63;
BA_ "GenSigStartValue" SG_ 299 ARS_RDI_RCS_Clu_312 256;
BA_ "GenSigStartValue" SG_ 299 ARS_RDI_VradRel_Clu_316 1200;
BA_ "GenSigStartValue" SG_ 299 ARS_RDI_RCS_Clu_316 256;
BA_ "GenSigStartValue" SG_ 299 ARS_RDI_AzimuthAng_Clu_316 511;
BA_ "GenSigStartValue" SG_ 299 ARS_RDI_ElevationAng_Clu_316 63;
BA_ "GenSigStartValue" SG_ 299 ARS_RDI_VradRel_Clu_317 1200;
BA_ "GenSigStartValue" SG_ 299 ARS_RDI_RCS_Clu_317 256;
BA_ "GenSigStartValue" SG_ 299 ARS_RDI_AzimuthAng_Clu_312 511;
BA_ "GenSigStartValue" SG_ 299 ARS_RDI_AzimuthAng_Clu_317 511;
BA_ "GenSigStartValue" SG_ 299 ARS_RDI_ElevationAng_Clu_317 63;
BA_ "GenSigStartValue" SG_ 299 ARS_RDI_VradRel_Clu_318 1200;
BA_ "GenSigStartValue" SG_ 299 ARS_RDI_RCS_Clu_318 256;
BA_ "GenSigStartValue" SG_ 299 ARS_RDI_AzimuthAng_Clu_318 511;
BA_ "GenSigStartValue" SG_ 299 ARS_RDI_ElevationAng_Clu_318 63;
BA_ "GenSigStartValue" SG_ 299 ARS_RDI_ElevationAng_Clu_312 63;
BA_ "GenSigStartValue" SG_ 299 ARS_RDI_VradRel_Clu_319 1200;
BA_ "GenSigStartValue" SG_ 299 ARS_RDI_RCS_Clu_319 256;
BA_ "GenSigStartValue" SG_ 299 ARS_RDI_AzimuthAng_Clu_319 511;
BA_ "GenSigStartValue" SG_ 299 ARS_RDI_ElevationAng_Clu_319 63;
BA_ "SystemSignalLongSymbol" SG_ 299 ARS_RDI_CRC16_Checksum_Clu_312_3 "ARS_RDI_CRC16_Checksum_Clu_312_319";
BA_ "GenSigStartValue" SG_ 299 ARS_RDI_VradRel_Clu_313 1200;
BA_ "GenSigStartValue" SG_ 299 ARS_RDI_RCS_Clu_313 256;
BA_ "GenSigStartValue" SG_ 299 ARS_RDI_AzimuthAng_Clu_313 511;
BA_ "GenSigStartValue" SG_ 300 ARS_RDI_ElevationAng_Clu_321 63;
BA_ "GenSigStartValue" SG_ 300 ARS_RDI_VradRel_Clu_320 1200;
BA_ "GenSigStartValue" SG_ 300 ARS_RDI_VradRel_Clu_322 1200;
BA_ "GenSigStartValue" SG_ 300 ARS_RDI_RCS_Clu_322 256;
BA_ "GenSigStartValue" SG_ 300 ARS_RDI_AzimuthAng_Clu_322 511;
BA_ "GenSigStartValue" SG_ 300 ARS_RDI_ElevationAng_Clu_322 63;
BA_ "GenSigStartValue" SG_ 300 ARS_RDI_VradRel_Clu_323 1200;
BA_ "GenSigStartValue" SG_ 300 ARS_RDI_RCS_Clu_323 256;
BA_ "GenSigStartValue" SG_ 300 ARS_RDI_AzimuthAng_Clu_323 511;
BA_ "GenSigStartValue" SG_ 300 ARS_RDI_ElevationAng_Clu_323 63;
BA_ "GenSigStartValue" SG_ 300 ARS_RDI_RCS_Clu_320 256;
BA_ "GenSigStartValue" SG_ 300 ARS_RDI_VradRel_Clu_324 1200;
BA_ "GenSigStartValue" SG_ 300 ARS_RDI_RCS_Clu_324 256;
BA_ "GenSigStartValue" SG_ 300 ARS_RDI_AzimuthAng_Clu_324 511;
BA_ "GenSigStartValue" SG_ 300 ARS_RDI_ElevationAng_Clu_324 63;
BA_ "GenSigStartValue" SG_ 300 ARS_RDI_VradRel_Clu_325 1200;
BA_ "GenSigStartValue" SG_ 300 ARS_RDI_RCS_Clu_325 256;
BA_ "GenSigStartValue" SG_ 300 ARS_RDI_AzimuthAng_Clu_320 511;
BA_ "GenSigStartValue" SG_ 300 ARS_RDI_AzimuthAng_Clu_325 511;
BA_ "GenSigStartValue" SG_ 300 ARS_RDI_ElevationAng_Clu_325 63;
BA_ "GenSigStartValue" SG_ 300 ARS_RDI_VradRel_Clu_326 1200;
BA_ "GenSigStartValue" SG_ 300 ARS_RDI_RCS_Clu_326 256;
BA_ "GenSigStartValue" SG_ 300 ARS_RDI_AzimuthAng_Clu_326 511;
BA_ "GenSigStartValue" SG_ 300 ARS_RDI_ElevationAng_Clu_326 63;
BA_ "GenSigStartValue" SG_ 300 ARS_RDI_ElevationAng_Clu_320 63;
BA_ "GenSigStartValue" SG_ 300 ARS_RDI_VradRel_Clu_327 1200;
BA_ "GenSigStartValue" SG_ 300 ARS_RDI_RCS_Clu_327 256;
BA_ "GenSigStartValue" SG_ 300 ARS_RDI_AzimuthAng_Clu_327 511;
BA_ "GenSigStartValue" SG_ 300 ARS_RDI_ElevationAng_Clu_327 63;
BA_ "SystemSignalLongSymbol" SG_ 300 ARS_RDI_CRC16_Checksum_Clu_320_3 "ARS_RDI_CRC16_Checksum_Clu_320_327";
BA_ "GenSigStartValue" SG_ 300 ARS_RDI_VradRel_Clu_321 1200;
BA_ "GenSigStartValue" SG_ 300 ARS_RDI_RCS_Clu_321 256;
BA_ "GenSigStartValue" SG_ 300 ARS_RDI_AzimuthAng_Clu_321 511;
BA_ "GenSigStartValue" SG_ 301 ARS_RDI_ElevationAng_Clu_329 63;
BA_ "GenSigStartValue" SG_ 301 ARS_RDI_VradRel_Clu_328 1200;
BA_ "GenSigStartValue" SG_ 301 ARS_RDI_VradRel_Clu_330 1200;
BA_ "GenSigStartValue" SG_ 301 ARS_RDI_RCS_Clu_330 256;
BA_ "GenSigStartValue" SG_ 301 ARS_RDI_AzimuthAng_Clu_330 511;
BA_ "GenSigStartValue" SG_ 301 ARS_RDI_ElevationAng_Clu_330 63;
BA_ "GenSigStartValue" SG_ 301 ARS_RDI_VradRel_Clu_331 1200;
BA_ "GenSigStartValue" SG_ 301 ARS_RDI_RCS_Clu_331 256;
BA_ "GenSigStartValue" SG_ 301 ARS_RDI_AzimuthAng_Clu_331 511;
BA_ "GenSigStartValue" SG_ 301 ARS_RDI_ElevationAng_Clu_331 63;
BA_ "GenSigStartValue" SG_ 301 ARS_RDI_RCS_Clu_328 256;
BA_ "GenSigStartValue" SG_ 301 ARS_RDI_VradRel_Clu_332 1200;
BA_ "GenSigStartValue" SG_ 301 ARS_RDI_RCS_Clu_332 256;
BA_ "GenSigStartValue" SG_ 301 ARS_RDI_AzimuthAng_Clu_332 511;
BA_ "GenSigStartValue" SG_ 301 ARS_RDI_ElevationAng_Clu_332 63;
BA_ "GenSigStartValue" SG_ 301 ARS_RDI_VradRel_Clu_333 1200;
BA_ "GenSigStartValue" SG_ 301 ARS_RDI_RCS_Clu_333 256;
BA_ "GenSigStartValue" SG_ 301 ARS_RDI_AzimuthAng_Clu_328 511;
BA_ "GenSigStartValue" SG_ 301 ARS_RDI_AzimuthAng_Clu_333 511;
BA_ "GenSigStartValue" SG_ 301 ARS_RDI_ElevationAng_Clu_333 63;
BA_ "GenSigStartValue" SG_ 301 ARS_RDI_VradRel_Clu_334 1200;
BA_ "GenSigStartValue" SG_ 301 ARS_RDI_RCS_Clu_334 256;
BA_ "GenSigStartValue" SG_ 301 ARS_RDI_AzimuthAng_Clu_334 511;
BA_ "GenSigStartValue" SG_ 301 ARS_RDI_ElevationAng_Clu_334 63;
BA_ "GenSigStartValue" SG_ 301 ARS_RDI_ElevationAng_Clu_328 63;
BA_ "GenSigStartValue" SG_ 301 ARS_RDI_VradRel_Clu_335 1200;
BA_ "GenSigStartValue" SG_ 301 ARS_RDI_RCS_Clu_335 256;
BA_ "GenSigStartValue" SG_ 301 ARS_RDI_AzimuthAng_Clu_335 511;
BA_ "GenSigStartValue" SG_ 301 ARS_RDI_ElevationAng_Clu_335 63;
BA_ "SystemSignalLongSymbol" SG_ 301 ARS_RDI_CRC16_Checksum_Clu_328_3 "ARS_RDI_CRC16_Checksum_Clu_328_335";
BA_ "GenSigStartValue" SG_ 301 ARS_RDI_VradRel_Clu_329 1200;
BA_ "GenSigStartValue" SG_ 301 ARS_RDI_RCS_Clu_329 256;
BA_ "GenSigStartValue" SG_ 301 ARS_RDI_AzimuthAng_Clu_329 511;
BA_ "GenSigStartValue" SG_ 302 ARS_RDI_ElevationAng_Clu_337 63;
BA_ "GenSigStartValue" SG_ 302 ARS_RDI_VradRel_Clu_336 1200;
BA_ "GenSigStartValue" SG_ 302 ARS_RDI_VradRel_Clu_338 1200;
BA_ "GenSigStartValue" SG_ 302 ARS_RDI_RCS_Clu_338 256;
BA_ "GenSigStartValue" SG_ 302 ARS_RDI_AzimuthAng_Clu_338 511;
BA_ "GenSigStartValue" SG_ 302 ARS_RDI_ElevationAng_Clu_338 63;
BA_ "GenSigStartValue" SG_ 302 ARS_RDI_VradRel_Clu_339 1200;
BA_ "GenSigStartValue" SG_ 302 ARS_RDI_RCS_Clu_339 256;
BA_ "GenSigStartValue" SG_ 302 ARS_RDI_AzimuthAng_Clu_339 511;
BA_ "GenSigStartValue" SG_ 302 ARS_RDI_ElevationAng_Clu_339 63;
BA_ "GenSigStartValue" SG_ 302 ARS_RDI_RCS_Clu_336 256;
BA_ "GenSigStartValue" SG_ 302 ARS_RDI_VradRel_Clu_340 1200;
BA_ "GenSigStartValue" SG_ 302 ARS_RDI_RCS_Clu_340 256;
BA_ "GenSigStartValue" SG_ 302 ARS_RDI_AzimuthAng_Clu_340 511;
BA_ "GenSigStartValue" SG_ 302 ARS_RDI_ElevationAng_Clu_340 63;
BA_ "GenSigStartValue" SG_ 302 ARS_RDI_VradRel_Clu_341 1200;
BA_ "GenSigStartValue" SG_ 302 ARS_RDI_RCS_Clu_341 256;
BA_ "GenSigStartValue" SG_ 302 ARS_RDI_AzimuthAng_Clu_336 511;
BA_ "GenSigStartValue" SG_ 302 ARS_RDI_AzimuthAng_Clu_341 511;
BA_ "GenSigStartValue" SG_ 302 ARS_RDI_ElevationAng_Clu_341 63;
BA_ "GenSigStartValue" SG_ 302 ARS_RDI_VradRel_Clu_342 1200;
BA_ "GenSigStartValue" SG_ 302 ARS_RDI_RCS_Clu_342 256;
BA_ "GenSigStartValue" SG_ 302 ARS_RDI_AzimuthAng_Clu_342 511;
BA_ "GenSigStartValue" SG_ 302 ARS_RDI_ElevationAng_Clu_342 63;
BA_ "GenSigStartValue" SG_ 302 ARS_RDI_ElevationAng_Clu_336 63;
BA_ "GenSigStartValue" SG_ 302 ARS_RDI_VradRel_Clu_343 1200;
BA_ "GenSigStartValue" SG_ 302 ARS_RDI_RCS_Clu_343 256;
BA_ "GenSigStartValue" SG_ 302 ARS_RDI_AzimuthAng_Clu_343 511;
BA_ "GenSigStartValue" SG_ 302 ARS_RDI_ElevationAng_Clu_343 63;
BA_ "SystemSignalLongSymbol" SG_ 302 ARS_RDI_CRC16_Checksum_Clu_336_3 "ARS_RDI_CRC16_Checksum_Clu_336_343";
BA_ "GenSigStartValue" SG_ 302 ARS_RDI_VradRel_Clu_337 1200;
BA_ "GenSigStartValue" SG_ 302 ARS_RDI_RCS_Clu_337 256;
BA_ "GenSigStartValue" SG_ 302 ARS_RDI_AzimuthAng_Clu_337 511;
BA_ "GenSigStartValue" SG_ 303 ARS_RDI_ElevationAng_Clu_345 63;
BA_ "GenSigStartValue" SG_ 303 ARS_RDI_VradRel_Clu_344 1200;
BA_ "GenSigStartValue" SG_ 303 ARS_RDI_VradRel_Clu_346 1200;
BA_ "GenSigStartValue" SG_ 303 ARS_RDI_RCS_Clu_346 256;
BA_ "GenSigStartValue" SG_ 303 ARS_RDI_AzimuthAng_Clu_346 511;
BA_ "GenSigStartValue" SG_ 303 ARS_RDI_ElevationAng_Clu_346 63;
BA_ "GenSigStartValue" SG_ 303 ARS_RDI_VradRel_Clu_347 1200;
BA_ "GenSigStartValue" SG_ 303 ARS_RDI_RCS_Clu_347 256;
BA_ "GenSigStartValue" SG_ 303 ARS_RDI_AzimuthAng_Clu_347 511;
BA_ "GenSigStartValue" SG_ 303 ARS_RDI_ElevationAng_Clu_347 63;
BA_ "GenSigStartValue" SG_ 303 ARS_RDI_RCS_Clu_344 256;
BA_ "GenSigStartValue" SG_ 303 ARS_RDI_VradRel_Clu_348 1200;
BA_ "GenSigStartValue" SG_ 303 ARS_RDI_RCS_Clu_348 256;
BA_ "GenSigStartValue" SG_ 303 ARS_RDI_AzimuthAng_Clu_348 511;
BA_ "GenSigStartValue" SG_ 303 ARS_RDI_ElevationAng_Clu_348 63;
BA_ "GenSigStartValue" SG_ 303 ARS_RDI_VradRel_Clu_349 1200;
BA_ "GenSigStartValue" SG_ 303 ARS_RDI_RCS_Clu_349 256;
BA_ "GenSigStartValue" SG_ 303 ARS_RDI_AzimuthAng_Clu_344 511;
BA_ "GenSigStartValue" SG_ 303 ARS_RDI_AzimuthAng_Clu_349 511;
BA_ "GenSigStartValue" SG_ 303 ARS_RDI_ElevationAng_Clu_349 63;
BA_ "GenSigStartValue" SG_ 303 ARS_RDI_VradRel_Clu_350 1200;
BA_ "GenSigStartValue" SG_ 303 ARS_RDI_RCS_Clu_350 256;
BA_ "GenSigStartValue" SG_ 303 ARS_RDI_AzimuthAng_Clu_350 511;
BA_ "GenSigStartValue" SG_ 303 ARS_RDI_ElevationAng_Clu_350 63;
BA_ "GenSigStartValue" SG_ 303 ARS_RDI_ElevationAng_Clu_344 63;
BA_ "GenSigStartValue" SG_ 303 ARS_RDI_VradRel_Clu_351 1200;
BA_ "GenSigStartValue" SG_ 303 ARS_RDI_RCS_Clu_351 256;
BA_ "GenSigStartValue" SG_ 303 ARS_RDI_AzimuthAng_Clu_351 511;
BA_ "GenSigStartValue" SG_ 303 ARS_RDI_ElevationAng_Clu_351 63;
BA_ "SystemSignalLongSymbol" SG_ 303 ARS_RDI_CRC16_Checksum_Clu_344_3 "ARS_RDI_CRC16_Checksum_Clu_344_351";
BA_ "GenSigStartValue" SG_ 303 ARS_RDI_VradRel_Clu_345 1200;
BA_ "GenSigStartValue" SG_ 303 ARS_RDI_RCS_Clu_345 256;
BA_ "GenSigStartValue" SG_ 303 ARS_RDI_AzimuthAng_Clu_345 511;
BA_ "GenSigStartValue" SG_ 304 ARS_RDI_ElevationAng_Clu_353 63;
BA_ "GenSigStartValue" SG_ 304 ARS_RDI_VradRel_Clu_352 1200;
BA_ "GenSigStartValue" SG_ 304 ARS_RDI_VradRel_Clu_354 1200;
BA_ "GenSigStartValue" SG_ 304 ARS_RDI_RCS_Clu_354 256;
BA_ "GenSigStartValue" SG_ 304 ARS_RDI_AzimuthAng_Clu_354 511;
BA_ "GenSigStartValue" SG_ 304 ARS_RDI_ElevationAng_Clu_354 63;
BA_ "GenSigStartValue" SG_ 304 ARS_RDI_VradRel_Clu_355 1200;
BA_ "GenSigStartValue" SG_ 304 ARS_RDI_RCS_Clu_355 256;
BA_ "GenSigStartValue" SG_ 304 ARS_RDI_AzimuthAng_Clu_355 511;
BA_ "GenSigStartValue" SG_ 304 ARS_RDI_ElevationAng_Clu_355 63;
BA_ "GenSigStartValue" SG_ 304 ARS_RDI_RCS_Clu_352 256;
BA_ "GenSigStartValue" SG_ 304 ARS_RDI_VradRel_Clu_356 1200;
BA_ "GenSigStartValue" SG_ 304 ARS_RDI_RCS_Clu_356 256;
BA_ "GenSigStartValue" SG_ 304 ARS_RDI_AzimuthAng_Clu_356 511;
BA_ "GenSigStartValue" SG_ 304 ARS_RDI_ElevationAng_Clu_356 63;
BA_ "GenSigStartValue" SG_ 304 ARS_RDI_VradRel_Clu_357 1200;
BA_ "GenSigStartValue" SG_ 304 ARS_RDI_RCS_Clu_357 256;
BA_ "GenSigStartValue" SG_ 304 ARS_RDI_AzimuthAng_Clu_352 511;
BA_ "GenSigStartValue" SG_ 304 ARS_RDI_AzimuthAng_Clu_357 511;
BA_ "GenSigStartValue" SG_ 304 ARS_RDI_ElevationAng_Clu_357 63;
BA_ "GenSigStartValue" SG_ 304 ARS_RDI_VradRel_Clu_358 1200;
BA_ "GenSigStartValue" SG_ 304 ARS_RDI_RCS_Clu_358 256;
BA_ "GenSigStartValue" SG_ 304 ARS_RDI_AzimuthAng_Clu_358 511;
BA_ "GenSigStartValue" SG_ 304 ARS_RDI_ElevationAng_Clu_358 63;
BA_ "GenSigStartValue" SG_ 304 ARS_RDI_ElevationAng_Clu_352 63;
BA_ "GenSigStartValue" SG_ 304 ARS_RDI_VradRel_Clu_359 1200;
BA_ "GenSigStartValue" SG_ 304 ARS_RDI_RCS_Clu_359 256;
BA_ "GenSigStartValue" SG_ 304 ARS_RDI_AzimuthAng_Clu_359 511;
BA_ "GenSigStartValue" SG_ 304 ARS_RDI_ElevationAng_Clu_359 63;
BA_ "SystemSignalLongSymbol" SG_ 304 ARS_RDI_CRC16_Checksum_Clu_352_3 "ARS_RDI_CRC16_Checksum_Clu_352_359";
BA_ "GenSigStartValue" SG_ 304 ARS_RDI_VradRel_Clu_353 1200;
BA_ "GenSigStartValue" SG_ 304 ARS_RDI_RCS_Clu_353 256;
BA_ "GenSigStartValue" SG_ 304 ARS_RDI_AzimuthAng_Clu_353 511;
BA_ "GenSigStartValue" SG_ 305 ARS_RDI_ElevationAng_Clu_361 63;
BA_ "GenSigStartValue" SG_ 305 ARS_RDI_VradRel_Clu_360 1200;
BA_ "GenSigStartValue" SG_ 305 ARS_RDI_VradRel_Clu_362 1200;
BA_ "GenSigStartValue" SG_ 305 ARS_RDI_RCS_Clu_362 256;
BA_ "GenSigStartValue" SG_ 305 ARS_RDI_AzimuthAng_Clu_362 511;
BA_ "GenSigStartValue" SG_ 305 ARS_RDI_ElevationAng_Clu_362 63;
BA_ "GenSigStartValue" SG_ 305 ARS_RDI_VradRel_Clu_363 1200;
BA_ "GenSigStartValue" SG_ 305 ARS_RDI_RCS_Clu_363 256;
BA_ "GenSigStartValue" SG_ 305 ARS_RDI_AzimuthAng_Clu_363 511;
BA_ "GenSigStartValue" SG_ 305 ARS_RDI_ElevationAng_Clu_363 63;
BA_ "GenSigStartValue" SG_ 305 ARS_RDI_RCS_Clu_360 256;
BA_ "GenSigStartValue" SG_ 305 ARS_RDI_VradRel_Clu_364 1200;
BA_ "GenSigStartValue" SG_ 305 ARS_RDI_RCS_Clu_364 256;
BA_ "GenSigStartValue" SG_ 305 ARS_RDI_AzimuthAng_Clu_364 511;
BA_ "GenSigStartValue" SG_ 305 ARS_RDI_ElevationAng_Clu_364 63;
BA_ "GenSigStartValue" SG_ 305 ARS_RDI_VradRel_Clu_365 1200;
BA_ "GenSigStartValue" SG_ 305 ARS_RDI_RCS_Clu_365 256;
BA_ "GenSigStartValue" SG_ 305 ARS_RDI_AzimuthAng_Clu_360 511;
BA_ "GenSigStartValue" SG_ 305 ARS_RDI_AzimuthAng_Clu_365 511;
BA_ "GenSigStartValue" SG_ 305 ARS_RDI_ElevationAng_Clu_365 63;
BA_ "GenSigStartValue" SG_ 305 ARS_RDI_VradRel_Clu_366 1200;
BA_ "GenSigStartValue" SG_ 305 ARS_RDI_RCS_Clu_366 256;
BA_ "GenSigStartValue" SG_ 305 ARS_RDI_AzimuthAng_Clu_366 511;
BA_ "GenSigStartValue" SG_ 305 ARS_RDI_ElevationAng_Clu_366 63;
BA_ "GenSigStartValue" SG_ 305 ARS_RDI_ElevationAng_Clu_360 63;
BA_ "GenSigStartValue" SG_ 305 ARS_RDI_VradRel_Clu_367 1200;
BA_ "GenSigStartValue" SG_ 305 ARS_RDI_RCS_Clu_367 256;
BA_ "GenSigStartValue" SG_ 305 ARS_RDI_AzimuthAng_Clu_367 511;
BA_ "GenSigStartValue" SG_ 305 ARS_RDI_ElevationAng_Clu_367 63;
BA_ "SystemSignalLongSymbol" SG_ 305 ARS_RDI_CRC16_Checksum_Clu_360_3 "ARS_RDI_CRC16_Checksum_Clu_360_367";
BA_ "GenSigStartValue" SG_ 305 ARS_RDI_VradRel_Clu_361 1200;
BA_ "GenSigStartValue" SG_ 305 ARS_RDI_RCS_Clu_361 256;
BA_ "GenSigStartValue" SG_ 305 ARS_RDI_AzimuthAng_Clu_361 511;
BA_ "GenSigStartValue" SG_ 306 ARS_RDI_ElevationAng_Clu_369 63;
BA_ "GenSigStartValue" SG_ 306 ARS_RDI_VradRel_Clu_368 1200;
BA_ "GenSigStartValue" SG_ 306 ARS_RDI_VradRel_Clu_370 1200;
BA_ "GenSigStartValue" SG_ 306 ARS_RDI_RCS_Clu_370 256;
BA_ "GenSigStartValue" SG_ 306 ARS_RDI_AzimuthAng_Clu_370 511;
BA_ "GenSigStartValue" SG_ 306 ARS_RDI_ElevationAng_Clu_370 63;
BA_ "GenSigStartValue" SG_ 306 ARS_RDI_VradRel_Clu_371 1200;
BA_ "GenSigStartValue" SG_ 306 ARS_RDI_RCS_Clu_371 256;
BA_ "GenSigStartValue" SG_ 306 ARS_RDI_AzimuthAng_Clu_371 511;
BA_ "GenSigStartValue" SG_ 306 ARS_RDI_ElevationAng_Clu_371 63;
BA_ "GenSigStartValue" SG_ 306 ARS_RDI_RCS_Clu_368 256;
BA_ "GenSigStartValue" SG_ 306 ARS_RDI_VradRel_Clu_372 1200;
BA_ "GenSigStartValue" SG_ 306 ARS_RDI_RCS_Clu_372 256;
BA_ "GenSigStartValue" SG_ 306 ARS_RDI_AzimuthAng_Clu_372 511;
BA_ "GenSigStartValue" SG_ 306 ARS_RDI_ElevationAng_Clu_372 63;
BA_ "GenSigStartValue" SG_ 306 ARS_RDI_VradRel_Clu_373 1200;
BA_ "GenSigStartValue" SG_ 306 ARS_RDI_RCS_Clu_373 256;
BA_ "GenSigStartValue" SG_ 306 ARS_RDI_AzimuthAng_Clu_368 511;
BA_ "GenSigStartValue" SG_ 306 ARS_RDI_AzimuthAng_Clu_373 511;
BA_ "GenSigStartValue" SG_ 306 ARS_RDI_ElevationAng_Clu_373 63;
BA_ "GenSigStartValue" SG_ 306 ARS_RDI_VradRel_Clu_374 1200;
BA_ "GenSigStartValue" SG_ 306 ARS_RDI_RCS_Clu_374 256;
BA_ "GenSigStartValue" SG_ 306 ARS_RDI_AzimuthAng_Clu_374 511;
BA_ "GenSigStartValue" SG_ 306 ARS_RDI_ElevationAng_Clu_374 63;
BA_ "GenSigStartValue" SG_ 306 ARS_RDI_ElevationAng_Clu_368 63;
BA_ "GenSigStartValue" SG_ 306 ARS_RDI_VradRel_Clu_375 1200;
BA_ "GenSigStartValue" SG_ 306 ARS_RDI_RCS_Clu_375 256;
BA_ "GenSigStartValue" SG_ 306 ARS_RDI_AzimuthAng_Clu_375 511;
BA_ "GenSigStartValue" SG_ 306 ARS_RDI_ElevationAng_Clu_375 63;
BA_ "SystemSignalLongSymbol" SG_ 306 ARS_RDI_CRC16_Checksum_Clu_368_3 "ARS_RDI_CRC16_Checksum_Clu_368_375";
BA_ "GenSigStartValue" SG_ 306 ARS_RDI_VradRel_Clu_369 1200;
BA_ "GenSigStartValue" SG_ 306 ARS_RDI_RCS_Clu_369 256;
BA_ "GenSigStartValue" SG_ 306 ARS_RDI_AzimuthAng_Clu_369 511;
VAL_ 288 ARS_RDI_DynProp_Clu_226 0 "STATIONARY" 1 "MOVING" 2 "AMBIGUOUS" 3 "RESERVED" ;
VAL_ 288 ARS_RDI_Quality_Clu_226 0 "INVALID" 1 "LOW" 2 "MID" 3 "HIGH" ;
VAL_ 288 ARS_RDI_DynProp_Clu_227 0 "STATIONARY" 1 "MOVING" 2 "AMBIGUOUS" 3 "RESERVED" ;
VAL_ 288 ARS_RDI_Quality_Clu_227 0 "INVALID" 1 "LOW" 2 "MID" 3 "HIGH" ;
VAL_ 288 ARS_RDI_DynProp_Clu_228 0 "STATIONARY" 1 "MOVING" 2 "AMBIGUOUS" 3 "RESERVED" ;
VAL_ 288 ARS_RDI_Quality_Clu_228 0 "INVALID" 1 "LOW" 2 "MID" 3 "HIGH" ;
VAL_ 288 ARS_RDI_DynProp_Clu_229 0 "STATIONARY" 1 "MOVING" 2 "AMBIGUOUS" 3 "RESERVED" ;
VAL_ 288 ARS_RDI_Quality_Clu_229 0 "INVALID" 1 "LOW" 2 "MID" 3 "HIGH" ;
VAL_ 288 ARS_RDI_DynProp_Clu_230 0 "STATIONARY" 1 "MOVING" 2 "AMBIGUOUS" 3 "RESERVED" ;
VAL_ 288 ARS_RDI_Quality_Clu_230 0 "INVALID" 1 "LOW" 2 "MID" 3 "HIGH" ;
VAL_ 288 ARS_RDI_DynProp_Clu_231 0 "STATIONARY" 1 "MOVING" 2 "AMBIGUOUS" 3 "RESERVED" ;
VAL_ 288 ARS_RDI_Quality_Clu_231 0 "INVALID" 1 "LOW" 2 "MID" 3 "HIGH" ;
VAL_ 288 ARS_RDI_DynProp_Clu_224 0 "STATIONARY" 1 "MOVING" 2 "AMBIGUOUS" 3 "RESERVED" ;
VAL_ 288 ARS_RDI_Quality_Clu_224 0 "INVALID" 1 "LOW" 2 "MID" 3 "HIGH" ;
VAL_ 288 ARS_RDI_DynProp_Clu_225 0 "STATIONARY" 1 "MOVING" 2 "AMBIGUOUS" 3 "RESERVED" ;
VAL_ 288 ARS_RDI_Quality_Clu_225 0 "INVALID" 1 "LOW" 2 "MID" 3 "HIGH" ;
VAL_ 289 ARS_RDI_DynProp_Clu_234 0 "STATIONARY" 1 "MOVING" 2 "AMBIGUOUS" 3 "RESERVED" ;
VAL_ 289 ARS_RDI_Quality_Clu_234 0 "INVALID" 1 "LOW" 2 "MID" 3 "HIGH" ;
VAL_ 289 ARS_RDI_DynProp_Clu_235 0 "STATIONARY" 1 "MOVING" 2 "AMBIGUOUS" 3 "RESERVED" ;
VAL_ 289 ARS_RDI_Quality_Clu_235 0 "INVALID" 1 "LOW" 2 "MID" 3 "HIGH" ;
VAL_ 289 ARS_RDI_DynProp_Clu_236 0 "STATIONARY" 1 "MOVING" 2 "AMBIGUOUS" 3 "RESERVED" ;
VAL_ 289 ARS_RDI_Quality_Clu_236 0 "INVALID" 1 "LOW" 2 "MID" 3 "HIGH" ;
VAL_ 289 ARS_RDI_DynProp_Clu_237 0 "STATIONARY" 1 "MOVING" 2 "AMBIGUOUS" 3 "RESERVED" ;
VAL_ 289 ARS_RDI_Quality_Clu_237 0 "INVALID" 1 "LOW" 2 "MID" 3 "HIGH" ;
VAL_ 289 ARS_RDI_DynProp_Clu_238 0 "STATIONARY" 1 "MOVING" 2 "AMBIGUOUS" 3 "RESERVED" ;
VAL_ 289 ARS_RDI_Quality_Clu_238 0 "INVALID" 1 "LOW" 2 "MID" 3 "HIGH" ;
VAL_ 289 ARS_RDI_DynProp_Clu_239 0 "STATIONARY" 1 "MOVING" 2 "AMBIGUOUS" 3 "RESERVED" ;
VAL_ 289 ARS_RDI_Quality_Clu_239 0 "INVALID" 1 "LOW" 2 "MID" 3 "HIGH" ;
VAL_ 289 ARS_RDI_DynProp_Clu_232 0 "STATIONARY" 1 "MOVING" 2 "AMBIGUOUS" 3 "RESERVED" ;
VAL_ 289 ARS_RDI_Quality_Clu_232 0 "INVALID" 1 "LOW" 2 "MID" 3 "HIGH" ;
VAL_ 289 ARS_RDI_DynProp_Clu_233 0 "STATIONARY" 1 "MOVING" 2 "AMBIGUOUS" 3 "RESERVED" ;
VAL_ 289 ARS_RDI_Quality_Clu_233 0 "INVALID" 1 "LOW" 2 "MID" 3 "HIGH" ;
VAL_ 290 ARS_RDI_DynProp_Clu_242 0 "STATIONARY" 1 "MOVING" 2 "AMBIGUOUS" 3 "RESERVED" ;
VAL_ 290 ARS_RDI_Quality_Clu_242 0 "INVALID" 1 "LOW" 2 "MID" 3 "HIGH" ;
VAL_ 290 ARS_RDI_DynProp_Clu_243 0 "STATIONARY" 1 "MOVING" 2 "AMBIGUOUS" 3 "RESERVED" ;
VAL_ 290 ARS_RDI_Quality_Clu_243 0 "INVALID" 1 "LOW" 2 "MID" 3 "HIGH" ;
VAL_ 290 ARS_RDI_DynProp_Clu_244 0 "STATIONARY" 1 "MOVING" 2 "AMBIGUOUS" 3 "RESERVED" ;
VAL_ 290 ARS_RDI_Quality_Clu_244 0 "INVALID" 1 "LOW" 2 "MID" 3 "HIGH" ;
VAL_ 290 ARS_RDI_DynProp_Clu_245 0 "STATIONARY" 1 "MOVING" 2 "AMBIGUOUS" 3 "RESERVED" ;
VAL_ 290 ARS_RDI_Quality_Clu_245 0 "INVALID" 1 "LOW" 2 "MID" 3 "HIGH" ;
VAL_ 290 ARS_RDI_DynProp_Clu_246 0 "STATIONARY" 1 "MOVING" 2 "AMBIGUOUS" 3 "RESERVED" ;
VAL_ 290 ARS_RDI_Quality_Clu_246 0 "INVALID" 1 "LOW" 2 "MID" 3 "HIGH" ;
VAL_ 290 ARS_RDI_DynProp_Clu_247 0 "STATIONARY" 1 "MOVING" 2 "AMBIGUOUS" 3 "RESERVED" ;
VAL_ 290 ARS_RDI_Quality_Clu_247 0 "INVALID" 1 "LOW" 2 "MID" 3 "HIGH" ;
VAL_ 290 ARS_RDI_DynProp_Clu_240 0 "STATIONARY" 1 "MOVING" 2 "AMBIGUOUS" 3 "RESERVED" ;
VAL_ 290 ARS_RDI_Quality_Clu_240 0 "INVALID" 1 "LOW" 2 "MID" 3 "HIGH" ;
VAL_ 290 ARS_RDI_DynProp_Clu_241 0 "STATIONARY" 1 "MOVING" 2 "AMBIGUOUS" 3 "RESERVED" ;
VAL_ 290 ARS_RDI_Quality_Clu_241 0 "INVALID" 1 "LOW" 2 "MID" 3 "HIGH" ;
VAL_ 291 ARS_RDI_DynProp_Clu_250 0 "STATIONARY" 1 "MOVING" 2 "AMBIGUOUS" 3 "RESERVED" ;
VAL_ 291 ARS_RDI_Quality_Clu_250 0 "INVALID" 1 "LOW" 2 "MID" 3 "HIGH" ;
VAL_ 291 ARS_RDI_DynProp_Clu_251 0 "STATIONARY" 1 "MOVING" 2 "AMBIGUOUS" 3 "RESERVED" ;
VAL_ 291 ARS_RDI_Quality_Clu_251 0 "INVALID" 1 "LOW" 2 "MID" 3 "HIGH" ;
VAL_ 291 ARS_RDI_DynProp_Clu_252 0 "STATIONARY" 1 "MOVING" 2 "AMBIGUOUS" 3 "RESERVED" ;
VAL_ 291 ARS_RDI_Quality_Clu_252 0 "INVALID" 1 "LOW" 2 "MID" 3 "HIGH" ;
VAL_ 291 ARS_RDI_DynProp_Clu_253 0 "STATIONARY" 1 "MOVING" 2 "AMBIGUOUS" 3 "RESERVED" ;
VAL_ 291 ARS_RDI_Quality_Clu_253 0 "INVALID" 1 "LOW" 2 "MID" 3 "HIGH" ;
VAL_ 291 ARS_RDI_DynProp_Clu_254 0 "STATIONARY" 1 "MOVING" 2 "AMBIGUOUS" 3 "RESERVED" ;
VAL_ 291 ARS_RDI_Quality_Clu_254 0 "INVALID" 1 "LOW" 2 "MID" 3 "HIGH" ;
VAL_ 291 ARS_RDI_DynProp_Clu_255 0 "STATIONARY" 1 "MOVING" 2 "AMBIGUOUS" 3 "RESERVED" ;
VAL_ 291 ARS_RDI_Quality_Clu_255 0 "INVALID" 1 "LOW" 2 "MID" 3 "HIGH" ;
VAL_ 291 ARS_RDI_DynProp_Clu_248 0 "STATIONARY" 1 "MOVING" 2 "AMBIGUOUS" 3 "RESERVED" ;
VAL_ 291 ARS_RDI_Quality_Clu_248 0 "INVALID" 1 "LOW" 2 "MID" 3 "HIGH" ;
VAL_ 291 ARS_RDI_DynProp_Clu_249 0 "STATIONARY" 1 "MOVING" 2 "AMBIGUOUS" 3 "RESERVED" ;
VAL_ 291 ARS_RDI_Quality_Clu_249 0 "INVALID" 1 "LOW" 2 "MID" 3 "HIGH" ;
VAL_ 292 ARS_RDI_DynProp_Clu_258 0 "STATIONARY" 1 "MOVING" 2 "AMBIGUOUS" 3 "RESERVED" ;
VAL_ 292 ARS_RDI_Quality_Clu_258 0 "INVALID" 1 "LOW" 2 "MID" 3 "HIGH" ;
VAL_ 292 ARS_RDI_DynProp_Clu_259 0 "STATIONARY" 1 "MOVING" 2 "AMBIGUOUS" 3 "RESERVED" ;
VAL_ 292 ARS_RDI_Quality_Clu_259 0 "INVALID" 1 "LOW" 2 "MID" 3 "HIGH" ;
VAL_ 292 ARS_RDI_DynProp_Clu_260 0 "STATIONARY" 1 "MOVING" 2 "AMBIGUOUS" 3 "RESERVED" ;
VAL_ 292 ARS_RDI_Quality_Clu_260 0 "INVALID" 1 "LOW" 2 "MID" 3 "HIGH" ;
VAL_ 292 ARS_RDI_DynProp_Clu_261 0 "STATIONARY" 1 "MOVING" 2 "AMBIGUOUS" 3 "RESERVED" ;
VAL_ 292 ARS_RDI_Quality_Clu_261 0 "INVALID" 1 "LOW" 2 "MID" 3 "HIGH" ;
VAL_ 292 ARS_RDI_DynProp_Clu_262 0 "STATIONARY" 1 "MOVING" 2 "AMBIGUOUS" 3 "RESERVED" ;
VAL_ 292 ARS_RDI_Quality_Clu_262 0 "INVALID" 1 "LOW" 2 "MID" 3 "HIGH" ;
VAL_ 292 ARS_RDI_DynProp_Clu_263 0 "STATIONARY" 1 "MOVING" 2 "AMBIGUOUS" 3 "RESERVED" ;
VAL_ 292 ARS_RDI_Quality_Clu_263 0 "INVALID" 1 "LOW" 2 "MID" 3 "HIGH" ;
VAL_ 292 ARS_RDI_DynProp_Clu_256 0 "STATIONARY" 1 "MOVING" 2 "AMBIGUOUS" 3 "RESERVED" ;
VAL_ 292 ARS_RDI_Quality_Clu_256 0 "INVALID" 1 "LOW" 2 "MID" 3 "HIGH" ;
VAL_ 292 ARS_RDI_DynProp_Clu_257 0 "STATIONARY" 1 "MOVING" 2 "AMBIGUOUS" 3 "RESERVED" ;
VAL_ 292 ARS_RDI_Quality_Clu_257 0 "INVALID" 1 "LOW" 2 "MID" 3 "HIGH" ;
VAL_ 293 ARS_RDI_DynProp_Clu_266 0 "STATIONARY" 1 "MOVING" 2 "AMBIGUOUS" 3 "RESERVED" ;
VAL_ 293 ARS_RDI_Quality_Clu_266 0 "INVALID" 1 "LOW" 2 "MID" 3 "HIGH" ;
VAL_ 293 ARS_RDI_DynProp_Clu_267 0 "STATIONARY" 1 "MOVING" 2 "AMBIGUOUS" 3 "RESERVED" ;
VAL_ 293 ARS_RDI_Quality_Clu_267 0 "INVALID" 1 "LOW" 2 "MID" 3 "HIGH" ;
VAL_ 293 ARS_RDI_DynProp_Clu_268 0 "STATIONARY" 1 "MOVING" 2 "AMBIGUOUS" 3 "RESERVED" ;
VAL_ 293 ARS_RDI_Quality_Clu_268 0 "INVALID" 1 "LOW" 2 "MID" 3 "HIGH" ;
VAL_ 293 ARS_RDI_DynProp_Clu_269 0 "STATIONARY" 1 "MOVING" 2 "AMBIGUOUS" 3 "RESERVED" ;
VAL_ 293 ARS_RDI_Quality_Clu_269 0 "INVALID" 1 "LOW" 2 "MID" 3 "HIGH" ;
VAL_ 293 ARS_RDI_DynProp_Clu_270 0 "STATIONARY" 1 "MOVING" 2 "AMBIGUOUS" 3 "RESERVED" ;
VAL_ 293 ARS_RDI_Quality_Clu_270 0 "INVALID" 1 "LOW" 2 "MID" 3 "HIGH" ;
VAL_ 293 ARS_RDI_DynProp_Clu_271 0 "STATIONARY" 1 "MOVING" 2 "AMBIGUOUS" 3 "RESERVED" ;
VAL_ 293 ARS_RDI_Quality_Clu_271 0 "INVALID" 1 "LOW" 2 "MID" 3 "HIGH" ;
VAL_ 293 ARS_RDI_DynProp_Clu_264 0 "STATIONARY" 1 "MOVING" 2 "AMBIGUOUS" 3 "RESERVED" ;
VAL_ 293 ARS_RDI_Quality_Clu_264 0 "INVALID" 1 "LOW" 2 "MID" 3 "HIGH" ;
VAL_ 293 ARS_RDI_DynProp_Clu_265 0 "STATIONARY" 1 "MOVING" 2 "AMBIGUOUS" 3 "RESERVED" ;
VAL_ 293 ARS_RDI_Quality_Clu_265 0 "INVALID" 1 "LOW" 2 "MID" 3 "HIGH" ;
VAL_ 294 ARS_RDI_DynProp_Clu_274 0 "STATIONARY" 1 "MOVING" 2 "AMBIGUOUS" 3 "RESERVED" ;
VAL_ 294 ARS_RDI_Quality_Clu_274 0 "INVALID" 1 "LOW" 2 "MID" 3 "HIGH" ;
VAL_ 294 ARS_RDI_DynProp_Clu_275 0 "STATIONARY" 1 "MOVING" 2 "AMBIGUOUS" 3 "RESERVED" ;
VAL_ 294 ARS_RDI_Quality_Clu_275 0 "INVALID" 1 "LOW" 2 "MID" 3 "HIGH" ;
VAL_ 294 ARS_RDI_DynProp_Clu_276 0 "STATIONARY" 1 "MOVING" 2 "AMBIGUOUS" 3 "RESERVED" ;
VAL_ 294 ARS_RDI_Quality_Clu_276 0 "INVALID" 1 "LOW" 2 "MID" 3 "HIGH" ;
VAL_ 294 ARS_RDI_DynProp_Clu_277 0 "STATIONARY" 1 "MOVING" 2 "AMBIGUOUS" 3 "RESERVED" ;
VAL_ 294 ARS_RDI_Quality_Clu_277 0 "INVALID" 1 "LOW" 2 "MID" 3 "HIGH" ;
VAL_ 294 ARS_RDI_DynProp_Clu_278 0 "STATIONARY" 1 "MOVING" 2 "AMBIGUOUS" 3 "RESERVED" ;
VAL_ 294 ARS_RDI_Quality_Clu_278 0 "INVALID" 1 "LOW" 2 "MID" 3 "HIGH" ;
VAL_ 294 ARS_RDI_DynProp_Clu_279 0 "STATIONARY" 1 "MOVING" 2 "AMBIGUOUS" 3 "RESERVED" ;
VAL_ 294 ARS_RDI_Quality_Clu_279 0 "INVALID" 1 "LOW" 2 "MID" 3 "HIGH" ;
VAL_ 294 ARS_RDI_DynProp_Clu_272 0 "STATIONARY" 1 "MOVING" 2 "AMBIGUOUS" 3 "RESERVED" ;
VAL_ 294 ARS_RDI_Quality_Clu_272 0 "INVALID" 1 "LOW" 2 "MID" 3 "HIGH" ;
VAL_ 294 ARS_RDI_DynProp_Clu_273 0 "STATIONARY" 1 "MOVING" 2 "AMBIGUOUS" 3 "RESERVED" ;
VAL_ 294 ARS_RDI_Quality_Clu_273 0 "INVALID" 1 "LOW" 2 "MID" 3 "HIGH" ;
VAL_ 295 ARS_RDI_DynProp_Clu_282 0 "STATIONARY" 1 "MOVING" 2 "AMBIGUOUS" 3 "RESERVED" ;
VAL_ 295 ARS_RDI_Quality_Clu_282 0 "INVALID" 1 "LOW" 2 "MID" 3 "HIGH" ;
VAL_ 295 ARS_RDI_DynProp_Clu_283 0 "STATIONARY" 1 "MOVING" 2 "AMBIGUOUS" 3 "RESERVED" ;
VAL_ 295 ARS_RDI_Quality_Clu_283 0 "INVALID" 1 "LOW" 2 "MID" 3 "HIGH" ;
VAL_ 295 ARS_RDI_DynProp_Clu_284 0 "STATIONARY" 1 "MOVING" 2 "AMBIGUOUS" 3 "RESERVED" ;
VAL_ 295 ARS_RDI_Quality_Clu_284 0 "INVALID" 1 "LOW" 2 "MID" 3 "HIGH" ;
VAL_ 295 ARS_RDI_DynProp_Clu_285 0 "STATIONARY" 1 "MOVING" 2 "AMBIGUOUS" 3 "RESERVED" ;
VAL_ 295 ARS_RDI_Quality_Clu_285 0 "INVALID" 1 "LOW" 2 "MID" 3 "HIGH" ;
VAL_ 295 ARS_RDI_DynProp_Clu_286 0 "STATIONARY" 1 "MOVING" 2 "AMBIGUOUS" 3 "RESERVED" ;
VAL_ 295 ARS_RDI_Quality_Clu_286 0 "INVALID" 1 "LOW" 2 "MID" 3 "HIGH" ;
VAL_ 295 ARS_RDI_DynProp_Clu_287 0 "STATIONARY" 1 "MOVING" 2 "AMBIGUOUS" 3 "RESERVED" ;
VAL_ 295 ARS_RDI_Quality_Clu_287 0 "INVALID" 1 "LOW" 2 "MID" 3 "HIGH" ;
VAL_ 295 ARS_RDI_DynProp_Clu_280 0 "STATIONARY" 1 "MOVING" 2 "AMBIGUOUS" 3 "RESERVED" ;
VAL_ 295 ARS_RDI_Quality_Clu_280 0 "INVALID" 1 "LOW" 2 "MID" 3 "HIGH" ;
VAL_ 295 ARS_RDI_DynProp_Clu_281 0 "STATIONARY" 1 "MOVING" 2 "AMBIGUOUS" 3 "RESERVED" ;
VAL_ 295 ARS_RDI_Quality_Clu_281 0 "INVALID" 1 "LOW" 2 "MID" 3 "HIGH" ;
VAL_ 296 ARS_RDI_DynProp_Clu_290 0 "STATIONARY" 1 "MOVING" 2 "AMBIGUOUS" 3 "RESERVED" ;
VAL_ 296 ARS_RDI_Quality_Clu_290 0 "INVALID" 1 "LOW" 2 "MID" 3 "HIGH" ;
VAL_ 296 ARS_RDI_DynProp_Clu_291 0 "STATIONARY" 1 "MOVING" 2 "AMBIGUOUS" 3 "RESERVED" ;
VAL_ 296 ARS_RDI_Quality_Clu_291 0 "INVALID" 1 "LOW" 2 "MID" 3 "HIGH" ;
VAL_ 296 ARS_RDI_DynProp_Clu_292 0 "STATIONARY" 1 "MOVING" 2 "AMBIGUOUS" 3 "RESERVED" ;
VAL_ 296 ARS_RDI_Quality_Clu_292 0 "INVALID" 1 "LOW" 2 "MID" 3 "HIGH" ;
VAL_ 296 ARS_RDI_DynProp_Clu_293 0 "STATIONARY" 1 "MOVING" 2 "AMBIGUOUS" 3 "RESERVED" ;
VAL_ 296 ARS_RDI_Quality_Clu_293 0 "INVALID" 1 "LOW" 2 "MID" 3 "HIGH" ;
VAL_ 296 ARS_RDI_DynProp_Clu_294 0 "STATIONARY" 1 "MOVING" 2 "AMBIGUOUS" 3 "RESERVED" ;
VAL_ 296 ARS_RDI_Quality_Clu_294 0 "INVALID" 1 "LOW" 2 "MID" 3 "HIGH" ;
VAL_ 296 ARS_RDI_DynProp_Clu_295 0 "STATIONARY" 1 "MOVING" 2 "AMBIGUOUS" 3 "RESERVED" ;
VAL_ 296 ARS_RDI_Quality_Clu_295 0 "INVALID" 1 "LOW" 2 "MID" 3 "HIGH" ;
VAL_ 296 ARS_RDI_DynProp_Clu_288 0 "STATIONARY" 1 "MOVING" 2 "AMBIGUOUS" 3 "RESERVED" ;
VAL_ 296 ARS_RDI_Quality_Clu_288 0 "INVALID" 1 "LOW" 2 "MID" 3 "HIGH" ;
VAL_ 296 ARS_RDI_DynProp_Clu_289 0 "STATIONARY" 1 "MOVING" 2 "AMBIGUOUS" 3 "RESERVED" ;
VAL_ 296 ARS_RDI_Quality_Clu_289 0 "INVALID" 1 "LOW" 2 "MID" 3 "HIGH" ;
VAL_ 297 ARS_RDI_DynProp_Clu_298 0 "STATIONARY" 1 "MOVING" 2 "AMBIGUOUS" 3 "RESERVED" ;
VAL_ 297 ARS_RDI_Quality_Clu_298 0 "INVALID" 1 "LOW" 2 "MID" 3 "HIGH" ;
VAL_ 297 ARS_RDI_DynProp_Clu_299 0 "STATIONARY" 1 "MOVING" 2 "AMBIGUOUS" 3 "RESERVED" ;
VAL_ 297 ARS_RDI_Quality_Clu_299 0 "INVALID" 1 "LOW" 2 "MID" 3 "HIGH" ;
VAL_ 297 ARS_RDI_DynProp_Clu_300 0 "STATIONARY" 1 "MOVING" 2 "AMBIGUOUS" 3 "RESERVED" ;
VAL_ 297 ARS_RDI_Quality_Clu_300 0 "INVALID" 1 "LOW" 2 "MID" 3 "HIGH" ;
VAL_ 297 ARS_RDI_DynProp_Clu_301 0 "STATIONARY" 1 "MOVING" 2 "AMBIGUOUS" 3 "RESERVED" ;
VAL_ 297 ARS_RDI_Quality_Clu_301 0 "INVALID" 1 "LOW" 2 "MID" 3 "HIGH" ;
VAL_ 297 ARS_RDI_DynProp_Clu_302 0 "STATIONARY" 1 "MOVING" 2 "AMBIGUOUS" 3 "RESERVED" ;
VAL_ 297 ARS_RDI_Quality_Clu_302 0 "INVALID" 1 "LOW" 2 "MID" 3 "HIGH" ;
VAL_ 297 ARS_RDI_DynProp_Clu_303 0 "STATIONARY" 1 "MOVING" 2 "AMBIGUOUS" 3 "RESERVED" ;
VAL_ 297 ARS_RDI_Quality_Clu_303 0 "INVALID" 1 "LOW" 2 "MID" 3 "HIGH" ;
VAL_ 297 ARS_RDI_DynProp_Clu_296 0 "STATIONARY" 1 "MOVING" 2 "AMBIGUOUS" 3 "RESERVED" ;
VAL_ 297 ARS_RDI_Quality_Clu_296 0 "INVALID" 1 "LOW" 2 "MID" 3 "HIGH" ;
VAL_ 297 ARS_RDI_DynProp_Clu_297 0 "STATIONARY" 1 "MOVING" 2 "AMBIGUOUS" 3 "RESERVED" ;
VAL_ 297 ARS_RDI_Quality_Clu_297 0 "INVALID" 1 "LOW" 2 "MID" 3 "HIGH" ;
VAL_ 298 ARS_RDI_DynProp_Clu_306 0 "STATIONARY" 1 "MOVING" 2 "AMBIGUOUS" 3 "RESERVED" ;
VAL_ 298 ARS_RDI_Quality_Clu_306 0 "INVALID" 1 "LOW" 2 "MID" 3 "HIGH" ;
VAL_ 298 ARS_RDI_DynProp_Clu_307 0 "STATIONARY" 1 "MOVING" 2 "AMBIGUOUS" 3 "RESERVED" ;
VAL_ 298 ARS_RDI_Quality_Clu_307 0 "INVALID" 1 "LOW" 2 "MID" 3 "HIGH" ;
VAL_ 298 ARS_RDI_DynProp_Clu_308 0 "STATIONARY" 1 "MOVING" 2 "AMBIGUOUS" 3 "RESERVED" ;
VAL_ 298 ARS_RDI_Quality_Clu_308 0 "INVALID" 1 "LOW" 2 "MID" 3 "HIGH" ;
VAL_ 298 ARS_RDI_DynProp_Clu_309 0 "STATIONARY" 1 "MOVING" 2 "AMBIGUOUS" 3 "RESERVED" ;
VAL_ 298 ARS_RDI_Quality_Clu_309 0 "INVALID" 1 "LOW" 2 "MID" 3 "HIGH" ;
VAL_ 298 ARS_RDI_DynProp_Clu_310 0 "STATIONARY" 1 "MOVING" 2 "AMBIGUOUS" 3 "RESERVED" ;
VAL_ 298 ARS_RDI_Quality_Clu_310 0 "INVALID" 1 "LOW" 2 "MID" 3 "HIGH" ;
VAL_ 298 ARS_RDI_DynProp_Clu_311 0 "STATIONARY" 1 "MOVING" 2 "AMBIGUOUS" 3 "RESERVED" ;
VAL_ 298 ARS_RDI_Quality_Clu_311 0 "INVALID" 1 "LOW" 2 "MID" 3 "HIGH" ;
VAL_ 298 ARS_RDI_DynProp_Clu_304 0 "STATIONARY" 1 "MOVING" 2 "AMBIGUOUS" 3 "RESERVED" ;
VAL_ 298 ARS_RDI_Quality_Clu_304 0 "INVALID" 1 "LOW" 2 "MID" 3 "HIGH" ;
VAL_ 298 ARS_RDI_DynProp_Clu_305 0 "STATIONARY" 1 "MOVING" 2 "AMBIGUOUS" 3 "RESERVED" ;
VAL_ 298 ARS_RDI_Quality_Clu_305 0 "INVALID" 1 "LOW" 2 "MID" 3 "HIGH" ;
VAL_ 299 ARS_RDI_DynProp_Clu_314 0 "STATIONARY" 1 "MOVING" 2 "AMBIGUOUS" 3 "RESERVED" ;
VAL_ 299 ARS_RDI_Quality_Clu_314 0 "INVALID" 1 "LOW" 2 "MID" 3 "HIGH" ;
VAL_ 299 ARS_RDI_DynProp_Clu_315 0 "STATIONARY" 1 "MOVING" 2 "AMBIGUOUS" 3 "RESERVED" ;
VAL_ 299 ARS_RDI_Quality_Clu_315 0 "INVALID" 1 "LOW" 2 "MID" 3 "HIGH" ;
VAL_ 299 ARS_RDI_DynProp_Clu_316 0 "STATIONARY" 1 "MOVING" 2 "AMBIGUOUS" 3 "RESERVED" ;
VAL_ 299 ARS_RDI_Quality_Clu_316 0 "INVALID" 1 "LOW" 2 "MID" 3 "HIGH" ;
VAL_ 299 ARS_RDI_DynProp_Clu_317 0 "STATIONARY" 1 "MOVING" 2 "AMBIGUOUS" 3 "RESERVED" ;
VAL_ 299 ARS_RDI_Quality_Clu_317 0 "INVALID" 1 "LOW" 2 "MID" 3 "HIGH" ;
VAL_ 299 ARS_RDI_DynProp_Clu_318 0 "STATIONARY" 1 "MOVING" 2 "AMBIGUOUS" 3 "RESERVED" ;
VAL_ 299 ARS_RDI_Quality_Clu_318 0 "INVALID" 1 "LOW" 2 "MID" 3 "HIGH" ;
VAL_ 299 ARS_RDI_DynProp_Clu_319 0 "STATIONARY" 1 "MOVING" 2 "AMBIGUOUS" 3 "RESERVED" ;
VAL_ 299 ARS_RDI_Quality_Clu_319 0 "INVALID" 1 "LOW" 2 "MID" 3 "HIGH" ;
VAL_ 299 ARS_RDI_DynProp_Clu_312 0 "STATIONARY" 1 "MOVING" 2 "AMBIGUOUS" 3 "RESERVED" ;
VAL_ 299 ARS_RDI_Quality_Clu_312 0 "INVALID" 1 "LOW" 2 "MID" 3 "HIGH" ;
VAL_ 299 ARS_RDI_DynProp_Clu_313 0 "STATIONARY" 1 "MOVING" 2 "AMBIGUOUS" 3 "RESERVED" ;
VAL_ 299 ARS_RDI_Quality_Clu_313 0 "INVALID" 1 "LOW" 2 "MID" 3 "HIGH" ;
VAL_ 300 ARS_RDI_DynProp_Clu_322 0 "STATIONARY" 1 "MOVING" 2 "AMBIGUOUS" 3 "RESERVED" ;
VAL_ 300 ARS_RDI_Quality_Clu_322 0 "INVALID" 1 "LOW" 2 "MID" 3 "HIGH" ;
VAL_ 300 ARS_RDI_DynProp_Clu_323 0 "STATIONARY" 1 "MOVING" 2 "AMBIGUOUS" 3 "RESERVED" ;
VAL_ 300 ARS_RDI_Quality_Clu_323 0 "INVALID" 1 "LOW" 2 "MID" 3 "HIGH" ;
VAL_ 300 ARS_RDI_DynProp_Clu_324 0 "STATIONARY" 1 "MOVING" 2 "AMBIGUOUS" 3 "RESERVED" ;
VAL_ 300 ARS_RDI_Quality_Clu_324 0 "INVALID" 1 "LOW" 2 "MID" 3 "HIGH" ;
VAL_ 300 ARS_RDI_DynProp_Clu_325 0 "STATIONARY" 1 "MOVING" 2 "AMBIGUOUS" 3 "RESERVED" ;
VAL_ 300 ARS_RDI_Quality_Clu_325 0 "INVALID" 1 "LOW" 2 "MID" 3 "HIGH" ;
VAL_ 300 ARS_RDI_DynProp_Clu_326 0 "STATIONARY" 1 "MOVING" 2 "AMBIGUOUS" 3 "RESERVED" ;
VAL_ 300 ARS_RDI_Quality_Clu_326 0 "INVALID" 1 "LOW" 2 "MID" 3 "HIGH" ;
VAL_ 300 ARS_RDI_DynProp_Clu_327 0 "STATIONARY" 1 "MOVING" 2 "AMBIGUOUS" 3 "RESERVED" ;
VAL_ 300 ARS_RDI_Quality_Clu_327 0 "INVALID" 1 "LOW" 2 "MID" 3 "HIGH" ;
VAL_ 300 ARS_RDI_DynProp_Clu_320 0 "STATIONARY" 1 "MOVING" 2 "AMBIGUOUS" 3 "RESERVED" ;
VAL_ 300 ARS_RDI_Quality_Clu_320 0 "INVALID" 1 "LOW" 2 "MID" 3 "HIGH" ;
VAL_ 300 ARS_RDI_DynProp_Clu_321 0 "STATIONARY" 1 "MOVING" 2 "AMBIGUOUS" 3 "RESERVED" ;
VAL_ 300 ARS_RDI_Quality_Clu_321 0 "INVALID" 1 "LOW" 2 "MID" 3 "HIGH" ;
VAL_ 301 ARS_RDI_DynProp_Clu_330 0 "STATIONARY" 1 "MOVING" 2 "AMBIGUOUS" 3 "RESERVED" ;
VAL_ 301 ARS_RDI_Quality_Clu_330 0 "INVALID" 1 "LOW" 2 "MID" 3 "HIGH" ;
VAL_ 301 ARS_RDI_DynProp_Clu_331 0 "STATIONARY" 1 "MOVING" 2 "AMBIGUOUS" 3 "RESERVED" ;
VAL_ 301 ARS_RDI_Quality_Clu_331 0 "INVALID" 1 "LOW" 2 "MID" 3 "HIGH" ;
VAL_ 301 ARS_RDI_DynProp_Clu_332 0 "STATIONARY" 1 "MOVING" 2 "AMBIGUOUS" 3 "RESERVED" ;
VAL_ 301 ARS_RDI_Quality_Clu_332 0 "INVALID" 1 "LOW" 2 "MID" 3 "HIGH" ;
VAL_ 301 ARS_RDI_DynProp_Clu_333 0 "STATIONARY" 1 "MOVING" 2 "AMBIGUOUS" 3 "RESERVED" ;
VAL_ 301 ARS_RDI_Quality_Clu_333 0 "INVALID" 1 "LOW" 2 "MID" 3 "HIGH" ;
VAL_ 301 ARS_RDI_DynProp_Clu_334 0 "STATIONARY" 1 "MOVING" 2 "AMBIGUOUS" 3 "RESERVED" ;
VAL_ 301 ARS_RDI_Quality_Clu_334 0 "INVALID" 1 "LOW" 2 "MID" 3 "HIGH" ;
VAL_ 301 ARS_RDI_DynProp_Clu_335 0 "STATIONARY" 1 "MOVING" 2 "AMBIGUOUS" 3 "RESERVED" ;
VAL_ 301 ARS_RDI_Quality_Clu_335 0 "INVALID" 1 "LOW" 2 "MID" 3 "HIGH" ;
VAL_ 301 ARS_RDI_DynProp_Clu_328 0 "STATIONARY" 1 "MOVING" 2 "AMBIGUOUS" 3 "RESERVED" ;
VAL_ 301 ARS_RDI_Quality_Clu_328 0 "INVALID" 1 "LOW" 2 "MID" 3 "HIGH" ;
VAL_ 301 ARS_RDI_DynProp_Clu_329 0 "STATIONARY" 1 "MOVING" 2 "AMBIGUOUS" 3 "RESERVED" ;
VAL_ 301 ARS_RDI_Quality_Clu_329 0 "INVALID" 1 "LOW" 2 "MID" 3 "HIGH" ;
VAL_ 302 ARS_RDI_DynProp_Clu_338 0 "STATIONARY" 1 "MOVING" 2 "AMBIGUOUS" 3 "RESERVED" ;
VAL_ 302 ARS_RDI_Quality_Clu_338 0 "INVALID" 1 "LOW" 2 "MID" 3 "HIGH" ;
VAL_ 302 ARS_RDI_DynProp_Clu_339 0 "STATIONARY" 1 "MOVING" 2 "AMBIGUOUS" 3 "RESERVED" ;
VAL_ 302 ARS_RDI_Quality_Clu_339 0 "INVALID" 1 "LOW" 2 "MID" 3 "HIGH" ;
VAL_ 302 ARS_RDI_DynProp_Clu_340 0 "STATIONARY" 1 "MOVING" 2 "AMBIGUOUS" 3 "RESERVED" ;
VAL_ 302 ARS_RDI_Quality_Clu_340 0 "INVALID" 1 "LOW" 2 "MID" 3 "HIGH" ;
VAL_ 302 ARS_RDI_DynProp_Clu_341 0 "STATIONARY" 1 "MOVING" 2 "AMBIGUOUS" 3 "RESERVED" ;
VAL_ 302 ARS_RDI_Quality_Clu_341 0 "INVALID" 1 "LOW" 2 "MID" 3 "HIGH" ;
VAL_ 302 ARS_RDI_DynProp_Clu_342 0 "STATIONARY" 1 "MOVING" 2 "AMBIGUOUS" 3 "RESERVED" ;
VAL_ 302 ARS_RDI_Quality_Clu_342 0 "INVALID" 1 "LOW" 2 "MID" 3 "HIGH" ;
VAL_ 302 ARS_RDI_DynProp_Clu_343 0 "STATIONARY" 1 "MOVING" 2 "AMBIGUOUS" 3 "RESERVED" ;
VAL_ 302 ARS_RDI_Quality_Clu_343 0 "INVALID" 1 "LOW" 2 "MID" 3 "HIGH" ;
VAL_ 302 ARS_RDI_DynProp_Clu_336 0 "STATIONARY" 1 "MOVING" 2 "AMBIGUOUS" 3 "RESERVED" ;
VAL_ 302 ARS_RDI_Quality_Clu_336 0 "INVALID" 1 "LOW" 2 "MID" 3 "HIGH" ;
VAL_ 302 ARS_RDI_DynProp_Clu_337 0 "STATIONARY" 1 "MOVING" 2 "AMBIGUOUS" 3 "RESERVED" ;
VAL_ 302 ARS_RDI_Quality_Clu_337 0 "INVALID" 1 "LOW" 2 "MID" 3 "HIGH" ;
VAL_ 303 ARS_RDI_DynProp_Clu_346 0 "STATIONARY" 1 "MOVING" 2 "AMBIGUOUS" 3 "RESERVED" ;
VAL_ 303 ARS_RDI_Quality_Clu_346 0 "INVALID" 1 "LOW" 2 "MID" 3 "HIGH" ;
VAL_ 303 ARS_RDI_DynProp_Clu_347 0 "STATIONARY" 1 "MOVING" 2 "AMBIGUOUS" 3 "RESERVED" ;
VAL_ 303 ARS_RDI_Quality_Clu_347 0 "INVALID" 1 "LOW" 2 "MID" 3 "HIGH" ;
VAL_ 303 ARS_RDI_DynProp_Clu_348 0 "STATIONARY" 1 "MOVING" 2 "AMBIGUOUS" 3 "RESERVED" ;
VAL_ 303 ARS_RDI_Quality_Clu_348 0 "INVALID" 1 "LOW" 2 "MID" 3 "HIGH" ;
VAL_ 303 ARS_RDI_DynProp_Clu_349 0 "STATIONARY" 1 "MOVING" 2 "AMBIGUOUS" 3 "RESERVED" ;
VAL_ 303 ARS_RDI_Quality_Clu_349 0 "INVALID" 1 "LOW" 2 "MID" 3 "HIGH" ;
VAL_ 303 ARS_RDI_DynProp_Clu_350 0 "STATIONARY" 1 "MOVING" 2 "AMBIGUOUS" 3 "RESERVED" ;
VAL_ 303 ARS_RDI_Quality_Clu_350 0 "INVALID" 1 "LOW" 2 "MID" 3 "HIGH" ;
VAL_ 303 ARS_RDI_DynProp_Clu_351 0 "STATIONARY" 1 "MOVING" 2 "AMBIGUOUS" 3 "RESERVED" ;
VAL_ 303 ARS_RDI_Quality_Clu_351 0 "INVALID" 1 "LOW" 2 "MID" 3 "HIGH" ;
VAL_ 303 ARS_RDI_DynProp_Clu_344 0 "STATIONARY" 1 "MOVING" 2 "AMBIGUOUS" 3 "RESERVED" ;
VAL_ 303 ARS_RDI_Quality_Clu_344 0 "INVALID" 1 "LOW" 2 "MID" 3 "HIGH" ;
VAL_ 303 ARS_RDI_DynProp_Clu_345 0 "STATIONARY" 1 "MOVING" 2 "AMBIGUOUS" 3 "RESERVED" ;
VAL_ 303 ARS_RDI_Quality_Clu_345 0 "INVALID" 1 "LOW" 2 "MID" 3 "HIGH" ;
VAL_ 304 ARS_RDI_DynProp_Clu_354 0 "STATIONARY" 1 "MOVING" 2 "AMBIGUOUS" 3 "RESERVED" ;
VAL_ 304 ARS_RDI_Quality_Clu_354 0 "INVALID" 1 "LOW" 2 "MID" 3 "HIGH" ;
VAL_ 304 ARS_RDI_DynProp_Clu_355 0 "STATIONARY" 1 "MOVING" 2 "AMBIGUOUS" 3 "RESERVED" ;
VAL_ 304 ARS_RDI_Quality_Clu_355 0 "INVALID" 1 "LOW" 2 "MID" 3 "HIGH" ;
VAL_ 304 ARS_RDI_DynProp_Clu_356 0 "STATIONARY" 1 "MOVING" 2 "AMBIGUOUS" 3 "RESERVED" ;
VAL_ 304 ARS_RDI_Quality_Clu_356 0 "INVALID" 1 "LOW" 2 "MID" 3 "HIGH" ;
VAL_ 304 ARS_RDI_DynProp_Clu_357 0 "STATIONARY" 1 "MOVING" 2 "AMBIGUOUS" 3 "RESERVED" ;
VAL_ 304 ARS_RDI_Quality_Clu_357 0 "INVALID" 1 "LOW" 2 "MID" 3 "HIGH" ;
VAL_ 304 ARS_RDI_DynProp_Clu_358 0 "STATIONARY" 1 "MOVING" 2 "AMBIGUOUS" 3 "RESERVED" ;
VAL_ 304 ARS_RDI_Quality_Clu_358 0 "INVALID" 1 "LOW" 2 "MID" 3 "HIGH" ;
VAL_ 304 ARS_RDI_DynProp_Clu_359 0 "STATIONARY" 1 "MOVING" 2 "AMBIGUOUS" 3 "RESERVED" ;
VAL_ 304 ARS_RDI_Quality_Clu_359 0 "INVALID" 1 "LOW" 2 "MID" 3 "HIGH" ;
VAL_ 304 ARS_RDI_DynProp_Clu_352 0 "STATIONARY" 1 "MOVING" 2 "AMBIGUOUS" 3 "RESERVED" ;
VAL_ 304 ARS_RDI_Quality_Clu_352 0 "INVALID" 1 "LOW" 2 "MID" 3 "HIGH" ;
VAL_ 304 ARS_RDI_DynProp_Clu_353 0 "STATIONARY" 1 "MOVING" 2 "AMBIGUOUS" 3 "RESERVED" ;
VAL_ 304 ARS_RDI_Quality_Clu_353 0 "INVALID" 1 "LOW" 2 "MID" 3 "HIGH" ;
VAL_ 305 ARS_RDI_DynProp_Clu_362 0 "STATIONARY" 1 "MOVING" 2 "AMBIGUOUS" 3 "RESERVED" ;
VAL_ 305 ARS_RDI_Quality_Clu_362 0 "INVALID" 1 "LOW" 2 "MID" 3 "HIGH" ;
VAL_ 305 ARS_RDI_DynProp_Clu_363 0 "STATIONARY" 1 "MOVING" 2 "AMBIGUOUS" 3 "RESERVED" ;
VAL_ 305 ARS_RDI_Quality_Clu_363 0 "INVALID" 1 "LOW" 2 "MID" 3 "HIGH" ;
VAL_ 305 ARS_RDI_DynProp_Clu_364 0 "STATIONARY" 1 "MOVING" 2 "AMBIGUOUS" 3 "RESERVED" ;
VAL_ 305 ARS_RDI_Quality_Clu_364 0 "INVALID" 1 "LOW" 2 "MID" 3 "HIGH" ;
VAL_ 305 ARS_RDI_DynProp_Clu_365 0 "STATIONARY" 1 "MOVING" 2 "AMBIGUOUS" 3 "RESERVED" ;
VAL_ 305 ARS_RDI_Quality_Clu_365 0 "INVALID" 1 "LOW" 2 "MID" 3 "HIGH" ;
VAL_ 305 ARS_RDI_DynProp_Clu_366 0 "STATIONARY" 1 "MOVING" 2 "AMBIGUOUS" 3 "RESERVED" ;
VAL_ 305 ARS_RDI_Quality_Clu_366 0 "INVALID" 1 "LOW" 2 "MID" 3 "HIGH" ;
VAL_ 305 ARS_RDI_DynProp_Clu_367 0 "STATIONARY" 1 "MOVING" 2 "AMBIGUOUS" 3 "RESERVED" ;
VAL_ 305 ARS_RDI_Quality_Clu_367 0 "INVALID" 1 "LOW" 2 "MID" 3 "HIGH" ;
VAL_ 305 ARS_RDI_DynProp_Clu_360 0 "STATIONARY" 1 "MOVING" 2 "AMBIGUOUS" 3 "RESERVED" ;
VAL_ 305 ARS_RDI_Quality_Clu_360 0 "INVALID" 1 "LOW" 2 "MID" 3 "HIGH" ;
VAL_ 305 ARS_RDI_DynProp_Clu_361 0 "STATIONARY" 1 "MOVING" 2 "AMBIGUOUS" 3 "RESERVED" ;
VAL_ 305 ARS_RDI_Quality_Clu_361 0 "INVALID" 1 "LOW" 2 "MID" 3 "HIGH" ;
VAL_ 306 ARS_RDI_DynProp_Clu_370 0 "STATIONARY" 1 "MOVING" 2 "AMBIGUOUS" 3 "RESERVED" ;
VAL_ 306 ARS_RDI_Quality_Clu_370 0 "INVALID" 1 "LOW" 2 "MID" 3 "HIGH" ;
VAL_ 306 ARS_RDI_DynProp_Clu_371 0 "STATIONARY" 1 "MOVING" 2 "AMBIGUOUS" 3 "RESERVED" ;
VAL_ 306 ARS_RDI_Quality_Clu_371 0 "INVALID" 1 "LOW" 2 "MID" 3 "HIGH" ;
VAL_ 306 ARS_RDI_DynProp_Clu_372 0 "STATIONARY" 1 "MOVING" 2 "AMBIGUOUS" 3 "RESERVED" ;
VAL_ 306 ARS_RDI_Quality_Clu_372 0 "INVALID" 1 "LOW" 2 "MID" 3 "HIGH" ;
VAL_ 306 ARS_RDI_DynProp_Clu_373 0 "STATIONARY" 1 "MOVING" 2 "AMBIGUOUS" 3 "RESERVED" ;
VAL_ 306 ARS_RDI_Quality_Clu_373 0 "INVALID" 1 "LOW" 2 "MID" 3 "HIGH" ;
VAL_ 306 ARS_RDI_DynProp_Clu_374 0 "STATIONARY" 1 "MOVING" 2 "AMBIGUOUS" 3 "RESERVED" ;
VAL_ 306 ARS_RDI_Quality_Clu_374 0 "INVALID" 1 "LOW" 2 "MID" 3 "HIGH" ;
VAL_ 306 ARS_RDI_DynProp_Clu_375 0 "STATIONARY" 1 "MOVING" 2 "AMBIGUOUS" 3 "RESERVED" ;
VAL_ 306 ARS_RDI_Quality_Clu_375 0 "INVALID" 1 "LOW" 2 "MID" 3 "HIGH" ;
VAL_ 306 ARS_RDI_DynProp_Clu_368 0 "STATIONARY" 1 "MOVING" 2 "AMBIGUOUS" 3 "RESERVED" ;
VAL_ 306 ARS_RDI_Quality_Clu_368 0 "INVALID" 1 "LOW" 2 "MID" 3 "HIGH" ;
VAL_ 306 ARS_RDI_DynProp_Clu_369 0 "STATIONARY" 1 "MOVING" 2 "AMBIGUOUS" 3 "RESERVED" ;
VAL_ 306 ARS_RDI_Quality_Clu_369 0 "INVALID" 1 "LOW" 2 "MID" 3 "HIGH" ;
SIG_GROUP_ 288 Signal_Group_ARS_RDI_224_231 1 : ARS_RDI_Range_Clu_224 ARS_RDI_ElevationAng_Clu_225 ARS_RDI_SNR_Clu_225 ARS_RDI_Range_Clu_226 ARS_RDI_VradRel_Clu_224 ARS_RDI_VradRel_Clu_226 ARS_RDI_RCS_Clu_226 ARS_RDI_AzimuthAng_Clu_226 ARS_RDI_ElevationAng_Clu_226 ARS_RDI_SNR_Clu_226 ARS_RDI_DynProp_Clu_226 ARS_RDI_Quality_Clu_226 ARS_RDI_DynProp_Clu_227 ARS_RDI_Quality_Clu_227 ARS_RDI_Range_Clu_227 ARS_RDI_VradRel_Clu_227 ARS_RDI_RCS_Clu_227 ARS_RDI_AzimuthAng_Clu_227 ARS_RDI_ElevationAng_Clu_227 ARS_RDI_SNR_Clu_227 ARS_RDI_RCS_Clu_224 ARS_RDI_Range_Clu_228 ARS_RDI_VradRel_Clu_228 ARS_RDI_RCS_Clu_228 ARS_RDI_AzimuthAng_Clu_228 ARS_RDI_ElevationAng_Clu_228 ARS_RDI_SNR_Clu_228 ARS_RDI_DynProp_Clu_228 ARS_RDI_Quality_Clu_228 ARS_RDI_DynProp_Clu_229 ARS_RDI_Quality_Clu_229 ARS_RDI_Range_Clu_229 ARS_RDI_VradRel_Clu_229 ARS_RDI_RCS_Clu_229 ARS_RDI_AzimuthAng_Clu_224 ARS_RDI_AzimuthAng_Clu_229 ARS_RDI_ElevationAng_Clu_229 ARS_RDI_SNR_Clu_229 ARS_RDI_Range_Clu_230 ARS_RDI_VradRel_Clu_230 ARS_RDI_RCS_Clu_230 ARS_RDI_AzimuthAng_Clu_230 ARS_RDI_ElevationAng_Clu_230 ARS_RDI_SNR_Clu_230 ARS_RDI_DynProp_Clu_230 ARS_RDI_Quality_Clu_230 ARS_RDI_DynProp_Clu_231 ARS_RDI_Quality_Clu_231 ARS_RDI_Range_Clu_231 ARS_RDI_ElevationAng_Clu_224 ARS_RDI_VradRel_Clu_231 ARS_RDI_RCS_Clu_231 ARS_RDI_AzimuthAng_Clu_231 ARS_RDI_ElevationAng_Clu_231 ARS_RDI_SNR_Clu_231 ARS_RDI_MsgCounter_Clu_224_231 ARS_RDI_CRC16_Checksum_Clu_224_2 ARS_RDI_SNR_Clu_224 ARS_RDI_DynProp_Clu_224 ARS_RDI_Quality_Clu_224 ARS_RDI_DynProp_Clu_225 ARS_RDI_Quality_Clu_225 ARS_RDI_Range_Clu_225 ARS_RDI_VradRel_Clu_225 ARS_RDI_RCS_Clu_225 ARS_RDI_AzimuthAng_Clu_225;
SIG_GROUP_ 289 Signal_Group_ARS_RDI_232_239 1 : ARS_RDI_Range_Clu_232 ARS_RDI_ElevationAng_Clu_233 ARS_RDI_SNR_Clu_233 ARS_RDI_Range_Clu_234 ARS_RDI_VradRel_Clu_232 ARS_RDI_VradRel_Clu_234 ARS_RDI_RCS_Clu_234 ARS_RDI_AzimuthAng_Clu_234 ARS_RDI_ElevationAng_Clu_234 ARS_RDI_SNR_Clu_234 ARS_RDI_DynProp_Clu_234 ARS_RDI_Quality_Clu_234 ARS_RDI_DynProp_Clu_235 ARS_RDI_Quality_Clu_235 ARS_RDI_Range_Clu_235 ARS_RDI_VradRel_Clu_235 ARS_RDI_RCS_Clu_235 ARS_RDI_AzimuthAng_Clu_235 ARS_RDI_ElevationAng_Clu_235 ARS_RDI_SNR_Clu_235 ARS_RDI_RCS_Clu_232 ARS_RDI_Range_Clu_236 ARS_RDI_VradRel_Clu_236 ARS_RDI_RCS_Clu_236 ARS_RDI_AzimuthAng_Clu_236 ARS_RDI_ElevationAng_Clu_236 ARS_RDI_SNR_Clu_236 ARS_RDI_DynProp_Clu_236 ARS_RDI_Quality_Clu_236 ARS_RDI_DynProp_Clu_237 ARS_RDI_Quality_Clu_237 ARS_RDI_Range_Clu_237 ARS_RDI_VradRel_Clu_237 ARS_RDI_RCS_Clu_237 ARS_RDI_AzimuthAng_Clu_232 ARS_RDI_AzimuthAng_Clu_237 ARS_RDI_ElevationAng_Clu_237 ARS_RDI_SNR_Clu_237 ARS_RDI_Range_Clu_238 ARS_RDI_VradRel_Clu_238 ARS_RDI_RCS_Clu_238 ARS_RDI_AzimuthAng_Clu_238 ARS_RDI_ElevationAng_Clu_238 ARS_RDI_SNR_Clu_238 ARS_RDI_DynProp_Clu_238 ARS_RDI_Quality_Clu_238 ARS_RDI_DynProp_Clu_239 ARS_RDI_Quality_Clu_239 ARS_RDI_Range_Clu_239 ARS_RDI_ElevationAng_Clu_232 ARS_RDI_VradRel_Clu_239 ARS_RDI_RCS_Clu_239 ARS_RDI_AzimuthAng_Clu_239 ARS_RDI_ElevationAng_Clu_239 ARS_RDI_SNR_Clu_239 ARS_RDI_MsgCounter_Clu_232_239 ARS_RDI_CRC16_Checksum_Clu_232_2 ARS_RDI_SNR_Clu_232 ARS_RDI_DynProp_Clu_232 ARS_RDI_Quality_Clu_232 ARS_RDI_DynProp_Clu_233 ARS_RDI_Quality_Clu_233 ARS_RDI_Range_Clu_233 ARS_RDI_VradRel_Clu_233 ARS_RDI_RCS_Clu_233 ARS_RDI_AzimuthAng_Clu_233;
SIG_GROUP_ 290 Signal_Group_ARS_RDI_240_247 1 : ARS_RDI_Range_Clu_240 ARS_RDI_ElevationAng_Clu_241 ARS_RDI_SNR_Clu_241 ARS_RDI_Range_Clu_242 ARS_RDI_VradRel_Clu_240 ARS_RDI_VradRel_Clu_242 ARS_RDI_RCS_Clu_242 ARS_RDI_AzimuthAng_Clu_242 ARS_RDI_ElevationAng_Clu_242 ARS_RDI_SNR_Clu_242 ARS_RDI_DynProp_Clu_242 ARS_RDI_Quality_Clu_242 ARS_RDI_DynProp_Clu_243 ARS_RDI_Quality_Clu_243 ARS_RDI_Range_Clu_243 ARS_RDI_VradRel_Clu_243 ARS_RDI_RCS_Clu_243 ARS_RDI_AzimuthAng_Clu_243 ARS_RDI_ElevationAng_Clu_243 ARS_RDI_SNR_Clu_243 ARS_RDI_RCS_Clu_240 ARS_RDI_Range_Clu_244 ARS_RDI_VradRel_Clu_244 ARS_RDI_RCS_Clu_244 ARS_RDI_AzimuthAng_Clu_244 ARS_RDI_ElevationAng_Clu_244 ARS_RDI_SNR_Clu_244 ARS_RDI_DynProp_Clu_244 ARS_RDI_Quality_Clu_244 ARS_RDI_DynProp_Clu_245 ARS_RDI_Quality_Clu_245 ARS_RDI_Range_Clu_245 ARS_RDI_VradRel_Clu_245 ARS_RDI_RCS_Clu_245 ARS_RDI_AzimuthAng_Clu_240 ARS_RDI_AzimuthAng_Clu_245 ARS_RDI_ElevationAng_Clu_245 ARS_RDI_SNR_Clu_245 ARS_RDI_Range_Clu_246 ARS_RDI_VradRel_Clu_246 ARS_RDI_RCS_Clu_246 ARS_RDI_AzimuthAng_Clu_246 ARS_RDI_ElevationAng_Clu_246 ARS_RDI_SNR_Clu_246 ARS_RDI_DynProp_Clu_246 ARS_RDI_Quality_Clu_246 ARS_RDI_DynProp_Clu_247 ARS_RDI_Quality_Clu_247 ARS_RDI_Range_Clu_247 ARS_RDI_ElevationAng_Clu_240 ARS_RDI_VradRel_Clu_247 ARS_RDI_RCS_Clu_247 ARS_RDI_AzimuthAng_Clu_247 ARS_RDI_ElevationAng_Clu_247 ARS_RDI_SNR_Clu_247 ARS_RDI_MsgCounter_Clu_240_247 ARS_RDI_CRC16_Checksum_Clu_240_2 ARS_RDI_SNR_Clu_240 ARS_RDI_DynProp_Clu_240 ARS_RDI_Quality_Clu_240 ARS_RDI_DynProp_Clu_241 ARS_RDI_Quality_Clu_241 ARS_RDI_Range_Clu_241 ARS_RDI_VradRel_Clu_241 ARS_RDI_RCS_Clu_241 ARS_RDI_AzimuthAng_Clu_241;
SIG_GROUP_ 291 Signal_Group_ARS_RDI_248_255 1 : ARS_RDI_Range_Clu_248 ARS_RDI_ElevationAng_Clu_249 ARS_RDI_SNR_Clu_249 ARS_RDI_Range_Clu_250 ARS_RDI_VradRel_Clu_248 ARS_RDI_VradRel_Clu_250 ARS_RDI_RCS_Clu_250 ARS_RDI_AzimuthAng_Clu_250 ARS_RDI_ElevationAng_Clu_250 ARS_RDI_SNR_Clu_250 ARS_RDI_DynProp_Clu_250 ARS_RDI_Quality_Clu_250 ARS_RDI_DynProp_Clu_251 ARS_RDI_Quality_Clu_251 ARS_RDI_Range_Clu_251 ARS_RDI_VradRel_Clu_251 ARS_RDI_RCS_Clu_251 ARS_RDI_AzimuthAng_Clu_251 ARS_RDI_ElevationAng_Clu_251 ARS_RDI_SNR_Clu_251 ARS_RDI_RCS_Clu_248 ARS_RDI_Range_Clu_252 ARS_RDI_VradRel_Clu_252 ARS_RDI_RCS_Clu_252 ARS_RDI_AzimuthAng_Clu_252 ARS_RDI_ElevationAng_Clu_252 ARS_RDI_SNR_Clu_252 ARS_RDI_DynProp_Clu_252 ARS_RDI_Quality_Clu_252 ARS_RDI_DynProp_Clu_253 ARS_RDI_Quality_Clu_253 ARS_RDI_Range_Clu_253 ARS_RDI_VradRel_Clu_253 ARS_RDI_RCS_Clu_253 ARS_RDI_AzimuthAng_Clu_248 ARS_RDI_AzimuthAng_Clu_253 ARS_RDI_ElevationAng_Clu_253 ARS_RDI_SNR_Clu_253 ARS_RDI_Range_Clu_254 ARS_RDI_VradRel_Clu_254 ARS_RDI_RCS_Clu_254 ARS_RDI_AzimuthAng_Clu_254 ARS_RDI_ElevationAng_Clu_254 ARS_RDI_SNR_Clu_254 ARS_RDI_DynProp_Clu_254 ARS_RDI_Quality_Clu_254 ARS_RDI_DynProp_Clu_255 ARS_RDI_Quality_Clu_255 ARS_RDI_Range_Clu_255 ARS_RDI_ElevationAng_Clu_248 ARS_RDI_VradRel_Clu_255 ARS_RDI_RCS_Clu_255 ARS_RDI_AzimuthAng_Clu_255 ARS_RDI_ElevationAng_Clu_255 ARS_RDI_SNR_Clu_255 ARS_RDI_MsgCounter_Clu_248_255 ARS_RDI_CRC16_Checksum_Clu_248_2 ARS_RDI_SNR_Clu_248 ARS_RDI_DynProp_Clu_248 ARS_RDI_Quality_Clu_248 ARS_RDI_DynProp_Clu_249 ARS_RDI_Quality_Clu_249 ARS_RDI_Range_Clu_249 ARS_RDI_VradRel_Clu_249 ARS_RDI_RCS_Clu_249 ARS_RDI_AzimuthAng_Clu_249;
SIG_GROUP_ 292 Signal_Group_ARS_RDI_256_263 1 : ARS_RDI_Range_Clu_256 ARS_RDI_ElevationAng_Clu_257 ARS_RDI_SNR_Clu_257 ARS_RDI_Range_Clu_258 ARS_RDI_VradRel_Clu_256 ARS_RDI_VradRel_Clu_258 ARS_RDI_RCS_Clu_258 ARS_RDI_AzimuthAng_Clu_258 ARS_RDI_ElevationAng_Clu_258 ARS_RDI_SNR_Clu_258 ARS_RDI_DynProp_Clu_258 ARS_RDI_Quality_Clu_258 ARS_RDI_DynProp_Clu_259 ARS_RDI_Quality_Clu_259 ARS_RDI_Range_Clu_259 ARS_RDI_VradRel_Clu_259 ARS_RDI_RCS_Clu_259 ARS_RDI_AzimuthAng_Clu_259 ARS_RDI_ElevationAng_Clu_259 ARS_RDI_SNR_Clu_259 ARS_RDI_RCS_Clu_256 ARS_RDI_Range_Clu_260 ARS_RDI_VradRel_Clu_260 ARS_RDI_RCS_Clu_260 ARS_RDI_AzimuthAng_Clu_260 ARS_RDI_ElevationAng_Clu_260 ARS_RDI_SNR_Clu_260 ARS_RDI_DynProp_Clu_260 ARS_RDI_Quality_Clu_260 ARS_RDI_DynProp_Clu_261 ARS_RDI_Quality_Clu_261 ARS_RDI_Range_Clu_261 ARS_RDI_VradRel_Clu_261 ARS_RDI_RCS_Clu_261 ARS_RDI_AzimuthAng_Clu_256 ARS_RDI_AzimuthAng_Clu_261 ARS_RDI_ElevationAng_Clu_261 ARS_RDI_SNR_Clu_261 ARS_RDI_Range_Clu_262 ARS_RDI_VradRel_Clu_262 ARS_RDI_RCS_Clu_262 ARS_RDI_AzimuthAng_Clu_262 ARS_RDI_ElevationAng_Clu_262 ARS_RDI_SNR_Clu_262 ARS_RDI_DynProp_Clu_262 ARS_RDI_Quality_Clu_262 ARS_RDI_DynProp_Clu_263 ARS_RDI_Quality_Clu_263 ARS_RDI_Range_Clu_263 ARS_RDI_ElevationAng_Clu_256 ARS_RDI_VradRel_Clu_263 ARS_RDI_RCS_Clu_263 ARS_RDI_AzimuthAng_Clu_263 ARS_RDI_ElevationAng_Clu_263 ARS_RDI_SNR_Clu_263 ARS_RDI_MsgCounter_Clu_256_263 ARS_RDI_CRC16_Checksum_Clu_256_2 ARS_RDI_SNR_Clu_256 ARS_RDI_DynProp_Clu_256 ARS_RDI_Quality_Clu_256 ARS_RDI_DynProp_Clu_257 ARS_RDI_Quality_Clu_257 ARS_RDI_Range_Clu_257 ARS_RDI_VradRel_Clu_257 ARS_RDI_RCS_Clu_257 ARS_RDI_AzimuthAng_Clu_257;
SIG_GROUP_ 293 Signal_Group_ARS_RDI_264_271 1 : ARS_RDI_Range_Clu_264 ARS_RDI_ElevationAng_Clu_265 ARS_RDI_SNR_Clu_265 ARS_RDI_Range_Clu_266 ARS_RDI_VradRel_Clu_264 ARS_RDI_VradRel_Clu_266 ARS_RDI_RCS_Clu_266 ARS_RDI_AzimuthAng_Clu_266 ARS_RDI_ElevationAng_Clu_266 ARS_RDI_SNR_Clu_266 ARS_RDI_DynProp_Clu_266 ARS_RDI_Quality_Clu_266 ARS_RDI_DynProp_Clu_267 ARS_RDI_Quality_Clu_267 ARS_RDI_Range_Clu_267 ARS_RDI_VradRel_Clu_267 ARS_RDI_RCS_Clu_267 ARS_RDI_AzimuthAng_Clu_267 ARS_RDI_ElevationAng_Clu_267 ARS_RDI_SNR_Clu_267 ARS_RDI_RCS_Clu_264 ARS_RDI_Range_Clu_268 ARS_RDI_VradRel_Clu_268 ARS_RDI_RCS_Clu_268 ARS_RDI_AzimuthAng_Clu_268 ARS_RDI_ElevationAng_Clu_268 ARS_RDI_SNR_Clu_268 ARS_RDI_DynProp_Clu_268 ARS_RDI_Quality_Clu_268 ARS_RDI_DynProp_Clu_269 ARS_RDI_Quality_Clu_269 ARS_RDI_Range_Clu_269 ARS_RDI_VradRel_Clu_269 ARS_RDI_RCS_Clu_269 ARS_RDI_AzimuthAng_Clu_264 ARS_RDI_AzimuthAng_Clu_269 ARS_RDI_ElevationAng_Clu_269 ARS_RDI_SNR_Clu_269 ARS_RDI_Range_Clu_270 ARS_RDI_VradRel_Clu_270 ARS_RDI_RCS_Clu_270 ARS_RDI_AzimuthAng_Clu_270 ARS_RDI_ElevationAng_Clu_270 ARS_RDI_SNR_Clu_270 ARS_RDI_DynProp_Clu_270 ARS_RDI_Quality_Clu_270 ARS_RDI_DynProp_Clu_271 ARS_RDI_Quality_Clu_271 ARS_RDI_Range_Clu_271 ARS_RDI_ElevationAng_Clu_264 ARS_RDI_VradRel_Clu_271 ARS_RDI_RCS_Clu_271 ARS_RDI_AzimuthAng_Clu_271 ARS_RDI_ElevationAng_Clu_271 ARS_RDI_SNR_Clu_271 ARS_RDI_MsgCounter_Clu_264_271 ARS_RDI_CRC16_Checksum_Clu_264_2 ARS_RDI_SNR_Clu_264 ARS_RDI_DynProp_Clu_264 ARS_RDI_Quality_Clu_264 ARS_RDI_DynProp_Clu_265 ARS_RDI_Quality_Clu_265 ARS_RDI_Range_Clu_265 ARS_RDI_VradRel_Clu_265 ARS_RDI_RCS_Clu_265 ARS_RDI_AzimuthAng_Clu_265;
SIG_GROUP_ 294 Signal_Group_ARS_RDI_272_279 1 : ARS_RDI_Range_Clu_272 ARS_RDI_ElevationAng_Clu_273 ARS_RDI_SNR_Clu_273 ARS_RDI_Range_Clu_274 ARS_RDI_VradRel_Clu_272 ARS_RDI_VradRel_Clu_274 ARS_RDI_RCS_Clu_274 ARS_RDI_AzimuthAng_Clu_274 ARS_RDI_ElevationAng_Clu_274 ARS_RDI_SNR_Clu_274 ARS_RDI_DynProp_Clu_274 ARS_RDI_Quality_Clu_274 ARS_RDI_DynProp_Clu_275 ARS_RDI_Quality_Clu_275 ARS_RDI_Range_Clu_275 ARS_RDI_VradRel_Clu_275 ARS_RDI_RCS_Clu_275 ARS_RDI_AzimuthAng_Clu_275 ARS_RDI_ElevationAng_Clu_275 ARS_RDI_SNR_Clu_275 ARS_RDI_RCS_Clu_272 ARS_RDI_Range_Clu_276 ARS_RDI_VradRel_Clu_276 ARS_RDI_RCS_Clu_276 ARS_RDI_AzimuthAng_Clu_276 ARS_RDI_ElevationAng_Clu_276 ARS_RDI_SNR_Clu_276 ARS_RDI_DynProp_Clu_276 ARS_RDI_Quality_Clu_276 ARS_RDI_DynProp_Clu_277 ARS_RDI_Quality_Clu_277 ARS_RDI_Range_Clu_277 ARS_RDI_VradRel_Clu_277 ARS_RDI_RCS_Clu_277 ARS_RDI_AzimuthAng_Clu_272 ARS_RDI_AzimuthAng_Clu_277 ARS_RDI_ElevationAng_Clu_277 ARS_RDI_SNR_Clu_277 ARS_RDI_Range_Clu_278 ARS_RDI_VradRel_Clu_278 ARS_RDI_RCS_Clu_278 ARS_RDI_AzimuthAng_Clu_278 ARS_RDI_ElevationAng_Clu_278 ARS_RDI_SNR_Clu_278 ARS_RDI_DynProp_Clu_278 ARS_RDI_Quality_Clu_278 ARS_RDI_DynProp_Clu_279 ARS_RDI_Quality_Clu_279 ARS_RDI_Range_Clu_279 ARS_RDI_ElevationAng_Clu_272 ARS_RDI_VradRel_Clu_279 ARS_RDI_RCS_Clu_279 ARS_RDI_AzimuthAng_Clu_279 ARS_RDI_ElevationAng_Clu_279 ARS_RDI_SNR_Clu_279 ARS_RDI_MsgCounter_Clu_272_279 ARS_RDI_CRC16_Checksum_Clu_272_2 ARS_RDI_SNR_Clu_272 ARS_RDI_DynProp_Clu_272 ARS_RDI_Quality_Clu_272 ARS_RDI_DynProp_Clu_273 ARS_RDI_Quality_Clu_273 ARS_RDI_Range_Clu_273 ARS_RDI_VradRel_Clu_273 ARS_RDI_RCS_Clu_273 ARS_RDI_AzimuthAng_Clu_273;
SIG_GROUP_ 295 Signal_Group_ARS_RDI_280_287 1 : ARS_RDI_Range_Clu_280 ARS_RDI_ElevationAng_Clu_281 ARS_RDI_SNR_Clu_281 ARS_RDI_Range_Clu_282 ARS_RDI_VradRel_Clu_280 ARS_RDI_VradRel_Clu_282 ARS_RDI_RCS_Clu_282 ARS_RDI_AzimuthAng_Clu_282 ARS_RDI_ElevationAng_Clu_282 ARS_RDI_SNR_Clu_282 ARS_RDI_DynProp_Clu_282 ARS_RDI_Quality_Clu_282 ARS_RDI_DynProp_Clu_283 ARS_RDI_Quality_Clu_283 ARS_RDI_Range_Clu_283 ARS_RDI_VradRel_Clu_283 ARS_RDI_RCS_Clu_283 ARS_RDI_AzimuthAng_Clu_283 ARS_RDI_ElevationAng_Clu_283 ARS_RDI_SNR_Clu_283 ARS_RDI_RCS_Clu_280 ARS_RDI_Range_Clu_284 ARS_RDI_VradRel_Clu_284 ARS_RDI_RCS_Clu_284 ARS_RDI_AzimuthAng_Clu_284 ARS_RDI_ElevationAng_Clu_284 ARS_RDI_SNR_Clu_284 ARS_RDI_DynProp_Clu_284 ARS_RDI_Quality_Clu_284 ARS_RDI_DynProp_Clu_285 ARS_RDI_Quality_Clu_285 ARS_RDI_Range_Clu_285 ARS_RDI_VradRel_Clu_285 ARS_RDI_RCS_Clu_285 ARS_RDI_AzimuthAng_Clu_280 ARS_RDI_AzimuthAng_Clu_285 ARS_RDI_ElevationAng_Clu_285 ARS_RDI_SNR_Clu_285 ARS_RDI_Range_Clu_286 ARS_RDI_VradRel_Clu_286 ARS_RDI_RCS_Clu_286 ARS_RDI_AzimuthAng_Clu_286 ARS_RDI_ElevationAng_Clu_286 ARS_RDI_SNR_Clu_286 ARS_RDI_DynProp_Clu_286 ARS_RDI_Quality_Clu_286 ARS_RDI_DynProp_Clu_287 ARS_RDI_Quality_Clu_287 ARS_RDI_Range_Clu_287 ARS_RDI_ElevationAng_Clu_280 ARS_RDI_VradRel_Clu_287 ARS_RDI_RCS_Clu_287 ARS_RDI_AzimuthAng_Clu_287 ARS_RDI_ElevationAng_Clu_287 ARS_RDI_SNR_Clu_287 ARS_RDI_MsgCounter_Clu_280_287 ARS_RDI_CRC16_Checksum_Clu_280_2 ARS_RDI_SNR_Clu_280 ARS_RDI_DynProp_Clu_280 ARS_RDI_Quality_Clu_280 ARS_RDI_DynProp_Clu_281 ARS_RDI_Quality_Clu_281 ARS_RDI_Range_Clu_281 ARS_RDI_VradRel_Clu_281 ARS_RDI_RCS_Clu_281 ARS_RDI_AzimuthAng_Clu_281;
SIG_GROUP_ 296 Signal_Group_ARS_RDI_288_295 1 : ARS_RDI_Range_Clu_288 ARS_RDI_ElevationAng_Clu_289 ARS_RDI_SNR_Clu_289 ARS_RDI_Range_Clu_290 ARS_RDI_VradRel_Clu_288 ARS_RDI_VradRel_Clu_290 ARS_RDI_RCS_Clu_290 ARS_RDI_AzimuthAng_Clu_290 ARS_RDI_ElevationAng_Clu_290 ARS_RDI_SNR_Clu_290 ARS_RDI_DynProp_Clu_290 ARS_RDI_Quality_Clu_290 ARS_RDI_DynProp_Clu_291 ARS_RDI_Quality_Clu_291 ARS_RDI_Range_Clu_291 ARS_RDI_VradRel_Clu_291 ARS_RDI_RCS_Clu_291 ARS_RDI_AzimuthAng_Clu_291 ARS_RDI_ElevationAng_Clu_291 ARS_RDI_SNR_Clu_291 ARS_RDI_RCS_Clu_288 ARS_RDI_Range_Clu_292 ARS_RDI_VradRel_Clu_292 ARS_RDI_RCS_Clu_292 ARS_RDI_AzimuthAng_Clu_292 ARS_RDI_ElevationAng_Clu_292 ARS_RDI_SNR_Clu_292 ARS_RDI_DynProp_Clu_292 ARS_RDI_Quality_Clu_292 ARS_RDI_DynProp_Clu_293 ARS_RDI_Quality_Clu_293 ARS_RDI_Range_Clu_293 ARS_RDI_VradRel_Clu_293 ARS_RDI_RCS_Clu_293 ARS_RDI_AzimuthAng_Clu_288 ARS_RDI_AzimuthAng_Clu_293 ARS_RDI_ElevationAng_Clu_293 ARS_RDI_SNR_Clu_293 ARS_RDI_Range_Clu_294 ARS_RDI_VradRel_Clu_294 ARS_RDI_RCS_Clu_294 ARS_RDI_AzimuthAng_Clu_294 ARS_RDI_ElevationAng_Clu_294 ARS_RDI_SNR_Clu_294 ARS_RDI_DynProp_Clu_294 ARS_RDI_Quality_Clu_294 ARS_RDI_DynProp_Clu_295 ARS_RDI_Quality_Clu_295 ARS_RDI_Range_Clu_295 ARS_RDI_ElevationAng_Clu_288 ARS_RDI_VradRel_Clu_295 ARS_RDI_RCS_Clu_295 ARS_RDI_AzimuthAng_Clu_295 ARS_RDI_ElevationAng_Clu_295 ARS_RDI_SNR_Clu_295 ARS_RDI_MsgCounter_Clu_288_295 ARS_RDI_CRC16_Checksum_Clu_288_2 ARS_RDI_SNR_Clu_288 ARS_RDI_DynProp_Clu_288 ARS_RDI_Quality_Clu_288 ARS_RDI_DynProp_Clu_289 ARS_RDI_Quality_Clu_289 ARS_RDI_Range_Clu_289 ARS_RDI_VradRel_Clu_289 ARS_RDI_RCS_Clu_289 ARS_RDI_AzimuthAng_Clu_289;
SIG_GROUP_ 297 Signal_Group_ARS_RDI_296_303 1 : ARS_RDI_Range_Clu_296 ARS_RDI_ElevationAng_Clu_297 ARS_RDI_SNR_Clu_297 ARS_RDI_Range_Clu_298 ARS_RDI_VradRel_Clu_296 ARS_RDI_VradRel_Clu_298 ARS_RDI_RCS_Clu_298 ARS_RDI_AzimuthAng_Clu_298 ARS_RDI_ElevationAng_Clu_298 ARS_RDI_SNR_Clu_298 ARS_RDI_DynProp_Clu_298 ARS_RDI_Quality_Clu_298 ARS_RDI_DynProp_Clu_299 ARS_RDI_Quality_Clu_299 ARS_RDI_Range_Clu_299 ARS_RDI_VradRel_Clu_299 ARS_RDI_RCS_Clu_299 ARS_RDI_AzimuthAng_Clu_299 ARS_RDI_ElevationAng_Clu_299 ARS_RDI_SNR_Clu_299 ARS_RDI_RCS_Clu_296 ARS_RDI_Range_Clu_300 ARS_RDI_VradRel_Clu_300 ARS_RDI_RCS_Clu_300 ARS_RDI_AzimuthAng_Clu_300 ARS_RDI_ElevationAng_Clu_300 ARS_RDI_SNR_Clu_300 ARS_RDI_DynProp_Clu_300 ARS_RDI_Quality_Clu_300 ARS_RDI_DynProp_Clu_301 ARS_RDI_Quality_Clu_301 ARS_RDI_Range_Clu_301 ARS_RDI_VradRel_Clu_301 ARS_RDI_RCS_Clu_301 ARS_RDI_AzimuthAng_Clu_296 ARS_RDI_AzimuthAng_Clu_301 ARS_RDI_ElevationAng_Clu_301 ARS_RDI_SNR_Clu_301 ARS_RDI_Range_Clu_302 ARS_RDI_VradRel_Clu_302 ARS_RDI_RCS_Clu_302 ARS_RDI_AzimuthAng_Clu_302 ARS_RDI_ElevationAng_Clu_302 ARS_RDI_SNR_Clu_302 ARS_RDI_DynProp_Clu_302 ARS_RDI_Quality_Clu_302 ARS_RDI_DynProp_Clu_303 ARS_RDI_Quality_Clu_303 ARS_RDI_Range_Clu_303 ARS_RDI_ElevationAng_Clu_296 ARS_RDI_VradRel_Clu_303 ARS_RDI_RCS_Clu_303 ARS_RDI_AzimuthAng_Clu_303 ARS_RDI_ElevationAng_Clu_303 ARS_RDI_SNR_Clu_303 ARS_RDI_MsgCounter_Clu_296_303 ARS_RDI_CRC16_Checksum_Clu_296_3 ARS_RDI_SNR_Clu_296 ARS_RDI_DynProp_Clu_296 ARS_RDI_Quality_Clu_296 ARS_RDI_DynProp_Clu_297 ARS_RDI_Quality_Clu_297 ARS_RDI_Range_Clu_297 ARS_RDI_VradRel_Clu_297 ARS_RDI_RCS_Clu_297 ARS_RDI_AzimuthAng_Clu_297;
SIG_GROUP_ 298 Signal_Group_ARS_RDI_304_311 1 : ARS_RDI_Range_Clu_304 ARS_RDI_ElevationAng_Clu_305 ARS_RDI_SNR_Clu_305 ARS_RDI_Range_Clu_306 ARS_RDI_VradRel_Clu_304 ARS_RDI_VradRel_Clu_306 ARS_RDI_RCS_Clu_306 ARS_RDI_AzimuthAng_Clu_306 ARS_RDI_ElevationAng_Clu_306 ARS_RDI_SNR_Clu_306 ARS_RDI_DynProp_Clu_306 ARS_RDI_Quality_Clu_306 ARS_RDI_DynProp_Clu_307 ARS_RDI_Quality_Clu_307 ARS_RDI_Range_Clu_307 ARS_RDI_VradRel_Clu_307 ARS_RDI_RCS_Clu_307 ARS_RDI_AzimuthAng_Clu_307 ARS_RDI_ElevationAng_Clu_307 ARS_RDI_SNR_Clu_307 ARS_RDI_RCS_Clu_304 ARS_RDI_Range_Clu_308 ARS_RDI_VradRel_Clu_308 ARS_RDI_RCS_Clu_308 ARS_RDI_AzimuthAng_Clu_308 ARS_RDI_ElevationAng_Clu_308 ARS_RDI_SNR_Clu_308 ARS_RDI_DynProp_Clu_308 ARS_RDI_Quality_Clu_308 ARS_RDI_DynProp_Clu_309 ARS_RDI_Quality_Clu_309 ARS_RDI_Range_Clu_309 ARS_RDI_VradRel_Clu_309 ARS_RDI_RCS_Clu_309 ARS_RDI_AzimuthAng_Clu_304 ARS_RDI_AzimuthAng_Clu_309 ARS_RDI_ElevationAng_Clu_309 ARS_RDI_SNR_Clu_309 ARS_RDI_Range_Clu_310 ARS_RDI_VradRel_Clu_310 ARS_RDI_RCS_Clu_310 ARS_RDI_AzimuthAng_Clu_310 ARS_RDI_ElevationAng_Clu_310 ARS_RDI_SNR_Clu_310 ARS_RDI_DynProp_Clu_310 ARS_RDI_Quality_Clu_310 ARS_RDI_DynProp_Clu_311 ARS_RDI_Quality_Clu_311 ARS_RDI_Range_Clu_311 ARS_RDI_ElevationAng_Clu_304 ARS_RDI_VradRel_Clu_311 ARS_RDI_RCS_Clu_311 ARS_RDI_AzimuthAng_Clu_311 ARS_RDI_ElevationAng_Clu_311 ARS_RDI_SNR_Clu_311 ARS_RDI_MsgCounter_Clu_304_311 ARS_RDI_CRC16_Checksum_Clu_304_3 ARS_RDI_SNR_Clu_304 ARS_RDI_DynProp_Clu_304 ARS_RDI_Quality_Clu_304 ARS_RDI_DynProp_Clu_305 ARS_RDI_Quality_Clu_305 ARS_RDI_Range_Clu_305 ARS_RDI_VradRel_Clu_305 ARS_RDI_RCS_Clu_305 ARS_RDI_AzimuthAng_Clu_305;
SIG_GROUP_ 299 Signal_Group_ARS_RDI_312_319 1 : ARS_RDI_Range_Clu_312 ARS_RDI_ElevationAng_Clu_313 ARS_RDI_SNR_Clu_313 ARS_RDI_Range_Clu_314 ARS_RDI_VradRel_Clu_312 ARS_RDI_VradRel_Clu_314 ARS_RDI_RCS_Clu_314 ARS_RDI_AzimuthAng_Clu_314 ARS_RDI_ElevationAng_Clu_314 ARS_RDI_SNR_Clu_314 ARS_RDI_DynProp_Clu_314 ARS_RDI_Quality_Clu_314 ARS_RDI_DynProp_Clu_315 ARS_RDI_Quality_Clu_315 ARS_RDI_Range_Clu_315 ARS_RDI_VradRel_Clu_315 ARS_RDI_RCS_Clu_315 ARS_RDI_AzimuthAng_Clu_315 ARS_RDI_ElevationAng_Clu_315 ARS_RDI_SNR_Clu_315 ARS_RDI_RCS_Clu_312 ARS_RDI_Range_Clu_316 ARS_RDI_VradRel_Clu_316 ARS_RDI_RCS_Clu_316 ARS_RDI_AzimuthAng_Clu_316 ARS_RDI_ElevationAng_Clu_316 ARS_RDI_SNR_Clu_316 ARS_RDI_DynProp_Clu_316 ARS_RDI_Quality_Clu_316 ARS_RDI_DynProp_Clu_317 ARS_RDI_Quality_Clu_317 ARS_RDI_Range_Clu_317 ARS_RDI_VradRel_Clu_317 ARS_RDI_RCS_Clu_317 ARS_RDI_AzimuthAng_Clu_312 ARS_RDI_AzimuthAng_Clu_317 ARS_RDI_ElevationAng_Clu_317 ARS_RDI_SNR_Clu_317 ARS_RDI_Range_Clu_318 ARS_RDI_VradRel_Clu_318 ARS_RDI_RCS_Clu_318 ARS_RDI_AzimuthAng_Clu_318 ARS_RDI_ElevationAng_Clu_318 ARS_RDI_SNR_Clu_318 ARS_RDI_DynProp_Clu_318 ARS_RDI_Quality_Clu_318 ARS_RDI_DynProp_Clu_319 ARS_RDI_Quality_Clu_319 ARS_RDI_Range_Clu_319 ARS_RDI_ElevationAng_Clu_312 ARS_RDI_VradRel_Clu_319 ARS_RDI_RCS_Clu_319 ARS_RDI_AzimuthAng_Clu_319 ARS_RDI_ElevationAng_Clu_319 ARS_RDI_SNR_Clu_319 ARS_RDI_MsgCounter_Clu_312_319 ARS_RDI_CRC16_Checksum_Clu_312_3 ARS_RDI_SNR_Clu_312 ARS_RDI_DynProp_Clu_312 ARS_RDI_Quality_Clu_312 ARS_RDI_DynProp_Clu_313 ARS_RDI_Quality_Clu_313 ARS_RDI_Range_Clu_313 ARS_RDI_VradRel_Clu_313 ARS_RDI_RCS_Clu_313 ARS_RDI_AzimuthAng_Clu_313;
SIG_GROUP_ 300 Signal_Group_ARS_RDI_320_327 1 : ARS_RDI_Range_Clu_320 ARS_RDI_ElevationAng_Clu_321 ARS_RDI_SNR_Clu_321 ARS_RDI_Range_Clu_322 ARS_RDI_VradRel_Clu_320 ARS_RDI_VradRel_Clu_322 ARS_RDI_RCS_Clu_322 ARS_RDI_AzimuthAng_Clu_322 ARS_RDI_ElevationAng_Clu_322 ARS_RDI_SNR_Clu_322 ARS_RDI_DynProp_Clu_322 ARS_RDI_Quality_Clu_322 ARS_RDI_DynProp_Clu_323 ARS_RDI_Quality_Clu_323 ARS_RDI_Range_Clu_323 ARS_RDI_VradRel_Clu_323 ARS_RDI_RCS_Clu_323 ARS_RDI_AzimuthAng_Clu_323 ARS_RDI_ElevationAng_Clu_323 ARS_RDI_SNR_Clu_323 ARS_RDI_RCS_Clu_320 ARS_RDI_Range_Clu_324 ARS_RDI_VradRel_Clu_324 ARS_RDI_RCS_Clu_324 ARS_RDI_AzimuthAng_Clu_324 ARS_RDI_ElevationAng_Clu_324 ARS_RDI_SNR_Clu_324 ARS_RDI_DynProp_Clu_324 ARS_RDI_Quality_Clu_324 ARS_RDI_DynProp_Clu_325 ARS_RDI_Quality_Clu_325 ARS_RDI_Range_Clu_325 ARS_RDI_VradRel_Clu_325 ARS_RDI_RCS_Clu_325 ARS_RDI_AzimuthAng_Clu_320 ARS_RDI_AzimuthAng_Clu_325 ARS_RDI_ElevationAng_Clu_325 ARS_RDI_SNR_Clu_325 ARS_RDI_Range_Clu_326 ARS_RDI_VradRel_Clu_326 ARS_RDI_RCS_Clu_326 ARS_RDI_AzimuthAng_Clu_326 ARS_RDI_ElevationAng_Clu_326 ARS_RDI_SNR_Clu_326 ARS_RDI_DynProp_Clu_326 ARS_RDI_Quality_Clu_326 ARS_RDI_DynProp_Clu_327 ARS_RDI_Quality_Clu_327 ARS_RDI_Range_Clu_327 ARS_RDI_ElevationAng_Clu_320 ARS_RDI_VradRel_Clu_327 ARS_RDI_RCS_Clu_327 ARS_RDI_AzimuthAng_Clu_327 ARS_RDI_ElevationAng_Clu_327 ARS_RDI_SNR_Clu_327 ARS_RDI_MsgCounter_Clu_320_327 ARS_RDI_CRC16_Checksum_Clu_320_3 ARS_RDI_SNR_Clu_320 ARS_RDI_DynProp_Clu_320 ARS_RDI_Quality_Clu_320 ARS_RDI_DynProp_Clu_321 ARS_RDI_Quality_Clu_321 ARS_RDI_Range_Clu_321 ARS_RDI_VradRel_Clu_321 ARS_RDI_RCS_Clu_321 ARS_RDI_AzimuthAng_Clu_321;
SIG_GROUP_ 301 Signal_Group_ARS_RDI_328_335 1 : ARS_RDI_Range_Clu_328 ARS_RDI_ElevationAng_Clu_329 ARS_RDI_SNR_Clu_329 ARS_RDI_Range_Clu_330 ARS_RDI_VradRel_Clu_328 ARS_RDI_VradRel_Clu_330 ARS_RDI_RCS_Clu_330 ARS_RDI_AzimuthAng_Clu_330 ARS_RDI_ElevationAng_Clu_330 ARS_RDI_SNR_Clu_330 ARS_RDI_DynProp_Clu_330 ARS_RDI_Quality_Clu_330 ARS_RDI_DynProp_Clu_331 ARS_RDI_Quality_Clu_331 ARS_RDI_Range_Clu_331 ARS_RDI_VradRel_Clu_331 ARS_RDI_RCS_Clu_331 ARS_RDI_AzimuthAng_Clu_331 ARS_RDI_ElevationAng_Clu_331 ARS_RDI_SNR_Clu_331 ARS_RDI_RCS_Clu_328 ARS_RDI_Range_Clu_332 ARS_RDI_VradRel_Clu_332 ARS_RDI_RCS_Clu_332 ARS_RDI_AzimuthAng_Clu_332 ARS_RDI_ElevationAng_Clu_332 ARS_RDI_SNR_Clu_332 ARS_RDI_DynProp_Clu_332 ARS_RDI_Quality_Clu_332 ARS_RDI_DynProp_Clu_333 ARS_RDI_Quality_Clu_333 ARS_RDI_Range_Clu_333 ARS_RDI_VradRel_Clu_333 ARS_RDI_RCS_Clu_333 ARS_RDI_AzimuthAng_Clu_328 ARS_RDI_AzimuthAng_Clu_333 ARS_RDI_ElevationAng_Clu_333 ARS_RDI_SNR_Clu_333 ARS_RDI_Range_Clu_334 ARS_RDI_VradRel_Clu_334 ARS_RDI_RCS_Clu_334 ARS_RDI_AzimuthAng_Clu_334 ARS_RDI_ElevationAng_Clu_334 ARS_RDI_SNR_Clu_334 ARS_RDI_DynProp_Clu_334 ARS_RDI_Quality_Clu_334 ARS_RDI_DynProp_Clu_335 ARS_RDI_Quality_Clu_335 ARS_RDI_Range_Clu_335 ARS_RDI_ElevationAng_Clu_328 ARS_RDI_VradRel_Clu_335 ARS_RDI_RCS_Clu_335 ARS_RDI_AzimuthAng_Clu_335 ARS_RDI_ElevationAng_Clu_335 ARS_RDI_SNR_Clu_335 ARS_RDI_MsgCounter_Clu_328_335 ARS_RDI_CRC16_Checksum_Clu_328_3 ARS_RDI_SNR_Clu_328 ARS_RDI_DynProp_Clu_328 ARS_RDI_Quality_Clu_328 ARS_RDI_DynProp_Clu_329 ARS_RDI_Quality_Clu_329 ARS_RDI_Range_Clu_329 ARS_RDI_VradRel_Clu_329 ARS_RDI_RCS_Clu_329 ARS_RDI_AzimuthAng_Clu_329;
SIG_GROUP_ 302 Signal_Group_ARS_RDI_336_343 1 : ARS_RDI_Range_Clu_336 ARS_RDI_ElevationAng_Clu_337 ARS_RDI_SNR_Clu_337 ARS_RDI_Range_Clu_338 ARS_RDI_VradRel_Clu_336 ARS_RDI_VradRel_Clu_338 ARS_RDI_RCS_Clu_338 ARS_RDI_AzimuthAng_Clu_338 ARS_RDI_ElevationAng_Clu_338 ARS_RDI_SNR_Clu_338 ARS_RDI_DynProp_Clu_338 ARS_RDI_Quality_Clu_338 ARS_RDI_DynProp_Clu_339 ARS_RDI_Quality_Clu_339 ARS_RDI_Range_Clu_339 ARS_RDI_VradRel_Clu_339 ARS_RDI_RCS_Clu_339 ARS_RDI_AzimuthAng_Clu_339 ARS_RDI_ElevationAng_Clu_339 ARS_RDI_SNR_Clu_339 ARS_RDI_RCS_Clu_336 ARS_RDI_Range_Clu_340 ARS_RDI_VradRel_Clu_340 ARS_RDI_RCS_Clu_340 ARS_RDI_AzimuthAng_Clu_340 ARS_RDI_ElevationAng_Clu_340 ARS_RDI_SNR_Clu_340 ARS_RDI_DynProp_Clu_340 ARS_RDI_Quality_Clu_340 ARS_RDI_DynProp_Clu_341 ARS_RDI_Quality_Clu_341 ARS_RDI_Range_Clu_341 ARS_RDI_VradRel_Clu_341 ARS_RDI_RCS_Clu_341 ARS_RDI_AzimuthAng_Clu_336 ARS_RDI_AzimuthAng_Clu_341 ARS_RDI_ElevationAng_Clu_341 ARS_RDI_SNR_Clu_341 ARS_RDI_Range_Clu_342 ARS_RDI_VradRel_Clu_342 ARS_RDI_RCS_Clu_342 ARS_RDI_AzimuthAng_Clu_342 ARS_RDI_ElevationAng_Clu_342 ARS_RDI_SNR_Clu_342 ARS_RDI_DynProp_Clu_342 ARS_RDI_Quality_Clu_342 ARS_RDI_DynProp_Clu_343 ARS_RDI_Quality_Clu_343 ARS_RDI_Range_Clu_343 ARS_RDI_ElevationAng_Clu_336 ARS_RDI_VradRel_Clu_343 ARS_RDI_RCS_Clu_343 ARS_RDI_AzimuthAng_Clu_343 ARS_RDI_ElevationAng_Clu_343 ARS_RDI_SNR_Clu_343 ARS_RDI_MsgCounter_Clu_336_343 ARS_RDI_CRC16_Checksum_Clu_336_3 ARS_RDI_SNR_Clu_336 ARS_RDI_DynProp_Clu_336 ARS_RDI_Quality_Clu_336 ARS_RDI_DynProp_Clu_337 ARS_RDI_Quality_Clu_337 ARS_RDI_Range_Clu_337 ARS_RDI_VradRel_Clu_337 ARS_RDI_RCS_Clu_337 ARS_RDI_AzimuthAng_Clu_337;
SIG_GROUP_ 303 Signal_Group_ARS_RDI_344_351 1 : ARS_RDI_Range_Clu_344 ARS_RDI_ElevationAng_Clu_345 ARS_RDI_SNR_Clu_345 ARS_RDI_Range_Clu_346 ARS_RDI_VradRel_Clu_344 ARS_RDI_VradRel_Clu_346 ARS_RDI_RCS_Clu_346 ARS_RDI_AzimuthAng_Clu_346 ARS_RDI_ElevationAng_Clu_346 ARS_RDI_SNR_Clu_346 ARS_RDI_DynProp_Clu_346 ARS_RDI_Quality_Clu_346 ARS_RDI_DynProp_Clu_347 ARS_RDI_Quality_Clu_347 ARS_RDI_Range_Clu_347 ARS_RDI_VradRel_Clu_347 ARS_RDI_RCS_Clu_347 ARS_RDI_AzimuthAng_Clu_347 ARS_RDI_ElevationAng_Clu_347 ARS_RDI_SNR_Clu_347 ARS_RDI_RCS_Clu_344 ARS_RDI_Range_Clu_348 ARS_RDI_VradRel_Clu_348 ARS_RDI_RCS_Clu_348 ARS_RDI_AzimuthAng_Clu_348 ARS_RDI_ElevationAng_Clu_348 ARS_RDI_SNR_Clu_348 ARS_RDI_DynProp_Clu_348 ARS_RDI_Quality_Clu_348 ARS_RDI_DynProp_Clu_349 ARS_RDI_Quality_Clu_349 ARS_RDI_Range_Clu_349 ARS_RDI_VradRel_Clu_349 ARS_RDI_RCS_Clu_349 ARS_RDI_AzimuthAng_Clu_344 ARS_RDI_AzimuthAng_Clu_349 ARS_RDI_ElevationAng_Clu_349 ARS_RDI_SNR_Clu_349 ARS_RDI_Range_Clu_350 ARS_RDI_VradRel_Clu_350 ARS_RDI_RCS_Clu_350 ARS_RDI_AzimuthAng_Clu_350 ARS_RDI_ElevationAng_Clu_350 ARS_RDI_SNR_Clu_350 ARS_RDI_DynProp_Clu_350 ARS_RDI_Quality_Clu_350 ARS_RDI_DynProp_Clu_351 ARS_RDI_Quality_Clu_351 ARS_RDI_Range_Clu_351 ARS_RDI_ElevationAng_Clu_344 ARS_RDI_VradRel_Clu_351 ARS_RDI_RCS_Clu_351 ARS_RDI_AzimuthAng_Clu_351 ARS_RDI_ElevationAng_Clu_351 ARS_RDI_SNR_Clu_351 ARS_RDI_MsgCounter_Clu_344_351 ARS_RDI_CRC16_Checksum_Clu_344_3 ARS_RDI_SNR_Clu_344 ARS_RDI_DynProp_Clu_344 ARS_RDI_Quality_Clu_344 ARS_RDI_DynProp_Clu_345 ARS_RDI_Quality_Clu_345 ARS_RDI_Range_Clu_345 ARS_RDI_VradRel_Clu_345 ARS_RDI_RCS_Clu_345 ARS_RDI_AzimuthAng_Clu_345;
SIG_GROUP_ 304 Signal_Group_ARS_RDI_352_359 1 : ARS_RDI_Range_Clu_352 ARS_RDI_ElevationAng_Clu_353 ARS_RDI_SNR_Clu_353 ARS_RDI_Range_Clu_354 ARS_RDI_VradRel_Clu_352 ARS_RDI_VradRel_Clu_354 ARS_RDI_RCS_Clu_354 ARS_RDI_AzimuthAng_Clu_354 ARS_RDI_ElevationAng_Clu_354 ARS_RDI_SNR_Clu_354 ARS_RDI_DynProp_Clu_354 ARS_RDI_Quality_Clu_354 ARS_RDI_DynProp_Clu_355 ARS_RDI_Quality_Clu_355 ARS_RDI_Range_Clu_355 ARS_RDI_VradRel_Clu_355 ARS_RDI_RCS_Clu_355 ARS_RDI_AzimuthAng_Clu_355 ARS_RDI_ElevationAng_Clu_355 ARS_RDI_SNR_Clu_355 ARS_RDI_RCS_Clu_352 ARS_RDI_Range_Clu_356 ARS_RDI_VradRel_Clu_356 ARS_RDI_RCS_Clu_356 ARS_RDI_AzimuthAng_Clu_356 ARS_RDI_ElevationAng_Clu_356 ARS_RDI_SNR_Clu_356 ARS_RDI_DynProp_Clu_356 ARS_RDI_Quality_Clu_356 ARS_RDI_DynProp_Clu_357 ARS_RDI_Quality_Clu_357 ARS_RDI_Range_Clu_357 ARS_RDI_VradRel_Clu_357 ARS_RDI_RCS_Clu_357 ARS_RDI_AzimuthAng_Clu_352 ARS_RDI_AzimuthAng_Clu_357 ARS_RDI_ElevationAng_Clu_357 ARS_RDI_SNR_Clu_357 ARS_RDI_Range_Clu_358 ARS_RDI_VradRel_Clu_358 ARS_RDI_RCS_Clu_358 ARS_RDI_AzimuthAng_Clu_358 ARS_RDI_ElevationAng_Clu_358 ARS_RDI_SNR_Clu_358 ARS_RDI_DynProp_Clu_358 ARS_RDI_Quality_Clu_358 ARS_RDI_DynProp_Clu_359 ARS_RDI_Quality_Clu_359 ARS_RDI_Range_Clu_359 ARS_RDI_ElevationAng_Clu_352 ARS_RDI_VradRel_Clu_359 ARS_RDI_RCS_Clu_359 ARS_RDI_AzimuthAng_Clu_359 ARS_RDI_ElevationAng_Clu_359 ARS_RDI_SNR_Clu_359 ARS_RDI_MsgCounter_Clu_352_359 ARS_RDI_CRC16_Checksum_Clu_352_3 ARS_RDI_SNR_Clu_352 ARS_RDI_DynProp_Clu_352 ARS_RDI_Quality_Clu_352 ARS_RDI_DynProp_Clu_353 ARS_RDI_Quality_Clu_353 ARS_RDI_Range_Clu_353 ARS_RDI_VradRel_Clu_353 ARS_RDI_RCS_Clu_353 ARS_RDI_AzimuthAng_Clu_353;
SIG_GROUP_ 305 Signal_Group_ARS_RDI_360_367 1 : ARS_RDI_Range_Clu_360 ARS_RDI_ElevationAng_Clu_361 ARS_RDI_SNR_Clu_361 ARS_RDI_Range_Clu_362 ARS_RDI_VradRel_Clu_360 ARS_RDI_VradRel_Clu_362 ARS_RDI_RCS_Clu_362 ARS_RDI_AzimuthAng_Clu_362 ARS_RDI_ElevationAng_Clu_362 ARS_RDI_SNR_Clu_362 ARS_RDI_DynProp_Clu_362 ARS_RDI_Quality_Clu_362 ARS_RDI_DynProp_Clu_363 ARS_RDI_Quality_Clu_363 ARS_RDI_Range_Clu_363 ARS_RDI_VradRel_Clu_363 ARS_RDI_RCS_Clu_363 ARS_RDI_AzimuthAng_Clu_363 ARS_RDI_ElevationAng_Clu_363 ARS_RDI_SNR_Clu_363 ARS_RDI_RCS_Clu_360 ARS_RDI_Range_Clu_364 ARS_RDI_VradRel_Clu_364 ARS_RDI_RCS_Clu_364 ARS_RDI_AzimuthAng_Clu_364 ARS_RDI_ElevationAng_Clu_364 ARS_RDI_SNR_Clu_364 ARS_RDI_DynProp_Clu_364 ARS_RDI_Quality_Clu_364 ARS_RDI_DynProp_Clu_365 ARS_RDI_Quality_Clu_365 ARS_RDI_Range_Clu_365 ARS_RDI_VradRel_Clu_365 ARS_RDI_RCS_Clu_365 ARS_RDI_AzimuthAng_Clu_360 ARS_RDI_AzimuthAng_Clu_365 ARS_RDI_ElevationAng_Clu_365 ARS_RDI_SNR_Clu_365 ARS_RDI_Range_Clu_366 ARS_RDI_VradRel_Clu_366 ARS_RDI_RCS_Clu_366 ARS_RDI_AzimuthAng_Clu_366 ARS_RDI_ElevationAng_Clu_366 ARS_RDI_SNR_Clu_366 ARS_RDI_DynProp_Clu_366 ARS_RDI_Quality_Clu_366 ARS_RDI_DynProp_Clu_367 ARS_RDI_Quality_Clu_367 ARS_RDI_Range_Clu_367 ARS_RDI_ElevationAng_Clu_360 ARS_RDI_VradRel_Clu_367 ARS_RDI_RCS_Clu_367 ARS_RDI_AzimuthAng_Clu_367 ARS_RDI_ElevationAng_Clu_367 ARS_RDI_SNR_Clu_367 ARS_RDI_MsgCounter_Clu_360_367 ARS_RDI_CRC16_Checksum_Clu_360_3 ARS_RDI_SNR_Clu_360 ARS_RDI_DynProp_Clu_360 ARS_RDI_Quality_Clu_360 ARS_RDI_DynProp_Clu_361 ARS_RDI_Quality_Clu_361 ARS_RDI_Range_Clu_361 ARS_RDI_VradRel_Clu_361 ARS_RDI_RCS_Clu_361 ARS_RDI_AzimuthAng_Clu_361;
SIG_GROUP_ 306 Signal_Group_ARS_RDI_368_375 1 : ARS_RDI_Range_Clu_368 ARS_RDI_ElevationAng_Clu_369 ARS_RDI_SNR_Clu_369 ARS_RDI_Range_Clu_370 ARS_RDI_VradRel_Clu_368 ARS_RDI_VradRel_Clu_370 ARS_RDI_RCS_Clu_370 ARS_RDI_AzimuthAng_Clu_370 ARS_RDI_ElevationAng_Clu_370 ARS_RDI_SNR_Clu_370 ARS_RDI_DynProp_Clu_370 ARS_RDI_Quality_Clu_370 ARS_RDI_DynProp_Clu_371 ARS_RDI_Quality_Clu_371 ARS_RDI_Range_Clu_371 ARS_RDI_VradRel_Clu_371 ARS_RDI_RCS_Clu_371 ARS_RDI_AzimuthAng_Clu_371 ARS_RDI_ElevationAng_Clu_371 ARS_RDI_SNR_Clu_371 ARS_RDI_RCS_Clu_368 ARS_RDI_Range_Clu_372 ARS_RDI_VradRel_Clu_372 ARS_RDI_RCS_Clu_372 ARS_RDI_AzimuthAng_Clu_372 ARS_RDI_ElevationAng_Clu_372 ARS_RDI_SNR_Clu_372 ARS_RDI_DynProp_Clu_372 ARS_RDI_Quality_Clu_372 ARS_RDI_DynProp_Clu_373 ARS_RDI_Quality_Clu_373 ARS_RDI_Range_Clu_373 ARS_RDI_VradRel_Clu_373 ARS_RDI_RCS_Clu_373 ARS_RDI_AzimuthAng_Clu_368 ARS_RDI_AzimuthAng_Clu_373 ARS_RDI_ElevationAng_Clu_373 ARS_RDI_SNR_Clu_373 ARS_RDI_Range_Clu_374 ARS_RDI_VradRel_Clu_374 ARS_RDI_RCS_Clu_374 ARS_RDI_AzimuthAng_Clu_374 ARS_RDI_ElevationAng_Clu_374 ARS_RDI_SNR_Clu_374 ARS_RDI_DynProp_Clu_374 ARS_RDI_Quality_Clu_374 ARS_RDI_DynProp_Clu_375 ARS_RDI_Quality_Clu_375 ARS_RDI_Range_Clu_375 ARS_RDI_ElevationAng_Clu_368 ARS_RDI_VradRel_Clu_375 ARS_RDI_RCS_Clu_375 ARS_RDI_AzimuthAng_Clu_375 ARS_RDI_ElevationAng_Clu_375 ARS_RDI_SNR_Clu_375 ARS_RDI_MsgCounter_Clu_368_375 ARS_RDI_CRC16_Checksum_Clu_368_3 ARS_RDI_SNR_Clu_368 ARS_RDI_DynProp_Clu_368 ARS_RDI_Quality_Clu_368 ARS_RDI_DynProp_Clu_369 ARS_RDI_Quality_Clu_369 ARS_RDI_Range_Clu_369 ARS_RDI_VradRel_Clu_369 ARS_RDI_RCS_Clu_369 ARS_RDI_AzimuthAng_Clu_369;
