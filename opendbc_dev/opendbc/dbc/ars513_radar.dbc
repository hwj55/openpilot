VERSION "created by canmatrix"

NS_ :

BS_:

BU_: FR GW

BO_ 527 ARS_OD_28_29: 64 FR
 SG_ ARS_OD_DistX_Obj_28 : 7|12@0+ (0.0875,-100.0125) [-100.0125|258.3] "m"  GW
 SG_ ARS_OD_Classification_Obj_28 : 98|3@0+ (1,0) [0|7] ""  GW
 SG_ ARS_OD_AabsYStd_Obj_28 : 111|8@0+ (0.25,0) [0|63.75] "m/s^2"  GW
 SG_ ARS_OD_ClassConf_Obj_28 : 119|7@0+ (1,0) [0|127] "%"  GW
 SG_ ARS_OD_ProbOfExist_Obj_28 : 112|7@0+ (1,0) [0|127] "%"  GW
 SG_ ARS_OD_DynConf_Obj_28 : 121|7@0+ (1,0) [0|127] "%"  GW
 SG_ ARS_OD_VabsX_Obj_28 : 11|11@0+ (0.125,-128) [-128|127.875] "m/s"  GW
 SG_ ARS_OD_DynProp_Obj_28 : 130|3@0+ (1,0) [0|7] ""  GW
 SG_ ARS_OD_MirrorProb_Obj_28 : 143|7@0+ (1,0) [0|127] "%"  GW
 SG_ ARS_OD_Length_Obj_28 : 136|7@0+ (0.2,0) [0|25.4] "m"  GW
 SG_ ARS_OD_MaintenanceState_Obj_28 : 145|2@0+ (1,0) [0|3] ""  GW
 SG_ ARS_OD_Width_Obj_28 : 159|7@0+ (0.2,0) [0|25.4] "m"  GW
 SG_ ARS_OD_RCS_Obj_28 : 152|9@0+ (0.2,-51.2) [-51.2|51] "dBsm"  GW
 SG_ ARS_OD_Orientation_Obj_28 : 175|10@0+ (0.01,-5.11) [-5.11|5.12] "rad"  GW
 SG_ ARS_OD_YawRateAbs_Obj_28 : 181|10@0+ (0.001,-0.511) [-0.511|0.512] "rad/s"  GW
 SG_ ARS_OD_YawRateAbsStd_Obj_28 : 187|10@0+ (0.0001,0) [0|0.1023] "rad/s"  GW
 SG_ ARS_OD_RefPoint_Obj_28 : 193|2@0+ (1,0) [0|3] ""  GW
 SG_ ARS_OD_LifeCycle_Obj_28 : 207|16@0+ (1,0) [0|65535] ""  GW
 SG_ ARS_OD_DistX_Obj_29 : 223|12@0+ (0.0875,-100.0125) [-100.0125|258.3] "m"  GW
 SG_ ARS_OD_VabsX_Obj_29 : 227|11@0+ (0.125,-128) [-128|127.875] "m/s"  GW
 SG_ ARS_OD_AabsX_Obj_29 : 232|9@0+ (0.125,-31.875) [-31.875|32] "m/s^2"  GW
 SG_ ARS_OD_AabsX_Obj_28 : 16|9@0+ (0.125,-31.875) [-31.875|32] "m/s^2"  GW
 SG_ ARS_OD_DistY_Obj_29 : 255|12@0+ (0.0875,-179.1125) [-179.1125|179.2] "m"  GW
 SG_ ARS_OD_VabsY_Obj_29 : 259|11@0+ (0.125,-128) [-128|127.875] "m/s"  GW
 SG_ ARS_OD_AabsY_Obj_29 : 264|9@0+ (0.125,-31.875) [-31.875|32] "m/s^2"  GW
 SG_ ARS_OD_DistXStd_Obj_29 : 287|8@0+ (0.05,0) [0|12.75] "m"  GW
 SG_ ARS_OD_DistYStd_Obj_29 : 295|8@0+ (0.1,0) [0|25.5] "m"  GW
 SG_ ARS_OD_VabsXStd_Obj_29 : 303|7@0+ (0.1,0) [0|12.7] "m/s"  GW
 SG_ ARS_OD_VabsYStd_Obj_29 : 296|7@0+ (0.2,0) [0|25.4] "m/s"  GW
 SG_ ARS_OD_AabsXStd_Obj_29 : 305|7@0+ (0.25,0) [0|31.75] "m/s^2"  GW
 SG_ ARS_OD_Classification_Obj_29 : 314|3@0+ (1,0) [0|7] ""  GW
 SG_ ARS_OD_AabsYStd_Obj_29 : 327|8@0+ (0.25,0) [0|63.75] "m/s^2"  GW
 SG_ ARS_OD_ClassConf_Obj_29 : 335|7@0+ (1,0) [0|127] "%"  GW
 SG_ ARS_OD_DistY_Obj_28 : 39|12@0+ (0.0875,-179.1125) [-179.1125|179.2] "m"  GW
 SG_ ARS_OD_ProbOfExist_Obj_29 : 328|7@0+ (1,0) [0|127] "%"  GW
 SG_ ARS_OD_DynConf_Obj_29 : 337|7@0+ (1,0) [0|127] "%"  GW
 SG_ ARS_OD_DynProp_Obj_29 : 346|3@0+ (1,0) [0|7] ""  GW
 SG_ ARS_OD_MirrorProb_Obj_29 : 359|7@0+ (1,0) [0|127] "%"  GW
 SG_ ARS_OD_Length_Obj_29 : 352|7@0+ (0.2,0) [0|25.4] "m"  GW
 SG_ ARS_OD_MaintenanceState_Obj_29 : 361|2@0+ (1,0) [0|3] ""  GW
 SG_ ARS_OD_Width_Obj_29 : 375|7@0+ (0.2,0) [0|25.4] "m"  GW
 SG_ ARS_OD_RCS_Obj_29 : 368|9@0+ (0.2,-51.2) [-51.2|51] "dBsm"  GW
 SG_ ARS_OD_Orientation_Obj_29 : 391|10@0+ (0.01,-5.11) [-5.11|5.12] "rad"  GW
 SG_ ARS_OD_YawRateAbs_Obj_29 : 397|10@0+ (0.001,-0.511) [-0.511|0.512] "rad/s"  GW
 SG_ ARS_OD_YawRateAbsStd_Obj_29 : 403|10@0+ (0.0001,0) [0|0.1023] "rad/s"  GW
 SG_ ARS_OD_RefPoint_Obj_29 : 409|2@0+ (1,0) [0|3] ""  GW
 SG_ ARS_OD_LifeCycle_Obj_29 : 423|16@0+ (1,0) [0|65535] ""  GW
 SG_ ARS_OD_OrientationStd_Obj_28 : 439|4@0+ (0.002,0) [0|0.03] "rad"  GW
 SG_ ARS_OD_OrientationStd_Obj_29 : 435|4@0+ (0.002,0) [0|0.03] "rad"  GW
 SG_ ARS_OD_ObstacleProb_Obj_28 : 447|7@0+ (1,0) [0|127] "%"  GW
 SG_ ARS_OD_MicroDopplerFlag_28 : 440|1@0+ (1,0) [0|1] ""  GW
 SG_ ARS_OD_ObstacleProb_Obj_29 : 455|7@0+ (1,0) [0|127] "%"  GW
 SG_ ARS_OD_VabsY_Obj_28 : 43|11@0+ (0.125,-128) [-128|127.875] "m/s"  GW
 SG_ ARS_OD_MicroDopplerFlag_29 : 448|1@0+ (1,0) [0|1] ""  GW
 SG_ ARS_OD_ID_28 : 463|8@0+ (1,0) [0|255] ""  GW
 SG_ ARS_OD_ID_29 : 471|8@0+ (1,0) [0|255] ""  GW
 SG_ ARS_OD_MsgCounter_Obj_28_29 : 495|8@0+ (1,0) [0|255] ""  GW
 SG_ ARS_OD_CRC16_Checksum_Obj_28_29 : 503|16@0+ (1,0) [0|65535] ""  GW
 SG_ ARS_OD_AabsY_Obj_28 : 48|9@0+ (0.125,-31.875) [-31.875|32] "m/s^2"  GW
 SG_ ARS_OD_DistXStd_Obj_28 : 71|8@0+ (0.05,0) [0|12.75] "m"  GW
 SG_ ARS_OD_DistYStd_Obj_28 : 79|8@0+ (0.1,0) [0|25.5] "m"  GW
 SG_ ARS_OD_VabsXStd_Obj_28 : 87|7@0+ (0.1,0) [0|12.7] "m/s"  GW
 SG_ ARS_OD_VabsYStd_Obj_28 : 80|7@0+ (0.2,0) [0|25.4] "m/s"  GW
 SG_ ARS_OD_AabsXStd_Obj_28 : 89|7@0+ (0.25,0) [0|31.75] "m/s^2"  GW

BO_ 528 ARS_OD_30_31: 64 FR
 SG_ ARS_OD_DistX_Obj_30 : 7|12@0+ (0.0875,-100.0125) [-100.0125|258.3] "m"  GW
 SG_ ARS_OD_Classification_Obj_30 : 98|3@0+ (1,0) [0|7] ""  GW
 SG_ ARS_OD_AabsYStd_Obj_30 : 111|8@0+ (0.25,0) [0|63.75] "m/s^2"  GW
 SG_ ARS_OD_ClassConf_Obj_30 : 119|7@0+ (1,0) [0|127] "%"  GW
 SG_ ARS_OD_ProbOfExist_Obj_30 : 112|7@0+ (1,0) [0|127] "%"  GW
 SG_ ARS_OD_DynConf_Obj_30 : 121|7@0+ (1,0) [0|127] "%"  GW
 SG_ ARS_OD_VabsX_Obj_30 : 11|11@0+ (0.125,-128) [-128|127.875] "m/s"  GW
 SG_ ARS_OD_DynProp_Obj_30 : 130|3@0+ (1,0) [0|7] ""  GW
 SG_ ARS_OD_MirrorProb_Obj_30 : 143|7@0+ (1,0) [0|127] "%"  GW
 SG_ ARS_OD_Length_Obj_30 : 136|7@0+ (0.2,0) [0|25.4] "m"  GW
 SG_ ARS_OD_MaintenanceState_Obj_30 : 145|2@0+ (1,0) [0|3] ""  GW
 SG_ ARS_OD_Width_Obj_30 : 159|7@0+ (0.2,0) [0|25.4] "m"  GW
 SG_ ARS_OD_RCS_Obj_30 : 152|9@0+ (0.2,-51.2) [-51.2|51] "dBsm"  GW
 SG_ ARS_OD_Orientation_Obj_30 : 175|10@0+ (0.01,-5.11) [-5.11|5.12] "rad"  GW
 SG_ ARS_OD_YawRateAbs_Obj_30 : 181|10@0+ (0.001,-0.511) [-0.511|0.512] "rad/s"  GW
 SG_ ARS_OD_YawRateAbsStd_Obj_30 : 187|10@0+ (0.0001,0) [0|0.1023] "rad/s"  GW
 SG_ ARS_OD_RefPoint_Obj_30 : 193|2@0+ (1,0) [0|3] ""  GW
 SG_ ARS_OD_LifeCycle_Obj_30 : 207|16@0+ (1,0) [0|65535] ""  GW
 SG_ ARS_OD_DistX_Obj_31 : 223|12@0+ (0.0875,-100.0125) [-100.0125|258.3] "m"  GW
 SG_ ARS_OD_VabsX_Obj_31 : 227|11@0+ (0.125,-128) [-128|127.875] "m/s"  GW
 SG_ ARS_OD_AabsX_Obj_31 : 232|9@0+ (0.125,-31.875) [-31.875|32] "m/s^2"  GW
 SG_ ARS_OD_AabsX_Obj_30 : 16|9@0+ (0.125,-31.875) [-31.875|32] "m/s^2"  GW
 SG_ ARS_OD_DistY_Obj_31 : 255|12@0+ (0.0875,-179.1125) [-179.1125|179.2] "m"  GW
 SG_ ARS_OD_VabsY_Obj_31 : 259|11@0+ (0.125,-128) [-128|127.875] "m/s"  GW
 SG_ ARS_OD_AabsY_Obj_31 : 264|9@0+ (0.125,-31.875) [-31.875|32] "m/s^2"  GW
 SG_ ARS_OD_DistXStd_Obj_31 : 287|8@0+ (0.05,0) [0|12.75] "m"  GW
 SG_ ARS_OD_DistYStd_Obj_31 : 295|8@0+ (0.1,0) [0|25.5] "m"  GW
 SG_ ARS_OD_VabsXStd_Obj_31 : 303|7@0+ (0.1,0) [0|12.7] "m/s"  GW
 SG_ ARS_OD_VabsYStd_Obj_31 : 296|7@0+ (0.2,0) [0|25.4] "m/s"  GW
 SG_ ARS_OD_AabsXStd_Obj_31 : 305|7@0+ (0.25,0) [0|31.75] "m/s^2"  GW
 SG_ ARS_OD_Classification_Obj_31 : 314|3@0+ (1,0) [0|7] ""  GW
 SG_ ARS_OD_AabsYStd_Obj_31 : 327|8@0+ (0.25,0) [0|63.75] "m/s^2"  GW
 SG_ ARS_OD_ClassConf_Obj_31 : 335|7@0+ (1,0) [0|127] "%"  GW
 SG_ ARS_OD_DistY_Obj_30 : 39|12@0+ (0.0875,-179.1125) [-179.1125|179.2] "m"  GW
 SG_ ARS_OD_ProbOfExist_Obj_31 : 328|7@0+ (1,0) [0|127] "%"  GW
 SG_ ARS_OD_DynConf_Obj_31 : 337|7@0+ (1,0) [0|127] "%"  GW
 SG_ ARS_OD_DynProp_Obj_31 : 346|3@0+ (1,0) [0|7] ""  GW
 SG_ ARS_OD_MirrorProb_Obj_31 : 359|7@0+ (1,0) [0|127] "%"  GW
 SG_ ARS_OD_Length_Obj_31 : 352|7@0+ (0.2,0) [0|25.4] "m"  GW
 SG_ ARS_OD_MaintenanceState_Obj_31 : 361|2@0+ (1,0) [0|3] ""  GW
 SG_ ARS_OD_Width_Obj_31 : 375|7@0+ (0.2,0) [0|25.4] "m"  GW
 SG_ ARS_OD_RCS_Obj_31 : 368|9@0+ (0.2,-51.2) [-51.2|51] "dBsm"  GW
 SG_ ARS_OD_Orientation_Obj_31 : 391|10@0+ (0.01,-5.11) [-5.11|5.12] "rad"  GW
 SG_ ARS_OD_YawRateAbs_Obj_31 : 397|10@0+ (0.001,-0.511) [-0.511|0.512] "rad/s"  GW
 SG_ ARS_OD_YawRateAbsStd_Obj_31 : 403|10@0+ (0.0001,0) [0|0.1023] "rad/s"  GW
 SG_ ARS_OD_RefPoint_Obj_31 : 409|2@0+ (1,0) [0|3] ""  GW
 SG_ ARS_OD_LifeCycle_Obj_31 : 423|16@0+ (1,0) [0|65535] ""  GW
 SG_ ARS_OD_OrientationStd_Obj_30 : 439|4@0+ (0.002,0) [0|0.03] "rad"  GW
 SG_ ARS_OD_OrientationStd_Obj_31 : 435|4@0+ (0.002,0) [0|0.03] "rad"  GW
 SG_ ARS_OD_ObstacleProb_Obj_30 : 447|7@0+ (1,0) [0|127] "%"  GW
 SG_ ARS_OD_MicroDopplerFlag_30 : 440|1@0+ (1,0) [0|1] ""  GW
 SG_ ARS_OD_ObstacleProb_Obj_31 : 455|7@0+ (1,0) [0|127] "%"  GW
 SG_ ARS_OD_VabsY_Obj_30 : 43|11@0+ (0.125,-128) [-128|127.875] "m/s"  GW
 SG_ ARS_OD_MicroDopplerFlag_31 : 448|1@0+ (1,0) [0|1] ""  GW
 SG_ ARS_OD_ID_30 : 463|8@0+ (1,0) [0|255] ""  GW
 SG_ ARS_OD_ID_31 : 471|8@0+ (1,0) [0|255] ""  GW
 SG_ ARS_OD_MsgCounter_Obj_30_31 : 495|8@0+ (1,0) [0|255] ""  GW
 SG_ ARS_OD_CRC16_Checksum_Obj_30_31 : 503|16@0+ (1,0) [0|65535] ""  GW
 SG_ ARS_OD_AabsY_Obj_30 : 48|9@0+ (0.125,-31.875) [-31.875|32] "m/s^2"  GW
 SG_ ARS_OD_DistXStd_Obj_30 : 71|8@0+ (0.05,0) [0|12.75] "m"  GW
 SG_ ARS_OD_DistYStd_Obj_30 : 79|8@0+ (0.1,0) [0|25.5] "m"  GW
 SG_ ARS_OD_VabsXStd_Obj_30 : 87|7@0+ (0.1,0) [0|12.7] "m/s"  GW
 SG_ ARS_OD_VabsYStd_Obj_30 : 80|7@0+ (0.2,0) [0|25.4] "m/s"  GW
 SG_ ARS_OD_AabsXStd_Obj_30 : 89|7@0+ (0.25,0) [0|31.75] "m/s^2"  GW

BO_ 529 ARS_OD_32_33: 64 FR
 SG_ ARS_OD_DistX_Obj_32 : 7|12@0+ (0.0875,-100.0125) [-100.0125|258.3] "m"  GW
 SG_ ARS_OD_Classification_Obj_32 : 98|3@0+ (1,0) [0|7] ""  GW
 SG_ ARS_OD_AabsYStd_Obj_32 : 111|8@0+ (0.25,0) [0|63.75] "m/s^2"  GW
 SG_ ARS_OD_ClassConf_Obj_32 : 119|7@0+ (1,0) [0|127] "%"  GW
 SG_ ARS_OD_ProbOfExist_Obj_32 : 112|7@0+ (1,0) [0|127] "%"  GW
 SG_ ARS_OD_DynConf_Obj_32 : 121|7@0+ (1,0) [0|127] "%"  GW
 SG_ ARS_OD_VabsX_Obj_32 : 11|11@0+ (0.125,-128) [-128|127.875] "m/s"  GW
 SG_ ARS_OD_DynProp_Obj_32 : 130|3@0+ (1,0) [0|7] ""  GW
 SG_ ARS_OD_MirrorProb_Obj_32 : 143|7@0+ (1,0) [0|127] "%"  GW
 SG_ ARS_OD_Length_Obj_32 : 136|7@0+ (0.2,0) [0|25.4] "m"  GW
 SG_ ARS_OD_MaintenanceState_Obj_32 : 145|2@0+ (1,0) [0|3] ""  GW
 SG_ ARS_OD_Width_Obj_32 : 159|7@0+ (0.2,0) [0|25.4] "m"  GW
 SG_ ARS_OD_RCS_Obj_32 : 152|9@0+ (0.2,-51.2) [-51.2|51] "dBsm"  GW
 SG_ ARS_OD_Orientation_Obj_32 : 175|10@0+ (0.01,-5.11) [-5.11|5.12] "rad"  GW
 SG_ ARS_OD_YawRateAbs_Obj_32 : 181|10@0+ (0.001,-0.511) [-0.511|0.512] "rad/s"  GW
 SG_ ARS_OD_YawRateAbsStd_Obj_32 : 187|10@0+ (0.0001,0) [0|0.1023] "rad/s"  GW
 SG_ ARS_OD_RefPoint_Obj_32 : 193|2@0+ (1,0) [0|3] ""  GW
 SG_ ARS_OD_LifeCycle_Obj_32 : 207|16@0+ (1,0) [0|65535] ""  GW
 SG_ ARS_OD_DistX_Obj_33 : 223|12@0+ (0.0875,-100.0125) [-100.0125|258.3] "m"  GW
 SG_ ARS_OD_VabsX_Obj_33 : 227|11@0+ (0.125,-128) [-128|127.875] "m/s"  GW
 SG_ ARS_OD_AabsX_Obj_33 : 232|9@0+ (0.125,-31.875) [-31.875|32] "m/s^2"  GW
 SG_ ARS_OD_AabsX_Obj_32 : 16|9@0+ (0.125,-31.875) [-31.875|32] "m/s^2"  GW
 SG_ ARS_OD_DistY_Obj_33 : 255|12@0+ (0.0875,-179.1125) [-179.1125|179.2] "m"  GW
 SG_ ARS_OD_VabsY_Obj_33 : 259|11@0+ (0.125,-128) [-128|127.875] "m/s"  GW
 SG_ ARS_OD_AabsY_Obj_33 : 264|9@0+ (0.125,-31.875) [-31.875|32] "m/s^2"  GW
 SG_ ARS_OD_DistXStd_Obj_33 : 287|8@0+ (0.05,0) [0|12.75] "m"  GW
 SG_ ARS_OD_DistYStd_Obj_33 : 295|8@0+ (0.1,0) [0|25.5] "m"  GW
 SG_ ARS_OD_VabsXStd_Obj_33 : 303|7@0+ (0.1,0) [0|12.7] "m/s"  GW
 SG_ ARS_OD_VabsYStd_Obj_33 : 296|7@0+ (0.2,0) [0|25.4] "m/s"  GW
 SG_ ARS_OD_AabsXStd_Obj_33 : 305|7@0+ (0.25,0) [0|31.75] "m/s^2"  GW
 SG_ ARS_OD_Classification_Obj_33 : 314|3@0+ (1,0) [0|7] ""  GW
 SG_ ARS_OD_AabsYStd_Obj_33 : 327|8@0+ (0.25,0) [0|63.75] "m/s^2"  GW
 SG_ ARS_OD_ClassConf_Obj_33 : 335|7@0+ (1,0) [0|127] "%"  GW
 SG_ ARS_OD_DistY_Obj_32 : 39|12@0+ (0.0875,-179.1125) [-179.1125|179.2] "m"  GW
 SG_ ARS_OD_ProbOfExist_Obj_33 : 328|7@0+ (1,0) [0|127] "%"  GW
 SG_ ARS_OD_DynConf_Obj_33 : 337|7@0+ (1,0) [0|127] "%"  GW
 SG_ ARS_OD_DynProp_Obj_33 : 346|3@0+ (1,0) [0|7] ""  GW
 SG_ ARS_OD_MirrorProb_Obj_33 : 359|7@0+ (1,0) [0|127] "%"  GW
 SG_ ARS_OD_Length_Obj_33 : 352|7@0+ (0.2,0) [0|25.4] "m"  GW
 SG_ ARS_OD_MaintenanceState_Obj_33 : 361|2@0+ (1,0) [0|3] ""  GW
 SG_ ARS_OD_Width_Obj_33 : 375|7@0+ (0.2,0) [0|25.4] "m"  GW
 SG_ ARS_OD_RCS_Obj_33 : 368|9@0+ (0.2,-51.2) [-51.2|51] "dBsm"  GW
 SG_ ARS_OD_Orientation_Obj_33 : 391|10@0+ (0.01,-5.11) [-5.11|5.12] "rad"  GW
 SG_ ARS_OD_YawRateAbs_Obj_33 : 397|10@0+ (0.001,-0.511) [-0.511|0.512] "rad/s"  GW
 SG_ ARS_OD_YawRateAbsStd_Obj_33 : 403|10@0+ (0.0001,0) [0|0.1023] "rad/s"  GW
 SG_ ARS_OD_RefPoint_Obj_33 : 409|2@0+ (1,0) [0|3] ""  GW
 SG_ ARS_OD_LifeCycle_Obj_33 : 423|16@0+ (1,0) [0|65535] ""  GW
 SG_ ARS_OD_OrientationStd_Obj_32 : 439|4@0+ (0.002,0) [0|0.03] "rad"  GW
 SG_ ARS_OD_OrientationStd_Obj_33 : 435|4@0+ (0.002,0) [0|0.03] "rad"  GW
 SG_ ARS_OD_ObstacleProb_Obj_32 : 447|7@0+ (1,0) [0|127] "%"  GW
 SG_ ARS_OD_MicroDopplerFlag_32 : 440|1@0+ (1,0) [0|1] ""  GW
 SG_ ARS_OD_ObstacleProb_Obj_33 : 455|7@0+ (1,0) [0|127] "%"  GW
 SG_ ARS_OD_VabsY_Obj_32 : 43|11@0+ (0.125,-128) [-128|127.875] "m/s"  GW
 SG_ ARS_OD_MicroDopplerFlag_33 : 448|1@0+ (1,0) [0|1] ""  GW
 SG_ ARS_OD_ID_32 : 463|8@0+ (1,0) [0|255] ""  GW
 SG_ ARS_OD_ID_33 : 471|8@0+ (1,0) [0|255] ""  GW
 SG_ ARS_OD_MsgCounter_Obj_32_33 : 495|8@0+ (1,0) [0|255] ""  GW
 SG_ ARS_OD_CRC16_Checksum_Obj_32_33 : 503|16@0+ (1,0) [0|65535] ""  GW
 SG_ ARS_OD_AabsY_Obj_32 : 48|9@0+ (0.125,-31.875) [-31.875|32] "m/s^2"  GW
 SG_ ARS_OD_DistXStd_Obj_32 : 71|8@0+ (0.05,0) [0|12.75] "m"  GW
 SG_ ARS_OD_DistYStd_Obj_32 : 79|8@0+ (0.1,0) [0|25.5] "m"  GW
 SG_ ARS_OD_VabsXStd_Obj_32 : 87|7@0+ (0.1,0) [0|12.7] "m/s"  GW
 SG_ ARS_OD_VabsYStd_Obj_32 : 80|7@0+ (0.2,0) [0|25.4] "m/s"  GW
 SG_ ARS_OD_AabsXStd_Obj_32 : 89|7@0+ (0.25,0) [0|31.75] "m/s^2"  GW

BO_ 530 ARS_OD_34_35: 64 FR
 SG_ ARS_OD_DistX_Obj_34 : 7|12@0+ (0.0875,-100.0125) [-100.0125|258.3] "m"  GW
 SG_ ARS_OD_Classification_Obj_34 : 98|3@0+ (1,0) [0|7] ""  GW
 SG_ ARS_OD_AabsYStd_Obj_34 : 111|8@0+ (0.25,0) [0|63.75] "m/s^2"  GW
 SG_ ARS_OD_ClassConf_Obj_34 : 119|7@0+ (1,0) [0|127] "%"  GW
 SG_ ARS_OD_ProbOfExist_Obj_34 : 112|7@0+ (1,0) [0|127] "%"  GW
 SG_ ARS_OD_DynConf_Obj_34 : 121|7@0+ (1,0) [0|127] "%"  GW
 SG_ ARS_OD_VabsX_Obj_34 : 11|11@0+ (0.125,-128) [-128|127.875] "m/s"  GW
 SG_ ARS_OD_DynProp_Obj_34 : 130|3@0+ (1,0) [0|7] ""  GW
 SG_ ARS_OD_MirrorProb_Obj_34 : 143|7@0+ (1,0) [0|127] "%"  GW
 SG_ ARS_OD_Length_Obj_34 : 136|7@0+ (0.2,0) [0|25.4] "m"  GW
 SG_ ARS_OD_MaintenanceState_Obj_34 : 145|2@0+ (1,0) [0|3] ""  GW
 SG_ ARS_OD_Width_Obj_34 : 159|7@0+ (0.2,0) [0|25.4] "m"  GW
 SG_ ARS_OD_RCS_Obj_34 : 152|9@0+ (0.2,-51.2) [-51.2|51] "dBsm"  GW
 SG_ ARS_OD_Orientation_Obj_34 : 175|10@0+ (0.01,-5.11) [-5.11|5.12] "rad"  GW
 SG_ ARS_OD_YawRateAbs_Obj_34 : 181|10@0+ (0.001,-0.511) [-0.511|0.512] "rad/s"  GW
 SG_ ARS_OD_YawRateAbsStd_Obj_34 : 187|10@0+ (0.0001,0) [0|0.1023] "rad/s"  GW
 SG_ ARS_OD_RefPoint_Obj_34 : 193|2@0+ (1,0) [0|3] ""  GW
 SG_ ARS_OD_LifeCycle_Obj_34 : 207|16@0+ (1,0) [0|65535] ""  GW
 SG_ ARS_OD_DistX_Obj_35 : 223|12@0+ (0.0875,-100.0125) [-100.0125|258.3] "m"  GW
 SG_ ARS_OD_VabsX_Obj_35 : 227|11@0+ (0.125,-128) [-128|127.875] "m/s"  GW
 SG_ ARS_OD_AabsX_Obj_35 : 232|9@0+ (0.125,-31.875) [-31.875|32] "m/s^2"  GW
 SG_ ARS_OD_AabsX_Obj_34 : 16|9@0+ (0.125,-31.875) [-31.875|32] "m/s^2"  GW
 SG_ ARS_OD_DistY_Obj_35 : 255|12@0+ (0.0875,-179.1125) [-179.1125|179.2] "m"  GW
 SG_ ARS_OD_VabsY_Obj_35 : 259|11@0+ (0.125,-128) [-128|127.875] "m/s"  GW
 SG_ ARS_OD_AabsY_Obj_35 : 264|9@0+ (0.125,-31.875) [-31.875|32] "m/s^2"  GW
 SG_ ARS_OD_DistXStd_Obj_35 : 287|8@0+ (0.05,0) [0|12.75] "m"  GW
 SG_ ARS_OD_DistYStd_Obj_35 : 295|8@0+ (0.1,0) [0|25.5] "m"  GW
 SG_ ARS_OD_VabsXStd_Obj_35 : 303|7@0+ (0.1,0) [0|12.7] "m/s"  GW
 SG_ ARS_OD_VabsYStd_Obj_35 : 296|7@0+ (0.2,0) [0|25.4] "m/s"  GW
 SG_ ARS_OD_AabsXStd_Obj_35 : 305|7@0+ (0.25,0) [0|31.75] "m/s^2"  GW
 SG_ ARS_OD_Classification_Obj_35 : 314|3@0+ (1,0) [0|7] ""  GW
 SG_ ARS_OD_AabsYStd_Obj_35 : 327|8@0+ (0.25,0) [0|63.75] "m/s^2"  GW
 SG_ ARS_OD_ClassConf_Obj_35 : 335|7@0+ (1,0) [0|127] "%"  GW
 SG_ ARS_OD_DistY_Obj_34 : 39|12@0+ (0.0875,-179.1125) [-179.1125|179.2] "m"  GW
 SG_ ARS_OD_ProbOfExist_Obj_35 : 328|7@0+ (1,0) [0|127] "%"  GW
 SG_ ARS_OD_DynConf_Obj_35 : 337|7@0+ (1,0) [0|127] "%"  GW
 SG_ ARS_OD_DynProp_Obj_35 : 346|3@0+ (1,0) [0|7] ""  GW
 SG_ ARS_OD_MirrorProb_Obj_35 : 359|7@0+ (1,0) [0|127] "%"  GW
 SG_ ARS_OD_Length_Obj_35 : 352|7@0+ (0.2,0) [0|25.4] "m"  GW
 SG_ ARS_OD_MaintenanceState_Obj_35 : 361|2@0+ (1,0) [0|3] ""  GW
 SG_ ARS_OD_Width_Obj_35 : 375|7@0+ (0.2,0) [0|25.4] "m"  GW
 SG_ ARS_OD_RCS_Obj_35 : 368|9@0+ (0.2,-51.2) [-51.2|51] "dBsm"  GW
 SG_ ARS_OD_Orientation_Obj_35 : 391|10@0+ (0.01,-5.11) [-5.11|5.12] "rad"  GW
 SG_ ARS_OD_YawRateAbs_Obj_35 : 397|10@0+ (0.001,-0.511) [-0.511|0.512] "rad/s"  GW
 SG_ ARS_OD_YawRateAbsStd_Obj_35 : 403|10@0+ (0.0001,0) [0|0.1023] "rad/s"  GW
 SG_ ARS_OD_RefPoint_Obj_35 : 409|2@0+ (1,0) [0|3] ""  GW
 SG_ ARS_OD_LifeCycle_Obj_35 : 423|16@0+ (1,0) [0|65535] ""  GW
 SG_ ARS_OD_OrientationStd_Obj_34 : 439|4@0+ (0.002,0) [0|0.03] "rad"  GW
 SG_ ARS_OD_OrientationStd_Obj_35 : 435|4@0+ (0.002,0) [0|0.03] "rad"  GW
 SG_ ARS_OD_ObstacleProb_Obj_34 : 447|7@0+ (1,0) [0|127] "%"  GW
 SG_ ARS_OD_MicroDopplerFlag_34 : 440|1@0+ (1,0) [0|1] ""  GW
 SG_ ARS_OD_ObstacleProb_Obj_35 : 455|7@0+ (1,0) [0|127] "%"  GW
 SG_ ARS_OD_VabsY_Obj_34 : 43|11@0+ (0.125,-128) [-128|127.875] "m/s"  GW
 SG_ ARS_OD_MicroDopplerFlag_35 : 448|1@0+ (1,0) [0|1] ""  GW
 SG_ ARS_OD_ID_34 : 463|8@0+ (1,0) [0|255] ""  GW
 SG_ ARS_OD_ID_35 : 471|8@0+ (1,0) [0|255] ""  GW
 SG_ ARS_OD_MsgCounter_Obj_34_35 : 495|8@0+ (1,0) [0|255] ""  GW
 SG_ ARS_OD_CRC16_Checksum_Obj_34_35 : 503|16@0+ (1,0) [0|65535] ""  GW
 SG_ ARS_OD_AabsY_Obj_34 : 48|9@0+ (0.125,-31.875) [-31.875|32] "m/s^2"  GW
 SG_ ARS_OD_DistXStd_Obj_34 : 71|8@0+ (0.05,0) [0|12.75] "m"  GW
 SG_ ARS_OD_DistYStd_Obj_34 : 79|8@0+ (0.1,0) [0|25.5] "m"  GW
 SG_ ARS_OD_VabsXStd_Obj_34 : 87|7@0+ (0.1,0) [0|12.7] "m/s"  GW
 SG_ ARS_OD_VabsYStd_Obj_34 : 80|7@0+ (0.2,0) [0|25.4] "m/s"  GW
 SG_ ARS_OD_AabsXStd_Obj_34 : 89|7@0+ (0.25,0) [0|31.75] "m/s^2"  GW

BO_ 531 ARS_OD_36_37: 64 FR
 SG_ ARS_OD_DistX_Obj_36 : 7|12@0+ (0.0875,-100.0125) [-100.0125|258.3] "m"  GW
 SG_ ARS_OD_Classification_Obj_36 : 98|3@0+ (1,0) [0|7] ""  GW
 SG_ ARS_OD_AabsYStd_Obj_36 : 111|8@0+ (0.25,0) [0|63.75] "m/s^2"  GW
 SG_ ARS_OD_ClassConf_Obj_36 : 119|7@0+ (1,0) [0|127] "%"  GW
 SG_ ARS_OD_ProbOfExist_Obj_36 : 112|7@0+ (1,0) [0|127] "%"  GW
 SG_ ARS_OD_DynConf_Obj_36 : 121|7@0+ (1,0) [0|127] "%"  GW
 SG_ ARS_OD_VabsX_Obj_36 : 11|11@0+ (0.125,-128) [-128|127.875] "m/s"  GW
 SG_ ARS_OD_DynProp_Obj_36 : 130|3@0+ (1,0) [0|7] ""  GW
 SG_ ARS_OD_MirrorProb_Obj_36 : 143|7@0+ (1,0) [0|127] "%"  GW
 SG_ ARS_OD_Length_Obj_36 : 136|7@0+ (0.2,0) [0|25.4] "m"  GW
 SG_ ARS_OD_MaintenanceState_Obj_36 : 145|2@0+ (1,0) [0|3] ""  GW
 SG_ ARS_OD_Width_Obj_36 : 159|7@0+ (0.2,0) [0|25.4] "m"  GW
 SG_ ARS_OD_RCS_Obj_36 : 152|9@0+ (0.2,-51.2) [-51.2|51] "dBsm"  GW
 SG_ ARS_OD_Orientation_Obj_36 : 175|10@0+ (0.01,-5.11) [-5.11|5.12] "rad"  GW
 SG_ ARS_OD_YawRateAbs_Obj_36 : 181|10@0+ (0.001,-0.511) [-0.511|0.512] "rad/s"  GW
 SG_ ARS_OD_YawRateAbsStd_Obj_36 : 187|10@0+ (0.0001,0) [0|0.1023] "rad/s"  GW
 SG_ ARS_OD_RefPoint_Obj_36 : 193|2@0+ (1,0) [0|3] ""  GW
 SG_ ARS_OD_LifeCycle_Obj_36 : 207|16@0+ (1,0) [0|65535] ""  GW
 SG_ ARS_OD_DistX_Obj_37 : 223|12@0+ (0.0875,-100.0125) [-100.0125|258.3] "m"  GW
 SG_ ARS_OD_VabsX_Obj_37 : 227|11@0+ (0.125,-128) [-128|127.875] "m/s"  GW
 SG_ ARS_OD_AabsX_Obj_37 : 232|9@0+ (0.125,-31.875) [-31.875|32] "m/s^2"  GW
 SG_ ARS_OD_AabsX_Obj_36 : 16|9@0+ (0.125,-31.875) [-31.875|32] "m/s^2"  GW
 SG_ ARS_OD_DistY_Obj_37 : 255|12@0+ (0.0875,-179.1125) [-179.1125|179.2] "m"  GW
 SG_ ARS_OD_VabsY_Obj_37 : 259|11@0+ (0.125,-128) [-128|127.875] "m/s"  GW
 SG_ ARS_OD_AabsY_Obj_37 : 264|9@0+ (0.125,-31.875) [-31.875|32] "m/s^2"  GW
 SG_ ARS_OD_DistXStd_Obj_37 : 287|8@0+ (0.05,0) [0|12.75] "m"  GW
 SG_ ARS_OD_DistYStd_Obj_37 : 295|8@0+ (0.1,0) [0|25.5] "m"  GW
 SG_ ARS_OD_VabsXStd_Obj_37 : 303|7@0+ (0.1,0) [0|12.7] "m/s"  GW
 SG_ ARS_OD_VabsYStd_Obj_37 : 296|7@0+ (0.2,0) [0|25.4] "m/s"  GW
 SG_ ARS_OD_AabsXStd_Obj_37 : 305|7@0+ (0.25,0) [0|31.75] "m/s^2"  GW
 SG_ ARS_OD_Classification_Obj_37 : 314|3@0+ (1,0) [0|7] ""  GW
 SG_ ARS_OD_AabsYStd_Obj_37 : 327|8@0+ (0.25,0) [0|63.75] "m/s^2"  GW
 SG_ ARS_OD_ClassConf_Obj_37 : 335|7@0+ (1,0) [0|127] "%"  GW
 SG_ ARS_OD_DistY_Obj_36 : 39|12@0+ (0.0875,-179.1125) [-179.1125|179.2] "m"  GW
 SG_ ARS_OD_ProbOfExist_Obj_37 : 328|7@0+ (1,0) [0|127] "%"  GW
 SG_ ARS_OD_DynConf_Obj_37 : 337|7@0+ (1,0) [0|127] "%"  GW
 SG_ ARS_OD_DynProp_Obj_37 : 346|3@0+ (1,0) [0|7] ""  GW
 SG_ ARS_OD_MirrorProb_Obj_37 : 359|7@0+ (1,0) [0|127] "%"  GW
 SG_ ARS_OD_Length_Obj_37 : 352|7@0+ (0.2,0) [0|25.4] "m"  GW
 SG_ ARS_OD_MaintenanceState_Obj_37 : 361|2@0+ (1,0) [0|3] ""  GW
 SG_ ARS_OD_Width_Obj_37 : 375|7@0+ (0.2,0) [0|25.4] "m"  GW
 SG_ ARS_OD_RCS_Obj_37 : 368|9@0+ (0.2,-51.2) [-51.2|51] "dBsm"  GW
 SG_ ARS_OD_Orientation_Obj_37 : 391|10@0+ (0.01,-5.11) [-5.11|5.12] "rad"  GW
 SG_ ARS_OD_YawRateAbs_Obj_37 : 397|10@0+ (0.001,-0.511) [-0.511|0.512] "rad/s"  GW
 SG_ ARS_OD_YawRateAbsStd_Obj_37 : 403|10@0+ (0.0001,0) [0|0.1023] "rad/s"  GW
 SG_ ARS_OD_RefPoint_Obj_37 : 409|2@0+ (1,0) [0|3] ""  GW
 SG_ ARS_OD_LifeCycle_Obj_37 : 423|16@0+ (1,0) [0|65535] ""  GW
 SG_ ARS_OD_OrientationStd_Obj_36 : 439|4@0+ (0.002,0) [0|0.03] "rad"  GW
 SG_ ARS_OD_OrientationStd_Obj_37 : 435|4@0+ (0.002,0) [0|0.03] "rad"  GW
 SG_ ARS_OD_ObstacleProb_Obj_36 : 447|7@0+ (1,0) [0|127] "%"  GW
 SG_ ARS_OD_MicroDopplerFlag_36 : 440|1@0+ (1,0) [0|1] ""  GW
 SG_ ARS_OD_ObstacleProb_Obj_37 : 455|7@0+ (1,0) [0|127] "%"  GW
 SG_ ARS_OD_VabsY_Obj_36 : 43|11@0+ (0.125,-128) [-128|127.875] "m/s"  GW
 SG_ ARS_OD_MicroDopplerFlag_37 : 448|1@0+ (1,0) [0|1] ""  GW
 SG_ ARS_OD_ID_36 : 463|8@0+ (1,0) [0|255] ""  GW
 SG_ ARS_OD_ID_37 : 471|8@0+ (1,0) [0|255] ""  GW
 SG_ ARS_OD_MsgCounter_Obj_36_37 : 495|8@0+ (1,0) [0|255] ""  GW
 SG_ ARS_OD_CRC16_Checksum_Obj_36_37 : 503|16@0+ (1,0) [0|65535] ""  GW
 SG_ ARS_OD_AabsY_Obj_36 : 48|9@0+ (0.125,-31.875) [-31.875|32] "m/s^2"  GW
 SG_ ARS_OD_DistXStd_Obj_36 : 71|8@0+ (0.05,0) [0|12.75] "m"  GW
 SG_ ARS_OD_DistYStd_Obj_36 : 79|8@0+ (0.1,0) [0|25.5] "m"  GW
 SG_ ARS_OD_VabsXStd_Obj_36 : 87|7@0+ (0.1,0) [0|12.7] "m/s"  GW
 SG_ ARS_OD_VabsYStd_Obj_36 : 80|7@0+ (0.2,0) [0|25.4] "m/s"  GW
 SG_ ARS_OD_AabsXStd_Obj_36 : 89|7@0+ (0.25,0) [0|31.75] "m/s^2"  GW

BO_ 532 ARS_OD_38_39: 64 FR
 SG_ ARS_OD_DistX_Obj_38 : 7|12@0+ (0.0875,-100.0125) [-100.0125|258.3] "m"  GW
 SG_ ARS_OD_Classification_Obj_38 : 98|3@0+ (1,0) [0|7] ""  GW
 SG_ ARS_OD_AabsYStd_Obj_38 : 111|8@0+ (0.25,0) [0|63.75] "m/s^2"  GW
 SG_ ARS_OD_ClassConf_Obj_38 : 119|7@0+ (1,0) [0|127] "%"  GW
 SG_ ARS_OD_ProbOfExist_Obj_38 : 112|7@0+ (1,0) [0|127] "%"  GW
 SG_ ARS_OD_DynConf_Obj_38 : 121|7@0+ (1,0) [0|127] "%"  GW
 SG_ ARS_OD_VabsX_Obj_38 : 11|11@0+ (0.125,-128) [-128|127.875] "m/s"  GW
 SG_ ARS_OD_DynProp_Obj_38 : 130|3@0+ (1,0) [0|7] ""  GW
 SG_ ARS_OD_MirrorProb_Obj_38 : 143|7@0+ (1,0) [0|127] "%"  GW
 SG_ ARS_OD_Length_Obj_38 : 136|7@0+ (0.2,0) [0|25.4] "m"  GW
 SG_ ARS_OD_MaintenanceState_Obj_38 : 145|2@0+ (1,0) [0|3] ""  GW
 SG_ ARS_OD_Width_Obj_38 : 159|7@0+ (0.2,0) [0|25.4] "m"  GW
 SG_ ARS_OD_RCS_Obj_38 : 152|9@0+ (0.2,-51.2) [-51.2|51] "dBsm"  GW
 SG_ ARS_OD_Orientation_Obj_38 : 175|10@0+ (0.01,-5.11) [-5.11|5.12] "rad"  GW
 SG_ ARS_OD_YawRateAbs_Obj_38 : 181|10@0+ (0.001,-0.511) [-0.511|0.512] "rad/s"  GW
 SG_ ARS_OD_YawRateAbsStd_Obj_38 : 187|10@0+ (0.0001,0) [0|0.1023] "rad/s"  GW
 SG_ ARS_OD_RefPoint_Obj_38 : 193|2@0+ (1,0) [0|3] ""  GW
 SG_ ARS_OD_LifeCycle_Obj_38 : 207|16@0+ (1,0) [0|65535] ""  GW
 SG_ ARS_OD_DistX_Obj_39 : 223|12@0+ (0.0875,-100.0125) [-100.0125|258.3] "m"  GW
 SG_ ARS_OD_VabsX_Obj_39 : 227|11@0+ (0.125,-128) [-128|127.875] "m/s"  GW
 SG_ ARS_OD_AabsX_Obj_39 : 232|9@0+ (0.125,-31.875) [-31.875|32] "m/s^2"  GW
 SG_ ARS_OD_AabsX_Obj_38 : 16|9@0+ (0.125,-31.875) [-31.875|32] "m/s^2"  GW
 SG_ ARS_OD_DistY_Obj_39 : 255|12@0+ (0.0875,-179.1125) [-179.1125|179.2] "m"  GW
 SG_ ARS_OD_VabsY_Obj_39 : 259|11@0+ (0.125,-128) [-128|127.875] "m/s"  GW
 SG_ ARS_OD_AabsY_Obj_39 : 264|9@0+ (0.125,-31.875) [-31.875|32] "m/s^2"  GW
 SG_ ARS_OD_DistXStd_Obj_39 : 287|8@0+ (0.05,0) [0|12.75] "m"  GW
 SG_ ARS_OD_DistYStd_Obj_39 : 295|8@0+ (0.1,0) [0|25.5] "m"  GW
 SG_ ARS_OD_VabsXStd_Obj_39 : 303|7@0+ (0.1,0) [0|12.7] "m/s"  GW
 SG_ ARS_OD_VabsYStd_Obj_39 : 296|7@0+ (0.2,0) [0|25.4] "m/s"  GW
 SG_ ARS_OD_AabsXStd_Obj_39 : 305|7@0+ (0.25,0) [0|31.75] "m/s^2"  GW
 SG_ ARS_OD_Classification_Obj_39 : 314|3@0+ (1,0) [0|7] ""  GW
 SG_ ARS_OD_AabsYStd_Obj_39 : 327|8@0+ (0.25,0) [0|63.75] "m/s^2"  GW
 SG_ ARS_OD_ClassConf_Obj_39 : 335|7@0+ (1,0) [0|127] "%"  GW
 SG_ ARS_OD_DistY_Obj_38 : 39|12@0+ (0.0875,-179.1125) [-179.1125|179.2] "m"  GW
 SG_ ARS_OD_ProbOfExist_Obj_39 : 328|7@0+ (1,0) [0|127] "%"  GW
 SG_ ARS_OD_DynConf_Obj_39 : 337|7@0+ (1,0) [0|127] "%"  GW
 SG_ ARS_OD_DynProp_Obj_39 : 346|3@0+ (1,0) [0|7] ""  GW
 SG_ ARS_OD_MirrorProb_Obj_39 : 359|7@0+ (1,0) [0|127] "%"  GW
 SG_ ARS_OD_Length_Obj_39 : 352|7@0+ (0.2,0) [0|25.4] "m"  GW
 SG_ ARS_OD_MaintenanceState_Obj_39 : 361|2@0+ (1,0) [0|3] ""  GW
 SG_ ARS_OD_Width_Obj_39 : 375|7@0+ (0.2,0) [0|25.4] "m"  GW
 SG_ ARS_OD_RCS_Obj_39 : 368|9@0+ (0.2,-51.2) [-51.2|51] "dBsm"  GW
 SG_ ARS_OD_Orientation_Obj_39 : 391|10@0+ (0.01,-5.11) [-5.11|5.12] "rad"  GW
 SG_ ARS_OD_YawRateAbs_Obj_39 : 397|10@0+ (0.001,-0.511) [-0.511|0.512] "rad/s"  GW
 SG_ ARS_OD_YawRateAbsStd_Obj_39 : 403|10@0+ (0.0001,0) [0|0.1023] "rad/s"  GW
 SG_ ARS_OD_RefPoint_Obj_39 : 409|2@0+ (1,0) [0|3] ""  GW
 SG_ ARS_OD_LifeCycle_Obj_39 : 423|16@0+ (1,0) [0|65535] ""  GW
 SG_ ARS_OD_OrientationStd_Obj_38 : 439|4@0+ (0.002,0) [0|0.03] "rad"  GW
 SG_ ARS_OD_OrientationStd_Obj_39 : 435|4@0+ (0.002,0) [0|0.03] "rad"  GW
 SG_ ARS_OD_ObstacleProb_Obj_38 : 447|7@0+ (1,0) [0|127] "%"  GW
 SG_ ARS_OD_MicroDopplerFlag_38 : 440|1@0+ (1,0) [0|1] ""  GW
 SG_ ARS_OD_ObstacleProb_Obj_39 : 455|7@0+ (1,0) [0|127] "%"  GW
 SG_ ARS_OD_VabsY_Obj_38 : 43|11@0+ (0.125,-128) [-128|127.875] "m/s"  GW
 SG_ ARS_OD_MicroDopplerFlag_39 : 448|1@0+ (1,0) [0|1] ""  GW
 SG_ ARS_OD_ID_38 : 463|8@0+ (1,0) [0|255] ""  GW
 SG_ ARS_OD_ID_39 : 471|8@0+ (1,0) [0|255] ""  GW
 SG_ ARS_OD_MsgCounter_Obj_38_39 : 495|8@0+ (1,0) [0|255] ""  GW
 SG_ ARS_OD_CRC16_Checksum_Obj_38_39 : 503|16@0+ (1,0) [0|65535] ""  GW
 SG_ ARS_OD_AabsY_Obj_38 : 48|9@0+ (0.125,-31.875) [-31.875|32] "m/s^2"  GW
 SG_ ARS_OD_DistXStd_Obj_38 : 71|8@0+ (0.05,0) [0|12.75] "m"  GW
 SG_ ARS_OD_DistYStd_Obj_38 : 79|8@0+ (0.1,0) [0|25.5] "m"  GW
 SG_ ARS_OD_VabsXStd_Obj_38 : 87|7@0+ (0.1,0) [0|12.7] "m/s"  GW
 SG_ ARS_OD_VabsYStd_Obj_38 : 80|7@0+ (0.2,0) [0|25.4] "m/s"  GW
 SG_ ARS_OD_AabsXStd_Obj_38 : 89|7@0+ (0.25,0) [0|31.75] "m/s^2"  GW

BO_ 533 ARS_OD_40_41: 64 FR
 SG_ ARS_OD_DistX_Obj_40 : 7|12@0+ (0.0875,-100.0125) [-100.0125|258.3] "m"  GW
 SG_ ARS_OD_Classification_Obj_40 : 98|3@0+ (1,0) [0|7] ""  GW
 SG_ ARS_OD_AabsYStd_Obj_40 : 111|8@0+ (0.25,0) [0|63.75] "m/s^2"  GW
 SG_ ARS_OD_ClassConf_Obj_40 : 119|7@0+ (1,0) [0|127] "%"  GW
 SG_ ARS_OD_ProbOfExist_Obj_40 : 112|7@0+ (1,0) [0|127] "%"  GW
 SG_ ARS_OD_DynConf_Obj_40 : 121|7@0+ (1,0) [0|127] "%"  GW
 SG_ ARS_OD_VabsX_Obj_40 : 11|11@0+ (0.125,-128) [-128|127.875] "m/s"  GW
 SG_ ARS_OD_DynProp_Obj_40 : 130|3@0+ (1,0) [0|7] ""  GW
 SG_ ARS_OD_MirrorProb_Obj_40 : 143|7@0+ (1,0) [0|127] "%"  GW
 SG_ ARS_OD_Length_Obj_40 : 136|7@0+ (0.2,0) [0|25.4] "m"  GW
 SG_ ARS_OD_MaintenanceState_Obj_40 : 145|2@0+ (1,0) [0|3] ""  GW
 SG_ ARS_OD_Width_Obj_40 : 159|7@0+ (0.2,0) [0|25.4] "m"  GW
 SG_ ARS_OD_RCS_Obj_40 : 152|9@0+ (0.2,-51.2) [-51.2|51] "dBsm"  GW
 SG_ ARS_OD_Orientation_Obj_40 : 175|10@0+ (0.01,-5.11) [-5.11|5.12] "rad"  GW
 SG_ ARS_OD_YawRateAbs_Obj_40 : 181|10@0+ (0.001,-0.511) [-0.511|0.512] "rad/s"  GW
 SG_ ARS_OD_YawRateAbsStd_Obj_40 : 187|10@0+ (0.0001,0) [0|0.1023] "rad/s"  GW
 SG_ ARS_OD_RefPoint_Obj_40 : 193|2@0+ (1,0) [0|3] ""  GW
 SG_ ARS_OD_LifeCycle_Obj_40 : 207|16@0+ (1,0) [0|65535] ""  GW
 SG_ ARS_OD_DistX_Obj_41 : 223|12@0+ (0.0875,-100.0125) [-100.0125|258.3] "m"  GW
 SG_ ARS_OD_VabsX_Obj_41 : 227|11@0+ (0.125,-128) [-128|127.875] "m/s"  GW
 SG_ ARS_OD_AabsX_Obj_41 : 232|9@0+ (0.125,-31.875) [-31.875|32] "m/s^2"  GW
 SG_ ARS_OD_AabsX_Obj_40 : 16|9@0+ (0.125,-31.875) [-31.875|32] "m/s^2"  GW
 SG_ ARS_OD_DistY_Obj_41 : 255|12@0+ (0.0875,-179.1125) [-179.1125|179.2] "m"  GW
 SG_ ARS_OD_VabsY_Obj_41 : 259|11@0+ (0.125,-128) [-128|127.875] "m/s"  GW
 SG_ ARS_OD_AabsY_Obj_41 : 264|9@0+ (0.125,-31.875) [-31.875|32] "m/s^2"  GW
 SG_ ARS_OD_DistXStd_Obj_41 : 287|8@0+ (0.05,0) [0|12.75] "m"  GW
 SG_ ARS_OD_DistYStd_Obj_41 : 295|8@0+ (0.1,0) [0|25.5] "m"  GW
 SG_ ARS_OD_VabsXStd_Obj_41 : 303|7@0+ (0.1,0) [0|12.7] "m/s"  GW
 SG_ ARS_OD_VabsYStd_Obj_41 : 296|7@0+ (0.2,0) [0|25.4] "m/s"  GW
 SG_ ARS_OD_AabsXStd_Obj_41 : 305|7@0+ (0.25,0) [0|31.75] "m/s^2"  GW
 SG_ ARS_OD_Classification_Obj_41 : 314|3@0+ (1,0) [0|7] ""  GW
 SG_ ARS_OD_AabsYStd_Obj_41 : 327|8@0+ (0.25,0) [0|63.75] "m/s^2"  GW
 SG_ ARS_OD_ClassConf_Obj_41 : 335|7@0+ (1,0) [0|127] "%"  GW
 SG_ ARS_OD_DistY_Obj_40 : 39|12@0+ (0.0875,-179.1125) [-179.1125|179.2] "m"  GW
 SG_ ARS_OD_ProbOfExist_Obj_41 : 328|7@0+ (1,0) [0|127] "%"  GW
 SG_ ARS_OD_DynConf_Obj_41 : 337|7@0+ (1,0) [0|127] "%"  GW
 SG_ ARS_OD_DynProp_Obj_41 : 346|3@0+ (1,0) [0|7] ""  GW
 SG_ ARS_OD_MirrorProb_Obj_41 : 359|7@0+ (1,0) [0|127] "%"  GW
 SG_ ARS_OD_Length_Obj_41 : 352|7@0+ (0.2,0) [0|25.4] "m"  GW
 SG_ ARS_OD_MaintenanceState_Obj_41 : 361|2@0+ (1,0) [0|3] ""  GW
 SG_ ARS_OD_Width_Obj_41 : 375|7@0+ (0.2,0) [0|25.4] "m"  GW
 SG_ ARS_OD_RCS_Obj_41 : 368|9@0+ (0.2,-51.2) [-51.2|51] "dBsm"  GW
 SG_ ARS_OD_Orientation_Obj_41 : 391|10@0+ (0.01,-5.11) [-5.11|5.12] "rad"  GW
 SG_ ARS_OD_YawRateAbs_Obj_41 : 397|10@0+ (0.001,-0.511) [-0.511|0.512] "rad/s"  GW
 SG_ ARS_OD_YawRateAbsStd_Obj_41 : 403|10@0+ (0.0001,0) [0|0.1023] "rad/s"  GW
 SG_ ARS_OD_RefPoint_Obj_41 : 409|2@0+ (1,0) [0|3] ""  GW
 SG_ ARS_OD_LifeCycle_Obj_41 : 423|16@0+ (1,0) [0|65535] ""  GW
 SG_ ARS_OD_OrientationStd_Obj_40 : 439|4@0+ (0.002,0) [0|0.03] "rad"  GW
 SG_ ARS_OD_OrientationStd_Obj_41 : 435|4@0+ (0.002,0) [0|0.03] "rad"  GW
 SG_ ARS_OD_ObstacleProb_Obj_40 : 447|7@0+ (1,0) [0|127] "%"  GW
 SG_ ARS_OD_MicroDopplerFlag_40 : 440|1@0+ (1,0) [0|1] ""  GW
 SG_ ARS_OD_ObstacleProb_Obj_41 : 455|7@0+ (1,0) [0|127] "%"  GW
 SG_ ARS_OD_VabsY_Obj_40 : 43|11@0+ (0.125,-128) [-128|127.875] "m/s"  GW
 SG_ ARS_OD_MicroDopplerFlag_41 : 448|1@0+ (1,0) [0|1] ""  GW
 SG_ ARS_OD_ID_40 : 463|8@0+ (1,0) [0|255] ""  GW
 SG_ ARS_OD_ID_41 : 471|8@0+ (1,0) [0|255] ""  GW
 SG_ ARS_OD_MsgCounter_Obj_40_41 : 495|8@0+ (1,0) [0|255] ""  GW
 SG_ ARS_OD_CRC16_Checksum_Obj_40_41 : 503|16@0+ (1,0) [0|65535] ""  GW
 SG_ ARS_OD_AabsY_Obj_40 : 48|9@0+ (0.125,-31.875) [-31.875|32] "m/s^2"  GW
 SG_ ARS_OD_DistXStd_Obj_40 : 71|8@0+ (0.05,0) [0|12.75] "m"  GW
 SG_ ARS_OD_DistYStd_Obj_40 : 79|8@0+ (0.1,0) [0|25.5] "m"  GW
 SG_ ARS_OD_VabsXStd_Obj_40 : 87|7@0+ (0.1,0) [0|12.7] "m/s"  GW
 SG_ ARS_OD_VabsYStd_Obj_40 : 80|7@0+ (0.2,0) [0|25.4] "m/s"  GW
 SG_ ARS_OD_AabsXStd_Obj_40 : 89|7@0+ (0.25,0) [0|31.75] "m/s^2"  GW

BO_ 534 ARS_OD_42_43: 64 FR
 SG_ ARS_OD_DistX_Obj_42 : 7|12@0+ (0.0875,-100.0125) [-100.0125|258.3] "m"  GW
 SG_ ARS_OD_Classification_Obj_42 : 98|3@0+ (1,0) [0|7] ""  GW
 SG_ ARS_OD_AabsYStd_Obj_42 : 111|8@0+ (0.25,0) [0|63.75] "m/s^2"  GW
 SG_ ARS_OD_ClassConf_Obj_42 : 119|7@0+ (1,0) [0|127] "%"  GW
 SG_ ARS_OD_ProbOfExist_Obj_42 : 112|7@0+ (1,0) [0|127] "%"  GW
 SG_ ARS_OD_DynConf_Obj_42 : 121|7@0+ (1,0) [0|127] "%"  GW
 SG_ ARS_OD_VabsX_Obj_42 : 11|11@0+ (0.125,-128) [-128|127.875] "m/s"  GW
 SG_ ARS_OD_DynProp_Obj_42 : 130|3@0+ (1,0) [0|7] ""  GW
 SG_ ARS_OD_MirrorProb_Obj_42 : 143|7@0+ (1,0) [0|127] "%"  GW
 SG_ ARS_OD_Length_Obj_42 : 136|7@0+ (0.2,0) [0|25.4] "m"  GW
 SG_ ARS_OD_MaintenanceState_Obj_42 : 145|2@0+ (1,0) [0|3] ""  GW
 SG_ ARS_OD_Width_Obj_42 : 159|7@0+ (0.2,0) [0|25.4] "m"  GW
 SG_ ARS_OD_RCS_Obj_42 : 152|9@0+ (0.2,-51.2) [-51.2|51] "dBsm"  GW
 SG_ ARS_OD_Orientation_Obj_42 : 175|10@0+ (0.01,-5.11) [-5.11|5.12] "rad"  GW
 SG_ ARS_OD_YawRateAbs_Obj_42 : 181|10@0+ (0.001,-0.511) [-0.511|0.512] "rad/s"  GW
 SG_ ARS_OD_YawRateAbsStd_Obj_42 : 187|10@0+ (0.0001,0) [0|0.1023] "rad/s"  GW
 SG_ ARS_OD_RefPoint_Obj_42 : 193|2@0+ (1,0) [0|3] ""  GW
 SG_ ARS_OD_LifeCycle_Obj_42 : 207|16@0+ (1,0) [0|65535] ""  GW
 SG_ ARS_OD_DistX_Obj_43 : 223|12@0+ (0.0875,-100.0125) [-100.0125|258.3] "m"  GW
 SG_ ARS_OD_VabsX_Obj_43 : 227|11@0+ (0.125,-128) [-128|127.875] "m/s"  GW
 SG_ ARS_OD_AabsX_Obj_43 : 232|9@0+ (0.125,-31.875) [-31.875|32] "m/s^2"  GW
 SG_ ARS_OD_AabsX_Obj_42 : 16|9@0+ (0.125,-31.875) [-31.875|32] "m/s^2"  GW
 SG_ ARS_OD_DistY_Obj_43 : 255|12@0+ (0.0875,-179.1125) [-179.1125|179.2] "m"  GW
 SG_ ARS_OD_VabsY_Obj_43 : 259|11@0+ (0.125,-128) [-128|127.875] "m/s"  GW
 SG_ ARS_OD_AabsY_Obj_43 : 264|9@0+ (0.125,-31.875) [-31.875|32] "m/s^2"  GW
 SG_ ARS_OD_DistXStd_Obj_43 : 287|8@0+ (0.05,0) [0|12.75] "m"  GW
 SG_ ARS_OD_DistYStd_Obj_43 : 295|8@0+ (0.1,0) [0|25.5] "m"  GW
 SG_ ARS_OD_VabsXStd_Obj_43 : 303|7@0+ (0.1,0) [0|12.7] "m/s"  GW
 SG_ ARS_OD_VabsYStd_Obj_43 : 296|7@0+ (0.2,0) [0|25.4] "m/s"  GW
 SG_ ARS_OD_AabsXStd_Obj_43 : 305|7@0+ (0.25,0) [0|31.75] "m/s^2"  GW
 SG_ ARS_OD_Classification_Obj_43 : 314|3@0+ (1,0) [0|7] ""  GW
 SG_ ARS_OD_AabsYStd_Obj_43 : 327|8@0+ (0.25,0) [0|63.75] "m/s^2"  GW
 SG_ ARS_OD_ClassConf_Obj_43 : 335|7@0+ (1,0) [0|127] "%"  GW
 SG_ ARS_OD_DistY_Obj_42 : 39|12@0+ (0.0875,-179.1125) [-179.1125|179.2] "m"  GW
 SG_ ARS_OD_ProbOfExist_Obj_43 : 328|7@0+ (1,0) [0|127] "%"  GW
 SG_ ARS_OD_DynConf_Obj_43 : 337|7@0+ (1,0) [0|127] "%"  GW
 SG_ ARS_OD_DynProp_Obj_43 : 346|3@0+ (1,0) [0|7] ""  GW
 SG_ ARS_OD_MirrorProb_Obj_43 : 359|7@0+ (1,0) [0|127] "%"  GW
 SG_ ARS_OD_Length_Obj_43 : 352|7@0+ (0.2,0) [0|25.4] "m"  GW
 SG_ ARS_OD_MaintenanceState_Obj_43 : 361|2@0+ (1,0) [0|3] ""  GW
 SG_ ARS_OD_Width_Obj_43 : 375|7@0+ (0.2,0) [0|25.4] "m"  GW
 SG_ ARS_OD_RCS_Obj_43 : 368|9@0+ (0.2,-51.2) [-51.2|51] "dBsm"  GW
 SG_ ARS_OD_Orientation_Obj_43 : 391|10@0+ (0.01,-5.11) [-5.11|5.12] "rad"  GW
 SG_ ARS_OD_YawRateAbs_Obj_43 : 397|10@0+ (0.001,-0.511) [-0.511|0.512] "rad/s"  GW
 SG_ ARS_OD_YawRateAbsStd_Obj_43 : 403|10@0+ (0.0001,0) [0|0.1023] "rad/s"  GW
 SG_ ARS_OD_RefPoint_Obj_43 : 409|2@0+ (1,0) [0|3] ""  GW
 SG_ ARS_OD_LifeCycle_Obj_43 : 423|16@0+ (1,0) [0|65535] ""  GW
 SG_ ARS_OD_OrientationStd_Obj_42 : 439|4@0+ (0.002,0) [0|0.03] "rad"  GW
 SG_ ARS_OD_OrientationStd_Obj_43 : 435|4@0+ (0.002,0) [0|0.03] "rad"  GW
 SG_ ARS_OD_ObstacleProb_Obj_42 : 447|7@0+ (1,0) [0|127] "%"  GW
 SG_ ARS_OD_MicroDopplerFlag_42 : 440|1@0+ (1,0) [0|1] ""  GW
 SG_ ARS_OD_ObstacleProb_Obj_43 : 455|7@0+ (1,0) [0|127] "%"  GW
 SG_ ARS_OD_VabsY_Obj_42 : 43|11@0+ (0.125,-128) [-128|127.875] "m/s"  GW
 SG_ ARS_OD_MicroDopplerFlag_43 : 448|1@0+ (1,0) [0|1] ""  GW
 SG_ ARS_OD_ID_42 : 463|8@0+ (1,0) [0|255] ""  GW
 SG_ ARS_OD_ID_43 : 471|8@0+ (1,0) [0|255] ""  GW
 SG_ ARS_OD_MsgCounter_Obj_42_43 : 495|8@0+ (1,0) [0|255] ""  GW
 SG_ ARS_OD_CRC16_Checksum_Obj_42_43 : 503|16@0+ (1,0) [0|65535] ""  GW
 SG_ ARS_OD_AabsY_Obj_42 : 48|9@0+ (0.125,-31.875) [-31.875|32] "m/s^2"  GW
 SG_ ARS_OD_DistXStd_Obj_42 : 71|8@0+ (0.05,0) [0|12.75] "m"  GW
 SG_ ARS_OD_DistYStd_Obj_42 : 79|8@0+ (0.1,0) [0|25.5] "m"  GW
 SG_ ARS_OD_VabsXStd_Obj_42 : 87|7@0+ (0.1,0) [0|12.7] "m/s"  GW
 SG_ ARS_OD_VabsYStd_Obj_42 : 80|7@0+ (0.2,0) [0|25.4] "m/s"  GW
 SG_ ARS_OD_AabsXStd_Obj_42 : 89|7@0+ (0.25,0) [0|31.75] "m/s^2"  GW

BO_ 535 ARS_OD_44_45: 64 FR
 SG_ ARS_OD_DistX_Obj_44 : 7|12@0+ (0.0875,-100.0125) [-100.0125|258.3] "m"  GW
 SG_ ARS_OD_Classification_Obj_44 : 98|3@0+ (1,0) [0|7] ""  GW
 SG_ ARS_OD_AabsYStd_Obj_44 : 111|8@0+ (0.25,0) [0|63.75] "m/s^2"  GW
 SG_ ARS_OD_ClassConf_Obj_44 : 119|7@0+ (1,0) [0|127] "%"  GW
 SG_ ARS_OD_ProbOfExist_Obj_44 : 112|7@0+ (1,0) [0|127] "%"  GW
 SG_ ARS_OD_DynConf_Obj_44 : 121|7@0+ (1,0) [0|127] "%"  GW
 SG_ ARS_OD_VabsX_Obj_44 : 11|11@0+ (0.125,-128) [-128|127.875] "m/s"  GW
 SG_ ARS_OD_DynProp_Obj_44 : 130|3@0+ (1,0) [0|7] ""  GW
 SG_ ARS_OD_MirrorProb_Obj_44 : 143|7@0+ (1,0) [0|127] "%"  GW
 SG_ ARS_OD_Length_Obj_44 : 136|7@0+ (0.2,0) [0|25.4] "m"  GW
 SG_ ARS_OD_MaintenanceState_Obj_44 : 145|2@0+ (1,0) [0|3] ""  GW
 SG_ ARS_OD_Width_Obj_44 : 159|7@0+ (0.2,0) [0|25.4] "m"  GW
 SG_ ARS_OD_RCS_Obj_44 : 152|9@0+ (0.2,-51.2) [-51.2|51] "dBsm"  GW
 SG_ ARS_OD_Orientation_Obj_44 : 175|10@0+ (0.01,-5.11) [-5.11|5.12] "rad"  GW
 SG_ ARS_OD_YawRateAbs_Obj_44 : 181|10@0+ (0.001,-0.511) [-0.511|0.512] "rad/s"  GW
 SG_ ARS_OD_YawRateAbsStd_Obj_44 : 187|10@0+ (0.0001,0) [0|0.1023] "rad/s"  GW
 SG_ ARS_OD_RefPoint_Obj_44 : 193|2@0+ (1,0) [0|3] ""  GW
 SG_ ARS_OD_LifeCycle_Obj_44 : 207|16@0+ (1,0) [0|65535] ""  GW
 SG_ ARS_OD_DistX_Obj_45 : 223|12@0+ (0.0875,-100.0125) [-100.0125|258.3] "m"  GW
 SG_ ARS_OD_VabsX_Obj_45 : 227|11@0+ (0.125,-128) [-128|127.875] "m/s"  GW
 SG_ ARS_OD_AabsX_Obj_45 : 232|9@0+ (0.125,-31.875) [-31.875|32] "m/s^2"  GW
 SG_ ARS_OD_AabsX_Obj_44 : 16|9@0+ (0.125,-31.875) [-31.875|32] "m/s^2"  GW
 SG_ ARS_OD_DistY_Obj_45 : 255|12@0+ (0.0875,-179.1125) [-179.1125|179.2] "m"  GW
 SG_ ARS_OD_VabsY_Obj_45 : 259|11@0+ (0.125,-128) [-128|127.875] "m/s"  GW
 SG_ ARS_OD_AabsY_Obj_45 : 264|9@0+ (0.125,-31.875) [-31.875|32] "m/s^2"  GW
 SG_ ARS_OD_DistXStd_Obj_45 : 287|8@0+ (0.05,0) [0|12.75] "m"  GW
 SG_ ARS_OD_DistYStd_Obj_45 : 295|8@0+ (0.1,0) [0|25.5] "m"  GW
 SG_ ARS_OD_VabsXStd_Obj_45 : 303|7@0+ (0.1,0) [0|12.7] "m/s"  GW
 SG_ ARS_OD_VabsYStd_Obj_45 : 296|7@0+ (0.2,0) [0|25.4] "m/s"  GW
 SG_ ARS_OD_AabsXStd_Obj_45 : 305|7@0+ (0.25,0) [0|31.75] "m/s^2"  GW
 SG_ ARS_OD_Classification_Obj_45 : 314|3@0+ (1,0) [0|7] ""  GW
 SG_ ARS_OD_AabsYStd_Obj_45 : 327|8@0+ (0.25,0) [0|63.75] "m/s^2"  GW
 SG_ ARS_OD_ClassConf_Obj_45 : 335|7@0+ (1,0) [0|127] "%"  GW
 SG_ ARS_OD_DistY_Obj_44 : 39|12@0+ (0.0875,-179.1125) [-179.1125|179.2] "m"  GW
 SG_ ARS_OD_ProbOfExist_Obj_45 : 328|7@0+ (1,0) [0|127] "%"  GW
 SG_ ARS_OD_DynConf_Obj_45 : 337|7@0+ (1,0) [0|127] "%"  GW
 SG_ ARS_OD_DynProp_Obj_45 : 346|3@0+ (1,0) [0|7] ""  GW
 SG_ ARS_OD_MirrorProb_Obj_45 : 359|7@0+ (1,0) [0|127] "%"  GW
 SG_ ARS_OD_Length_Obj_45 : 352|7@0+ (0.2,0) [0|25.4] "m"  GW
 SG_ ARS_OD_MaintenanceState_Obj_45 : 361|2@0+ (1,0) [0|3] ""  GW
 SG_ ARS_OD_Width_Obj_45 : 375|7@0+ (0.2,0) [0|25.4] "m"  GW
 SG_ ARS_OD_RCS_Obj_45 : 368|9@0+ (0.2,-51.2) [-51.2|51] "dBsm"  GW
 SG_ ARS_OD_Orientation_Obj_45 : 391|10@0+ (0.01,-5.11) [-5.11|5.12] "rad"  GW
 SG_ ARS_OD_YawRateAbs_Obj_45 : 397|10@0+ (0.001,-0.511) [-0.511|0.512] "rad/s"  GW
 SG_ ARS_OD_YawRateAbsStd_Obj_45 : 403|10@0+ (0.0001,0) [0|0.1023] "rad/s"  GW
 SG_ ARS_OD_RefPoint_Obj_45 : 409|2@0+ (1,0) [0|3] ""  GW
 SG_ ARS_OD_LifeCycle_Obj_45 : 423|16@0+ (1,0) [0|65535] ""  GW
 SG_ ARS_OD_OrientationStd_Obj_44 : 439|4@0+ (0.002,0) [0|0.03] "rad"  GW
 SG_ ARS_OD_OrientationStd_Obj_45 : 435|4@0+ (0.002,0) [0|0.03] "rad"  GW
 SG_ ARS_OD_ObstacleProb_Obj_44 : 447|7@0+ (1,0) [0|127] "%"  GW
 SG_ ARS_OD_MicroDopplerFlag_44 : 440|1@0+ (1,0) [0|1] ""  GW
 SG_ ARS_OD_ObstacleProb_Obj_45 : 455|7@0+ (1,0) [0|127] "%"  GW
 SG_ ARS_OD_VabsY_Obj_44 : 43|11@0+ (0.125,-128) [-128|127.875] "m/s"  GW
 SG_ ARS_OD_MicroDopplerFlag_45 : 448|1@0+ (1,0) [0|1] ""  GW
 SG_ ARS_OD_ID_44 : 463|8@0+ (1,0) [0|255] ""  GW
 SG_ ARS_OD_ID_45 : 471|8@0+ (1,0) [0|255] ""  GW
 SG_ ARS_OD_MsgCounter_Obj_44_45 : 495|8@0+ (1,0) [0|255] ""  GW
 SG_ ARS_OD_CRC16_Checksum_Obj_44_45 : 503|16@0+ (1,0) [0|65535] ""  GW
 SG_ ARS_OD_AabsY_Obj_44 : 48|9@0+ (0.125,-31.875) [-31.875|32] "m/s^2"  GW
 SG_ ARS_OD_DistXStd_Obj_44 : 71|8@0+ (0.05,0) [0|12.75] "m"  GW
 SG_ ARS_OD_DistYStd_Obj_44 : 79|8@0+ (0.1,0) [0|25.5] "m"  GW
 SG_ ARS_OD_VabsXStd_Obj_44 : 87|7@0+ (0.1,0) [0|12.7] "m/s"  GW
 SG_ ARS_OD_VabsYStd_Obj_44 : 80|7@0+ (0.2,0) [0|25.4] "m/s"  GW
 SG_ ARS_OD_AabsXStd_Obj_44 : 89|7@0+ (0.25,0) [0|31.75] "m/s^2"  GW

BO_ 536 ARS_OD_46_47: 64 FR
 SG_ ARS_OD_DistX_Obj_46 : 7|12@0+ (0.0875,-100.0125) [-100.0125|258.3] "m"  GW
 SG_ ARS_OD_Classification_Obj_46 : 98|3@0+ (1,0) [0|7] ""  GW
 SG_ ARS_OD_AabsYStd_Obj_46 : 111|8@0+ (0.25,0) [0|63.75] "m/s^2"  GW
 SG_ ARS_OD_ClassConf_Obj_46 : 119|7@0+ (1,0) [0|127] "%"  GW
 SG_ ARS_OD_ProbOfExist_Obj_46 : 112|7@0+ (1,0) [0|127] "%"  GW
 SG_ ARS_OD_DynConf_Obj_46 : 121|7@0+ (1,0) [0|127] "%"  GW
 SG_ ARS_OD_VabsX_Obj_46 : 11|11@0+ (0.125,-128) [-128|127.875] "m/s"  GW
 SG_ ARS_OD_DynProp_Obj_46 : 130|3@0+ (1,0) [0|7] ""  GW
 SG_ ARS_OD_MirrorProb_Obj_46 : 143|7@0+ (1,0) [0|127] "%"  GW
 SG_ ARS_OD_Length_Obj_46 : 136|7@0+ (0.2,0) [0|25.4] "m"  GW
 SG_ ARS_OD_MaintenanceState_Obj_46 : 145|2@0+ (1,0) [0|3] ""  GW
 SG_ ARS_OD_Width_Obj_46 : 159|7@0+ (0.2,0) [0|25.4] "m"  GW
 SG_ ARS_OD_RCS_Obj_46 : 152|9@0+ (0.2,-51.2) [-51.2|51] "dBsm"  GW
 SG_ ARS_OD_Orientation_Obj_46 : 175|10@0+ (0.01,-5.11) [-5.11|5.12] "rad"  GW
 SG_ ARS_OD_YawRateAbs_Obj_46 : 181|10@0+ (0.001,-0.511) [-0.511|0.512] "rad/s"  GW
 SG_ ARS_OD_YawRateAbsStd_Obj_46 : 187|10@0+ (0.0001,0) [0|0.1023] "rad/s"  GW
 SG_ ARS_OD_RefPoint_Obj_46 : 193|2@0+ (1,0) [0|3] ""  GW
 SG_ ARS_OD_LifeCycle_Obj_46 : 207|16@0+ (1,0) [0|65535] ""  GW
 SG_ ARS_OD_DistX_Obj_47 : 223|12@0+ (0.0875,-100.0125) [-100.0125|258.3] "m"  GW
 SG_ ARS_OD_VabsX_Obj_47 : 227|11@0+ (0.125,-128) [-128|127.875] "m/s"  GW
 SG_ ARS_OD_AabsX_Obj_47 : 232|9@0+ (0.125,-31.875) [-31.875|32] "m/s^2"  GW
 SG_ ARS_OD_AabsX_Obj_46 : 16|9@0+ (0.125,-31.875) [-31.875|32] "m/s^2"  GW
 SG_ ARS_OD_DistY_Obj_47 : 255|12@0+ (0.0875,-179.1125) [-179.1125|179.2] "m"  GW
 SG_ ARS_OD_VabsY_Obj_47 : 259|11@0+ (0.125,-128) [-128|127.875] "m/s"  GW
 SG_ ARS_OD_AabsY_Obj_47 : 264|9@0+ (0.125,-31.875) [-31.875|32] "m/s^2"  GW
 SG_ ARS_OD_DistXStd_Obj_47 : 287|8@0+ (0.05,0) [0|12.75] "m"  GW
 SG_ ARS_OD_DistYStd_Obj_47 : 295|8@0+ (0.1,0) [0|25.5] "m"  GW
 SG_ ARS_OD_VabsXStd_Obj_47 : 303|7@0+ (0.1,0) [0|12.7] "m/s"  GW
 SG_ ARS_OD_VabsYStd_Obj_47 : 296|7@0+ (0.2,0) [0|25.4] "m/s"  GW
 SG_ ARS_OD_AabsXStd_Obj_47 : 305|7@0+ (0.25,0) [0|31.75] "m/s^2"  GW
 SG_ ARS_OD_Classification_Obj_47 : 314|3@0+ (1,0) [0|7] ""  GW
 SG_ ARS_OD_AabsYStd_Obj_47 : 327|8@0+ (0.25,0) [0|63.75] "m/s^2"  GW
 SG_ ARS_OD_ClassConf_Obj_47 : 335|7@0+ (1,0) [0|127] "%"  GW
 SG_ ARS_OD_DistY_Obj_46 : 39|12@0+ (0.0875,-179.1125) [-179.1125|179.2] "m"  GW
 SG_ ARS_OD_ProbOfExist_Obj_47 : 328|7@0+ (1,0) [0|127] "%"  GW
 SG_ ARS_OD_DynConf_Obj_47 : 337|7@0+ (1,0) [0|127] "%"  GW
 SG_ ARS_OD_DynProp_Obj_47 : 346|3@0+ (1,0) [0|7] ""  GW
 SG_ ARS_OD_MirrorProb_Obj_47 : 359|7@0+ (1,0) [0|127] "%"  GW
 SG_ ARS_OD_Length_Obj_47 : 352|7@0+ (0.2,0) [0|25.4] "m"  GW
 SG_ ARS_OD_MaintenanceState_Obj_47 : 361|2@0+ (1,0) [0|3] ""  GW
 SG_ ARS_OD_Width_Obj_47 : 375|7@0+ (0.2,0) [0|25.4] "m"  GW
 SG_ ARS_OD_RCS_Obj_47 : 368|9@0+ (0.2,-51.2) [-51.2|51] "dBsm"  GW
 SG_ ARS_OD_Orientation_Obj_47 : 391|10@0+ (0.01,-5.11) [-5.11|5.12] "rad"  GW
 SG_ ARS_OD_YawRateAbs_Obj_47 : 397|10@0+ (0.001,-0.511) [-0.511|0.512] "rad/s"  GW
 SG_ ARS_OD_YawRateAbsStd_Obj_47 : 403|10@0+ (0.0001,0) [0|0.1023] "rad/s"  GW
 SG_ ARS_OD_RefPoint_Obj_47 : 409|2@0+ (1,0) [0|3] ""  GW
 SG_ ARS_OD_LifeCycle_Obj_47 : 423|16@0+ (1,0) [0|65535] ""  GW
 SG_ ARS_OD_OrientationStd_Obj_46 : 439|4@0+ (0.002,0) [0|0.03] "rad"  GW
 SG_ ARS_OD_OrientationStd_Obj_47 : 435|4@0+ (0.002,0) [0|0.03] "rad"  GW
 SG_ ARS_OD_ObstacleProb_Obj_46 : 447|7@0+ (1,0) [0|127] "%"  GW
 SG_ ARS_OD_MicroDopplerFlag_46 : 440|1@0+ (1,0) [0|1] ""  GW
 SG_ ARS_OD_ObstacleProb_Obj_47 : 455|7@0+ (1,0) [0|127] "%"  GW
 SG_ ARS_OD_VabsY_Obj_46 : 43|11@0+ (0.125,-128) [-128|127.875] "m/s"  GW
 SG_ ARS_OD_MicroDopplerFlag_47 : 448|1@0+ (1,0) [0|1] ""  GW
 SG_ ARS_OD_ID_46 : 463|8@0+ (1,0) [0|255] ""  GW
 SG_ ARS_OD_ID_47 : 471|8@0+ (1,0) [0|255] ""  GW
 SG_ ARS_OD_MsgCounter_Obj_46_47 : 495|8@0+ (1,0) [0|255] ""  GW
 SG_ ARS_OD_CRC16_Checksum_Obj_46_47 : 503|16@0+ (1,0) [0|65535] ""  GW
 SG_ ARS_OD_AabsY_Obj_46 : 48|9@0+ (0.125,-31.875) [-31.875|32] "m/s^2"  GW
 SG_ ARS_OD_DistXStd_Obj_46 : 71|8@0+ (0.05,0) [0|12.75] "m"  GW
 SG_ ARS_OD_DistYStd_Obj_46 : 79|8@0+ (0.1,0) [0|25.5] "m"  GW
 SG_ ARS_OD_VabsXStd_Obj_46 : 87|7@0+ (0.1,0) [0|12.7] "m/s"  GW
 SG_ ARS_OD_VabsYStd_Obj_46 : 80|7@0+ (0.2,0) [0|25.4] "m/s"  GW
 SG_ ARS_OD_AabsXStd_Obj_46 : 89|7@0+ (0.25,0) [0|31.75] "m/s^2"  GW

BO_ 537 ARS_OD_48_49: 64 FR
 SG_ ARS_OD_DistX_Obj_48 : 7|12@0+ (0.0875,-100.0125) [-100.0125|258.3] "m"  GW
 SG_ ARS_OD_Classification_Obj_48 : 98|3@0+ (1,0) [0|7] ""  GW
 SG_ ARS_OD_AabsYStd_Obj_48 : 111|8@0+ (0.25,0) [0|63.75] "m/s^2"  GW
 SG_ ARS_OD_ClassConf_Obj_48 : 119|7@0+ (1,0) [0|127] "%"  GW
 SG_ ARS_OD_ProbOfExist_Obj_48 : 112|7@0+ (1,0) [0|127] "%"  GW
 SG_ ARS_OD_DynConf_Obj_48 : 121|7@0+ (1,0) [0|127] "%"  GW
 SG_ ARS_OD_VabsX_Obj_48 : 11|11@0+ (0.125,-128) [-128|127.875] "m/s"  GW
 SG_ ARS_OD_DynProp_Obj_48 : 130|3@0+ (1,0) [0|7] ""  GW
 SG_ ARS_OD_MirrorProb_Obj_48 : 143|7@0+ (1,0) [0|127] "%"  GW
 SG_ ARS_OD_Length_Obj_48 : 136|7@0+ (0.2,0) [0|25.4] "m"  GW
 SG_ ARS_OD_MaintenanceState_Obj_48 : 145|2@0+ (1,0) [0|3] ""  GW
 SG_ ARS_OD_Width_Obj_48 : 159|7@0+ (0.2,0) [0|25.4] "m"  GW
 SG_ ARS_OD_RCS_Obj_48 : 152|9@0+ (0.2,-51.2) [-51.2|51] "dBsm"  GW
 SG_ ARS_OD_Orientation_Obj_48 : 175|10@0+ (0.01,-5.11) [-5.11|5.12] "rad"  GW
 SG_ ARS_OD_YawRateAbs_Obj_48 : 181|10@0+ (0.001,-0.511) [-0.511|0.512] "rad/s"  GW
 SG_ ARS_OD_YawRateAbsStd_Obj_48 : 187|10@0+ (0.0001,0) [0|0.1023] "rad/s"  GW
 SG_ ARS_OD_RefPoint_Obj_48 : 193|2@0+ (1,0) [0|3] ""  GW
 SG_ ARS_OD_LifeCycle_Obj_48 : 207|16@0+ (1,0) [0|65535] ""  GW
 SG_ ARS_OD_DistX_Obj_49 : 223|12@0+ (0.0875,-100.0125) [-100.0125|258.3] "m"  GW
 SG_ ARS_OD_VabsX_Obj_49 : 227|11@0+ (0.125,-128) [-128|127.875] "m/s"  GW
 SG_ ARS_OD_AabsX_Obj_49 : 232|9@0+ (0.125,-31.875) [-31.875|32] "m/s^2"  GW
 SG_ ARS_OD_AabsX_Obj_48 : 16|9@0+ (0.125,-31.875) [-31.875|32] "m/s^2"  GW
 SG_ ARS_OD_DistY_Obj_49 : 255|12@0+ (0.0875,-179.1125) [-179.1125|179.2] "m"  GW
 SG_ ARS_OD_VabsY_Obj_49 : 259|11@0+ (0.125,-128) [-128|127.875] "m/s"  GW
 SG_ ARS_OD_AabsY_Obj_49 : 264|9@0+ (0.125,-31.875) [-31.875|32] "m/s^2"  GW
 SG_ ARS_OD_DistXStd_Obj_49 : 287|8@0+ (0.05,0) [0|12.75] "m"  GW
 SG_ ARS_OD_DistYStd_Obj_49 : 295|8@0+ (0.1,0) [0|25.5] "m"  GW
 SG_ ARS_OD_VabsXStd_Obj_49 : 303|7@0+ (0.1,0) [0|12.7] "m/s"  GW
 SG_ ARS_OD_VabsYStd_Obj_49 : 296|7@0+ (0.2,0) [0|25.4] "m/s"  GW
 SG_ ARS_OD_AabsXStd_Obj_49 : 305|7@0+ (0.25,0) [0|31.75] "m/s^2"  GW
 SG_ ARS_OD_Classification_Obj_49 : 314|3@0+ (1,0) [0|7] ""  GW
 SG_ ARS_OD_AabsYStd_Obj_49 : 327|8@0+ (0.25,0) [0|63.75] "m/s^2"  GW
 SG_ ARS_OD_ClassConf_Obj_49 : 335|7@0+ (1,0) [0|127] "%"  GW
 SG_ ARS_OD_DistY_Obj_48 : 39|12@0+ (0.0875,-179.1125) [-179.1125|179.2] "m"  GW
 SG_ ARS_OD_ProbOfExist_Obj_49 : 328|7@0+ (1,0) [0|127] "%"  GW
 SG_ ARS_OD_DynConf_Obj_49 : 337|7@0+ (1,0) [0|127] "%"  GW
 SG_ ARS_OD_DynProp_Obj_49 : 346|3@0+ (1,0) [0|7] ""  GW
 SG_ ARS_OD_MirrorProb_Obj_49 : 359|7@0+ (1,0) [0|127] "%"  GW
 SG_ ARS_OD_Length_Obj_49 : 352|7@0+ (0.2,0) [0|25.4] "m"  GW
 SG_ ARS_OD_MaintenanceState_Obj_49 : 361|2@0+ (1,0) [0|3] ""  GW
 SG_ ARS_OD_Width_Obj_49 : 375|7@0+ (0.2,0) [0|25.4] "m"  GW
 SG_ ARS_OD_RCS_Obj_49 : 368|9@0+ (0.2,-51.2) [-51.2|51] "dBsm"  GW
 SG_ ARS_OD_Orientation_Obj_49 : 391|10@0+ (0.01,-5.11) [-5.11|5.12] "rad"  GW
 SG_ ARS_OD_YawRateAbs_Obj_49 : 397|10@0+ (0.001,-0.511) [-0.511|0.512] "rad/s"  GW
 SG_ ARS_OD_YawRateAbsStd_Obj_49 : 403|10@0+ (0.0001,0) [0|0.1023] "rad/s"  GW
 SG_ ARS_OD_RefPoint_Obj_49 : 409|2@0+ (1,0) [0|3] ""  GW
 SG_ ARS_OD_LifeCycle_Obj_49 : 423|16@0+ (1,0) [0|65535] ""  GW
 SG_ ARS_OD_OrientationStd_Obj_48 : 439|4@0+ (0.002,0) [0|0.03] "rad"  GW
 SG_ ARS_OD_OrientationStd_Obj_49 : 435|4@0+ (0.002,0) [0|0.03] "rad"  GW
 SG_ ARS_OD_ObstacleProb_Obj_48 : 447|7@0+ (1,0) [0|127] "%"  GW
 SG_ ARS_OD_MicroDopplerFlag_48 : 440|1@0+ (1,0) [0|1] ""  GW
 SG_ ARS_OD_ObstacleProb_Obj_49 : 455|7@0+ (1,0) [0|127] "%"  GW
 SG_ ARS_OD_VabsY_Obj_48 : 43|11@0+ (0.125,-128) [-128|127.875] "m/s"  GW
 SG_ ARS_OD_MicroDopplerFlag_49 : 448|1@0+ (1,0) [0|1] ""  GW
 SG_ ARS_OD_ID_48 : 463|8@0+ (1,0) [0|255] ""  GW
 SG_ ARS_OD_ID_49 : 471|8@0+ (1,0) [0|255] ""  GW
 SG_ ARS_OD_MsgCounter_Obj_48_49 : 495|8@0+ (1,0) [0|255] ""  GW
 SG_ ARS_OD_CRC16_Checksum_Obj_48_49 : 503|16@0+ (1,0) [0|65535] ""  GW
 SG_ ARS_OD_AabsY_Obj_48 : 48|9@0+ (0.125,-31.875) [-31.875|32] "m/s^2"  GW
 SG_ ARS_OD_DistXStd_Obj_48 : 71|8@0+ (0.05,0) [0|12.75] "m"  GW
 SG_ ARS_OD_DistYStd_Obj_48 : 79|8@0+ (0.1,0) [0|25.5] "m"  GW
 SG_ ARS_OD_VabsXStd_Obj_48 : 87|7@0+ (0.1,0) [0|12.7] "m/s"  GW
 SG_ ARS_OD_VabsYStd_Obj_48 : 80|7@0+ (0.2,0) [0|25.4] "m/s"  GW
 SG_ ARS_OD_AabsXStd_Obj_48 : 89|7@0+ (0.25,0) [0|31.75] "m/s^2"  GW

BO_ 538 ARS_OD_50_51: 64 FR
 SG_ ARS_OD_DistX_Obj_50 : 7|12@0+ (0.0875,-100.0125) [-100.0125|258.3] "m"  GW
 SG_ ARS_OD_Classification_Obj_50 : 98|3@0+ (1,0) [0|7] ""  GW
 SG_ ARS_OD_AabsYStd_Obj_50 : 111|8@0+ (0.25,0) [0|63.75] "m/s^2"  GW
 SG_ ARS_OD_ClassConf_Obj_50 : 119|7@0+ (1,0) [0|127] "%"  GW
 SG_ ARS_OD_ProbOfExist_Obj_50 : 112|7@0+ (1,0) [0|127] "%"  GW
 SG_ ARS_OD_DynConf_Obj_50 : 121|7@0+ (1,0) [0|127] "%"  GW
 SG_ ARS_OD_VabsX_Obj_50 : 11|11@0+ (0.125,-128) [-128|127.875] "m/s"  GW
 SG_ ARS_OD_DynProp_Obj_50 : 130|3@0+ (1,0) [0|7] ""  GW
 SG_ ARS_OD_MirrorProb_Obj_50 : 143|7@0+ (1,0) [0|127] "%"  GW
 SG_ ARS_OD_Length_Obj_50 : 136|7@0+ (0.2,0) [0|25.4] "m"  GW
 SG_ ARS_OD_MaintenanceState_Obj_50 : 145|2@0+ (1,0) [0|3] ""  GW
 SG_ ARS_OD_Width_Obj_50 : 159|7@0+ (0.2,0) [0|25.4] "m"  GW
 SG_ ARS_OD_RCS_Obj_50 : 152|9@0+ (0.2,-51.2) [-51.2|51] "dBsm"  GW
 SG_ ARS_OD_Orientation_Obj_50 : 175|10@0+ (0.01,-5.11) [-5.11|5.12] "rad"  GW
 SG_ ARS_OD_YawRateAbs_Obj_50 : 181|10@0+ (0.001,-0.511) [-0.511|0.512] "rad/s"  GW
 SG_ ARS_OD_YawRateAbsStd_Obj_50 : 187|10@0+ (0.0001,0) [0|0.1023] "rad/s"  GW
 SG_ ARS_OD_RefPoint_Obj_50 : 193|2@0+ (1,0) [0|3] ""  GW
 SG_ ARS_OD_LifeCycle_Obj_50 : 207|16@0+ (1,0) [0|65535] ""  GW
 SG_ ARS_OD_DistX_Obj_51 : 223|12@0+ (0.0875,-100.0125) [-100.0125|258.3] "m"  GW
 SG_ ARS_OD_VabsX_Obj_51 : 227|11@0+ (0.125,-128) [-128|127.875] "m/s"  GW
 SG_ ARS_OD_AabsX_Obj_51 : 232|9@0+ (0.125,-31.875) [-31.875|32] "m/s^2"  GW
 SG_ ARS_OD_AabsX_Obj_50 : 16|9@0+ (0.125,-31.875) [-31.875|32] "m/s^2"  GW
 SG_ ARS_OD_DistY_Obj_51 : 255|12@0+ (0.0875,-179.1125) [-179.1125|179.2] "m"  GW
 SG_ ARS_OD_VabsY_Obj_51 : 259|11@0+ (0.125,-128) [-128|127.875] "m/s"  GW
 SG_ ARS_OD_AabsY_Obj_51 : 264|9@0+ (0.125,-31.875) [-31.875|32] "m/s^2"  GW
 SG_ ARS_OD_DistXStd_Obj_51 : 287|8@0+ (0.05,0) [0|12.75] "m"  GW
 SG_ ARS_OD_DistYStd_Obj_51 : 295|8@0+ (0.1,0) [0|25.5] "m"  GW
 SG_ ARS_OD_VabsXStd_Obj_51 : 303|7@0+ (0.1,0) [0|12.7] "m/s"  GW
 SG_ ARS_OD_VabsYStd_Obj_51 : 296|7@0+ (0.2,0) [0|25.4] "m/s"  GW
 SG_ ARS_OD_AabsXStd_Obj_51 : 305|7@0+ (0.25,0) [0|31.75] "m/s^2"  GW
 SG_ ARS_OD_Classification_Obj_51 : 314|3@0+ (1,0) [0|7] ""  GW
 SG_ ARS_OD_AabsYStd_Obj_51 : 327|8@0+ (0.25,0) [0|63.75] "m/s^2"  GW
 SG_ ARS_OD_ClassConf_Obj_51 : 335|7@0+ (1,0) [0|127] "%"  GW
 SG_ ARS_OD_DistY_Obj_50 : 39|12@0+ (0.0875,-179.1125) [-179.1125|179.2] "m"  GW
 SG_ ARS_OD_ProbOfExist_Obj_51 : 328|7@0+ (1,0) [0|127] "%"  GW
 SG_ ARS_OD_DynConf_Obj_51 : 337|7@0+ (1,0) [0|127] "%"  GW
 SG_ ARS_OD_DynProp_Obj_51 : 346|3@0+ (1,0) [0|7] ""  GW
 SG_ ARS_OD_MirrorProb_Obj_51 : 359|7@0+ (1,0) [0|127] "%"  GW
 SG_ ARS_OD_Length_Obj_51 : 352|7@0+ (0.2,0) [0|25.4] "m"  GW
 SG_ ARS_OD_MaintenanceState_Obj_51 : 361|2@0+ (1,0) [0|3] ""  GW
 SG_ ARS_OD_Width_Obj_51 : 375|7@0+ (0.2,0) [0|25.4] "m"  GW
 SG_ ARS_OD_RCS_Obj_51 : 368|9@0+ (0.2,-51.2) [-51.2|51] "dBsm"  GW
 SG_ ARS_OD_Orientation_Obj_51 : 391|10@0+ (0.01,-5.11) [-5.11|5.12] "rad"  GW
 SG_ ARS_OD_YawRateAbs_Obj_51 : 397|10@0+ (0.001,-0.511) [-0.511|0.512] "rad/s"  GW
 SG_ ARS_OD_YawRateAbsStd_Obj_51 : 403|10@0+ (0.0001,0) [0|0.1023] "rad/s"  GW
 SG_ ARS_OD_RefPoint_Obj_51 : 409|2@0+ (1,0) [0|3] ""  GW
 SG_ ARS_OD_LifeCycle_Obj_51 : 423|16@0+ (1,0) [0|65535] ""  GW
 SG_ ARS_OD_OrientationStd_Obj_50 : 439|4@0+ (0.002,0) [0|0.03] "rad"  GW
 SG_ ARS_OD_OrientationStd_Obj_51 : 435|4@0+ (0.002,0) [0|0.03] "rad"  GW
 SG_ ARS_OD_ObstacleProb_Obj_50 : 447|7@0+ (1,0) [0|127] "%"  GW
 SG_ ARS_OD_MicroDopplerFlag_50 : 440|1@0+ (1,0) [0|1] ""  GW
 SG_ ARS_OD_ObstacleProb_Obj_51 : 455|7@0+ (1,0) [0|127] "%"  GW
 SG_ ARS_OD_VabsY_Obj_50 : 43|11@0+ (0.125,-128) [-128|127.875] "m/s"  GW
 SG_ ARS_OD_MicroDopplerFlag_51 : 448|1@0+ (1,0) [0|1] ""  GW
 SG_ ARS_OD_ID_50 : 463|8@0+ (1,0) [0|255] ""  GW
 SG_ ARS_OD_ID_51 : 471|8@0+ (1,0) [0|255] ""  GW
 SG_ ARS_OD_MsgCounter_Obj_50_51 : 495|8@0+ (1,0) [0|255] ""  GW
 SG_ ARS_OD_CRC16_Checksum_Obj_50_51 : 503|16@0+ (1,0) [0|65535] ""  GW
 SG_ ARS_OD_AabsY_Obj_50 : 48|9@0+ (0.125,-31.875) [-31.875|32] "m/s^2"  GW
 SG_ ARS_OD_DistXStd_Obj_50 : 71|8@0+ (0.05,0) [0|12.75] "m"  GW
 SG_ ARS_OD_DistYStd_Obj_50 : 79|8@0+ (0.1,0) [0|25.5] "m"  GW
 SG_ ARS_OD_VabsXStd_Obj_50 : 87|7@0+ (0.1,0) [0|12.7] "m/s"  GW
 SG_ ARS_OD_VabsYStd_Obj_50 : 80|7@0+ (0.2,0) [0|25.4] "m/s"  GW
 SG_ ARS_OD_AabsXStd_Obj_50 : 89|7@0+ (0.25,0) [0|31.75] "m/s^2"  GW

BO_ 539 ARS_OD_52_53: 64 FR
 SG_ ARS_OD_DistX_Obj_52 : 7|12@0+ (0.0875,-100.0125) [-100.0125|258.3] "m"  GW
 SG_ ARS_OD_Classification_Obj_52 : 98|3@0+ (1,0) [0|7] ""  GW
 SG_ ARS_OD_AabsYStd_Obj_52 : 111|8@0+ (0.25,0) [0|63.75] "m/s^2"  GW
 SG_ ARS_OD_ClassConf_Obj_52 : 119|7@0+ (1,0) [0|127] "%"  GW
 SG_ ARS_OD_ProbOfExist_Obj_52 : 112|7@0+ (1,0) [0|127] "%"  GW
 SG_ ARS_OD_DynConf_Obj_52 : 121|7@0+ (1,0) [0|127] "%"  GW
 SG_ ARS_OD_VabsX_Obj_52 : 11|11@0+ (0.125,-128) [-128|127.875] "m/s"  GW
 SG_ ARS_OD_DynProp_Obj_52 : 130|3@0+ (1,0) [0|7] ""  GW
 SG_ ARS_OD_MirrorProb_Obj_52 : 143|7@0+ (1,0) [0|127] "%"  GW
 SG_ ARS_OD_Length_Obj_52 : 136|7@0+ (0.2,0) [0|25.4] "m"  GW
 SG_ ARS_OD_MaintenanceState_Obj_52 : 145|2@0+ (1,0) [0|3] ""  GW
 SG_ ARS_OD_Width_Obj_52 : 159|7@0+ (0.2,0) [0|25.4] "m"  GW
 SG_ ARS_OD_RCS_Obj_52 : 152|9@0+ (0.2,-51.2) [-51.2|51] "dBsm"  GW
 SG_ ARS_OD_Orientation_Obj_52 : 175|10@0+ (0.01,-5.11) [-5.11|5.12] "rad"  GW
 SG_ ARS_OD_YawRateAbs_Obj_52 : 181|10@0+ (0.001,-0.511) [-0.511|0.512] "rad/s"  GW
 SG_ ARS_OD_YawRateAbsStd_Obj_52 : 187|10@0+ (0.0001,0) [0|0.1023] "rad/s"  GW
 SG_ ARS_OD_RefPoint_Obj_52 : 193|2@0+ (1,0) [0|3] ""  GW
 SG_ ARS_OD_LifeCycle_Obj_52 : 207|16@0+ (1,0) [0|65535] ""  GW
 SG_ ARS_OD_DistX_Obj_53 : 223|12@0+ (0.0875,-100.0125) [-100.0125|258.3] "m"  GW
 SG_ ARS_OD_VabsX_Obj_53 : 227|11@0+ (0.125,-128) [-128|127.875] "m/s"  GW
 SG_ ARS_OD_AabsX_Obj_53 : 232|9@0+ (0.125,-31.875) [-31.875|32] "m/s^2"  GW
 SG_ ARS_OD_AabsX_Obj_52 : 16|9@0+ (0.125,-31.875) [-31.875|32] "m/s^2"  GW
 SG_ ARS_OD_DistY_Obj_53 : 255|12@0+ (0.0875,-179.1125) [-179.1125|179.2] "m"  GW
 SG_ ARS_OD_VabsY_Obj_53 : 259|11@0+ (0.125,-128) [-128|127.875] "m/s"  GW
 SG_ ARS_OD_AabsY_Obj_53 : 264|9@0+ (0.125,-31.875) [-31.875|32] "m/s^2"  GW
 SG_ ARS_OD_DistXStd_Obj_53 : 287|8@0+ (0.05,0) [0|12.75] "m"  GW
 SG_ ARS_OD_DistYStd_Obj_53 : 295|8@0+ (0.1,0) [0|25.5] "m"  GW
 SG_ ARS_OD_VabsXStd_Obj_53 : 303|7@0+ (0.1,0) [0|12.7] "m/s"  GW
 SG_ ARS_OD_VabsYStd_Obj_53 : 296|7@0+ (0.2,0) [0|25.4] "m/s"  GW
 SG_ ARS_OD_AabsXStd_Obj_53 : 305|7@0+ (0.25,0) [0|31.75] "m/s^2"  GW
 SG_ ARS_OD_Classification_Obj_53 : 314|3@0+ (1,0) [0|7] ""  GW
 SG_ ARS_OD_AabsYStd_Obj_53 : 327|8@0+ (0.25,0) [0|63.75] "m/s^2"  GW
 SG_ ARS_OD_ClassConf_Obj_53 : 335|7@0+ (1,0) [0|127] "%"  GW
 SG_ ARS_OD_DistY_Obj_52 : 39|12@0+ (0.0875,-179.1125) [-179.1125|179.2] "m"  GW
 SG_ ARS_OD_ProbOfExist_Obj_53 : 328|7@0+ (1,0) [0|127] "%"  GW
 SG_ ARS_OD_DynConf_Obj_53 : 337|7@0+ (1,0) [0|127] "%"  GW
 SG_ ARS_OD_DynProp_Obj_53 : 346|3@0+ (1,0) [0|7] ""  GW
 SG_ ARS_OD_MirrorProb_Obj_53 : 359|7@0+ (1,0) [0|127] "%"  GW
 SG_ ARS_OD_Length_Obj_53 : 352|7@0+ (0.2,0) [0|25.4] "m"  GW
 SG_ ARS_OD_MaintenanceState_Obj_53 : 361|2@0+ (1,0) [0|3] ""  GW
 SG_ ARS_OD_Width_Obj_53 : 375|7@0+ (0.2,0) [0|25.4] "m"  GW
 SG_ ARS_OD_RCS_Obj_53 : 368|9@0+ (0.2,-51.2) [-51.2|51] "dBsm"  GW
 SG_ ARS_OD_Orientation_Obj_53 : 391|10@0+ (0.01,-5.11) [-5.11|5.12] "rad"  GW
 SG_ ARS_OD_YawRateAbs_Obj_53 : 397|10@0+ (0.001,-0.511) [-0.511|0.512] "rad/s"  GW
 SG_ ARS_OD_YawRateAbsStd_Obj_53 : 403|10@0+ (0.0001,0) [0|0.1023] "rad/s"  GW
 SG_ ARS_OD_RefPoint_Obj_53 : 409|2@0+ (1,0) [0|3] ""  GW
 SG_ ARS_OD_LifeCycle_Obj_53 : 423|16@0+ (1,0) [0|65535] ""  GW
 SG_ ARS_OD_OrientationStd_Obj_52 : 439|4@0+ (0.002,0) [0|0.03] "rad"  GW
 SG_ ARS_OD_OrientationStd_Obj_53 : 435|4@0+ (0.002,0) [0|0.03] "rad"  GW
 SG_ ARS_OD_ObstacleProb_Obj_52 : 447|7@0+ (1,0) [0|127] "%"  GW
 SG_ ARS_OD_MicroDopplerFlag_52 : 440|1@0+ (1,0) [0|1] ""  GW
 SG_ ARS_OD_ObstacleProb_Obj_53 : 455|7@0+ (1,0) [0|127] "%"  GW
 SG_ ARS_OD_VabsY_Obj_52 : 43|11@0+ (0.125,-128) [-128|127.875] "m/s"  GW
 SG_ ARS_OD_MicroDopplerFlag_53 : 448|1@0+ (1,0) [0|1] ""  GW
 SG_ ARS_OD_ID_52 : 463|8@0+ (1,0) [0|255] ""  GW
 SG_ ARS_OD_ID_53 : 471|8@0+ (1,0) [0|255] ""  GW
 SG_ ARS_OD_MsgCounter_Obj_52_53 : 495|8@0+ (1,0) [0|255] ""  GW
 SG_ ARS_OD_CRC16_Checksum_Obj_52_53 : 503|16@0+ (1,0) [0|65535] ""  GW
 SG_ ARS_OD_AabsY_Obj_52 : 48|9@0+ (0.125,-31.875) [-31.875|32] "m/s^2"  GW
 SG_ ARS_OD_DistXStd_Obj_52 : 71|8@0+ (0.05,0) [0|12.75] "m"  GW
 SG_ ARS_OD_DistYStd_Obj_52 : 79|8@0+ (0.1,0) [0|25.5] "m"  GW
 SG_ ARS_OD_VabsXStd_Obj_52 : 87|7@0+ (0.1,0) [0|12.7] "m/s"  GW
 SG_ ARS_OD_VabsYStd_Obj_52 : 80|7@0+ (0.2,0) [0|25.4] "m/s"  GW
 SG_ ARS_OD_AabsXStd_Obj_52 : 89|7@0+ (0.25,0) [0|31.75] "m/s^2"  GW

BO_ 540 ARS_OD_54_55: 64 FR
 SG_ ARS_OD_DistX_Obj_54 : 7|12@0+ (0.0875,-100.0125) [-100.0125|258.3] "m"  GW
 SG_ ARS_OD_Classification_Obj_54 : 98|3@0+ (1,0) [0|7] ""  GW
 SG_ ARS_OD_AabsYStd_Obj_54 : 111|8@0+ (0.25,0) [0|63.75] "m/s^2"  GW
 SG_ ARS_OD_ClassConf_Obj_54 : 119|7@0+ (1,0) [0|127] "%"  GW
 SG_ ARS_OD_ProbOfExist_Obj_54 : 112|7@0+ (1,0) [0|127] "%"  GW
 SG_ ARS_OD_DynConf_Obj_54 : 121|7@0+ (1,0) [0|127] "%"  GW
 SG_ ARS_OD_VabsX_Obj_54 : 11|11@0+ (0.125,-128) [-128|127.875] "m/s"  GW
 SG_ ARS_OD_DynProp_Obj_54 : 130|3@0+ (1,0) [0|7] ""  GW
 SG_ ARS_OD_MirrorProb_Obj_54 : 143|7@0+ (1,0) [0|127] "%"  GW
 SG_ ARS_OD_Length_Obj_54 : 136|7@0+ (0.2,0) [0|25.4] "m"  GW
 SG_ ARS_OD_MaintenanceState_Obj_54 : 145|2@0+ (1,0) [0|3] ""  GW
 SG_ ARS_OD_Width_Obj_54 : 159|7@0+ (0.2,0) [0|25.4] "m"  GW
 SG_ ARS_OD_RCS_Obj_54 : 152|9@0+ (0.2,-51.2) [-51.2|51] "dBsm"  GW
 SG_ ARS_OD_Orientation_Obj_54 : 175|10@0+ (0.01,-5.11) [-5.11|5.12] "rad"  GW
 SG_ ARS_OD_YawRateAbs_Obj_54 : 181|10@0+ (0.001,-0.511) [-0.511|0.512] "rad/s"  GW
 SG_ ARS_OD_YawRateAbsStd_Obj_54 : 187|10@0+ (0.0001,0) [0|0.1023] "rad/s"  GW
 SG_ ARS_OD_RefPoint_Obj_54 : 193|2@0+ (1,0) [0|3] ""  GW
 SG_ ARS_OD_LifeCycle_Obj_54 : 207|16@0+ (1,0) [0|65535] ""  GW
 SG_ ARS_OD_DistX_Obj_55 : 223|12@0+ (0.0875,-100.0125) [-100.0125|258.3] "m"  GW
 SG_ ARS_OD_VabsX_Obj_55 : 227|11@0+ (0.125,-128) [-128|127.875] "m/s"  GW
 SG_ ARS_OD_AabsX_Obj_55 : 232|9@0+ (0.125,-31.875) [-31.875|32] "m/s^2"  GW
 SG_ ARS_OD_AabsX_Obj_54 : 16|9@0+ (0.125,-31.875) [-31.875|32] "m/s^2"  GW
 SG_ ARS_OD_DistY_Obj_55 : 255|12@0+ (0.0875,-179.1125) [-179.1125|179.2] "m"  GW
 SG_ ARS_OD_VabsY_Obj_55 : 259|11@0+ (0.125,-128) [-128|127.875] "m/s"  GW
 SG_ ARS_OD_AabsY_Obj_55 : 264|9@0+ (0.125,-31.875) [-31.875|32] "m/s^2"  GW
 SG_ ARS_OD_DistXStd_Obj_55 : 287|8@0+ (0.05,0) [0|12.75] "m"  GW
 SG_ ARS_OD_DistYStd_Obj_55 : 295|8@0+ (0.1,0) [0|25.5] "m"  GW
 SG_ ARS_OD_VabsXStd_Obj_55 : 303|7@0+ (0.1,0) [0|12.7] "m/s"  GW
 SG_ ARS_OD_VabsYStd_Obj_55 : 296|7@0+ (0.2,0) [0|25.4] "m/s"  GW
 SG_ ARS_OD_AabsXStd_Obj_55 : 305|7@0+ (0.25,0) [0|31.75] "m/s^2"  GW
 SG_ ARS_OD_Classification_Obj_55 : 314|3@0+ (1,0) [0|7] ""  GW
 SG_ ARS_OD_AabsYStd_Obj_55 : 327|8@0+ (0.25,0) [0|63.75] "m/s^2"  GW
 SG_ ARS_OD_ClassConf_Obj_55 : 335|7@0+ (1,0) [0|127] "%"  GW
 SG_ ARS_OD_DistY_Obj_54 : 39|12@0+ (0.0875,-179.1125) [-179.1125|179.2] "m"  GW
 SG_ ARS_OD_ProbOfExist_Obj_55 : 328|7@0+ (1,0) [0|127] "%"  GW
 SG_ ARS_OD_DynConf_Obj_55 : 337|7@0+ (1,0) [0|127] "%"  GW
 SG_ ARS_OD_DynProp_Obj_55 : 346|3@0+ (1,0) [0|7] ""  GW
 SG_ ARS_OD_MirrorProb_Obj_55 : 359|7@0+ (1,0) [0|127] "%"  GW
 SG_ ARS_OD_Length_Obj_55 : 352|7@0+ (0.2,0) [0|25.4] "m"  GW
 SG_ ARS_OD_MaintenanceState_Obj_55 : 361|2@0+ (1,0) [0|3] ""  GW
 SG_ ARS_OD_Width_Obj_55 : 375|7@0+ (0.2,0) [0|25.4] "m"  GW
 SG_ ARS_OD_RCS_Obj_55 : 368|9@0+ (0.2,-51.2) [-51.2|51] "dBsm"  GW
 SG_ ARS_OD_Orientation_Obj_55 : 391|10@0+ (0.01,-5.11) [-5.11|5.12] "rad"  GW
 SG_ ARS_OD_YawRateAbs_Obj_55 : 397|10@0+ (0.001,-0.511) [-0.511|0.512] "rad/s"  GW
 SG_ ARS_OD_YawRateAbsStd_Obj_55 : 403|10@0+ (0.0001,0) [0|0.1023] "rad/s"  GW
 SG_ ARS_OD_RefPoint_Obj_55 : 409|2@0+ (1,0) [0|3] ""  GW
 SG_ ARS_OD_LifeCycle_Obj_55 : 423|16@0+ (1,0) [0|65535] ""  GW
 SG_ ARS_OD_OrientationStd_Obj_54 : 439|4@0+ (0.002,0) [0|0.03] "rad"  GW
 SG_ ARS_OD_OrientationStd_Obj_55 : 435|4@0+ (0.002,0) [0|0.03] "rad"  GW
 SG_ ARS_OD_ObstacleProb_Obj_54 : 447|7@0+ (1,0) [0|127] "%"  GW
 SG_ ARS_OD_MicroDopplerFlag_54 : 440|1@0+ (1,0) [0|1] ""  GW
 SG_ ARS_OD_ObstacleProb_Obj_55 : 455|7@0+ (1,0) [0|127] "%"  GW
 SG_ ARS_OD_VabsY_Obj_54 : 43|11@0+ (0.125,-128) [-128|127.875] "m/s"  GW
 SG_ ARS_OD_MicroDopplerFlag_55 : 448|1@0+ (1,0) [0|1] ""  GW
 SG_ ARS_OD_ID_54 : 463|8@0+ (1,0) [0|255] ""  GW
 SG_ ARS_OD_ID_55 : 471|8@0+ (1,0) [0|255] ""  GW
 SG_ ARS_OD_MsgCounter_Obj_54_55 : 495|8@0+ (1,0) [0|255] ""  GW
 SG_ ARS_OD_CRC16_Checksum_Obj_54_55 : 503|16@0+ (1,0) [0|65535] ""  GW
 SG_ ARS_OD_AabsY_Obj_54 : 48|9@0+ (0.125,-31.875) [-31.875|32] "m/s^2"  GW
 SG_ ARS_OD_DistXStd_Obj_54 : 71|8@0+ (0.05,0) [0|12.75] "m"  GW
 SG_ ARS_OD_DistYStd_Obj_54 : 79|8@0+ (0.1,0) [0|25.5] "m"  GW
 SG_ ARS_OD_VabsXStd_Obj_54 : 87|7@0+ (0.1,0) [0|12.7] "m/s"  GW
 SG_ ARS_OD_VabsYStd_Obj_54 : 80|7@0+ (0.2,0) [0|25.4] "m/s"  GW
 SG_ ARS_OD_AabsXStd_Obj_54 : 89|7@0+ (0.25,0) [0|31.75] "m/s^2"  GW

BO_ 541 ARS_OD_56_57: 64 FR
 SG_ ARS_OD_DistX_Obj_56 : 7|12@0+ (0.0875,-100.0125) [-100.0125|258.3] "m"  GW
 SG_ ARS_OD_Classification_Obj_56 : 98|3@0+ (1,0) [0|7] ""  GW
 SG_ ARS_OD_AabsYStd_Obj_56 : 111|8@0+ (0.25,0) [0|63.75] "m/s^2"  GW
 SG_ ARS_OD_ClassConf_Obj_56 : 119|7@0+ (1,0) [0|127] "%"  GW
 SG_ ARS_OD_ProbOfExist_Obj_56 : 112|7@0+ (1,0) [0|127] "%"  GW
 SG_ ARS_OD_DynConf_Obj_56 : 121|7@0+ (1,0) [0|127] "%"  GW
 SG_ ARS_OD_VabsX_Obj_56 : 11|11@0+ (0.125,-128) [-128|127.875] "m/s"  GW
 SG_ ARS_OD_DynProp_Obj_56 : 130|3@0+ (1,0) [0|7] ""  GW
 SG_ ARS_OD_MirrorProb_Obj_56 : 143|7@0+ (1,0) [0|127] "%"  GW
 SG_ ARS_OD_Length_Obj_56 : 136|7@0+ (0.2,0) [0|25.4] "m"  GW
 SG_ ARS_OD_MaintenanceState_Obj_56 : 145|2@0+ (1,0) [0|3] ""  GW
 SG_ ARS_OD_Width_Obj_56 : 159|7@0+ (0.2,0) [0|25.4] "m"  GW
 SG_ ARS_OD_RCS_Obj_56 : 152|9@0+ (0.2,-51.2) [-51.2|51] "dBsm"  GW
 SG_ ARS_OD_Orientation_Obj_56 : 175|10@0+ (0.01,-5.11) [-5.11|5.12] "rad"  GW
 SG_ ARS_OD_YawRateAbs_Obj_56 : 181|10@0+ (0.001,-0.511) [-0.511|0.512] "rad/s"  GW
 SG_ ARS_OD_YawRateAbsStd_Obj_56 : 187|10@0+ (0.0001,0) [0|0.1023] "rad/s"  GW
 SG_ ARS_OD_RefPoint_Obj_56 : 193|2@0+ (1,0) [0|3] ""  GW
 SG_ ARS_OD_LifeCycle_Obj_56 : 207|16@0+ (1,0) [0|65535] ""  GW
 SG_ ARS_OD_DistX_Obj_57 : 223|12@0+ (0.0875,-100.0125) [-100.0125|258.3] "m"  GW
 SG_ ARS_OD_VabsX_Obj_57 : 227|11@0+ (0.125,-128) [-128|127.875] "m/s"  GW
 SG_ ARS_OD_AabsX_Obj_57 : 232|9@0+ (0.125,-31.875) [-31.875|32] "m/s^2"  GW
 SG_ ARS_OD_AabsX_Obj_56 : 16|9@0+ (0.125,-31.875) [-31.875|32] "m/s^2"  GW
 SG_ ARS_OD_DistY_Obj_57 : 255|12@0+ (0.0875,-179.1125) [-179.1125|179.2] "m"  GW
 SG_ ARS_OD_VabsY_Obj_57 : 259|11@0+ (0.125,-128) [-128|127.875] "m/s"  GW
 SG_ ARS_OD_AabsY_Obj_57 : 264|9@0+ (0.125,-31.875) [-31.875|32] "m/s^2"  GW
 SG_ ARS_OD_DistXStd_Obj_57 : 287|8@0+ (0.05,0) [0|12.75] "m"  GW
 SG_ ARS_OD_DistYStd_Obj_57 : 295|8@0+ (0.1,0) [0|25.5] "m"  GW
 SG_ ARS_OD_VabsXStd_Obj_57 : 303|7@0+ (0.1,0) [0|12.7] "m/s"  GW
 SG_ ARS_OD_VabsYStd_Obj_57 : 296|7@0+ (0.2,0) [0|25.4] "m/s"  GW
 SG_ ARS_OD_AabsXStd_Obj_57 : 305|7@0+ (0.25,0) [0|31.75] "m/s^2"  GW
 SG_ ARS_OD_Classification_Obj_57 : 314|3@0+ (1,0) [0|7] ""  GW
 SG_ ARS_OD_AabsYStd_Obj_57 : 327|8@0+ (0.25,0) [0|63.75] "m/s^2"  GW
 SG_ ARS_OD_ClassConf_Obj_57 : 335|7@0+ (1,0) [0|127] "%"  GW
 SG_ ARS_OD_DistY_Obj_56 : 39|12@0+ (0.0875,-179.1125) [-179.1125|179.2] "m"  GW
 SG_ ARS_OD_ProbOfExist_Obj_57 : 328|7@0+ (1,0) [0|127] "%"  GW
 SG_ ARS_OD_DynConf_Obj_57 : 337|7@0+ (1,0) [0|127] "%"  GW
 SG_ ARS_OD_DynProp_Obj_57 : 346|3@0+ (1,0) [0|7] ""  GW
 SG_ ARS_OD_MirrorProb_Obj_57 : 359|7@0+ (1,0) [0|127] "%"  GW
 SG_ ARS_OD_Length_Obj_57 : 352|7@0+ (0.2,0) [0|25.4] "m"  GW
 SG_ ARS_OD_MaintenanceState_Obj_57 : 361|2@0+ (1,0) [0|3] ""  GW
 SG_ ARS_OD_Width_Obj_57 : 375|7@0+ (0.2,0) [0|25.4] "m"  GW
 SG_ ARS_OD_RCS_Obj_57 : 368|9@0+ (0.2,-51.2) [-51.2|51] "dBsm"  GW
 SG_ ARS_OD_Orientation_Obj_57 : 391|10@0+ (0.01,-5.11) [-5.11|5.12] "rad"  GW
 SG_ ARS_OD_YawRateAbs_Obj_57 : 397|10@0+ (0.001,-0.511) [-0.511|0.512] "rad/s"  GW
 SG_ ARS_OD_YawRateAbsStd_Obj_57 : 403|10@0+ (0.0001,0) [0|0.1023] "rad/s"  GW
 SG_ ARS_OD_RefPoint_Obj_57 : 409|2@0+ (1,0) [0|3] ""  GW
 SG_ ARS_OD_LifeCycle_Obj_57 : 423|16@0+ (1,0) [0|65535] ""  GW
 SG_ ARS_OD_OrientationStd_Obj_56 : 439|4@0+ (0.002,0) [0|0.03] "rad"  GW
 SG_ ARS_OD_OrientationStd_Obj_57 : 435|4@0+ (0.002,0) [0|0.03] "rad"  GW
 SG_ ARS_OD_ObstacleProb_Obj_56 : 447|7@0+ (1,0) [0|127] "%"  GW
 SG_ ARS_OD_MicroDopplerFlag_56 : 440|1@0+ (1,0) [0|1] ""  GW
 SG_ ARS_OD_ObstacleProb_Obj_57 : 455|7@0+ (1,0) [0|127] "%"  GW
 SG_ ARS_OD_VabsY_Obj_56 : 43|11@0+ (0.125,-128) [-128|127.875] "m/s"  GW
 SG_ ARS_OD_MicroDopplerFlag_57 : 448|1@0+ (1,0) [0|1] ""  GW
 SG_ ARS_OD_ID_56 : 463|8@0+ (1,0) [0|255] ""  GW
 SG_ ARS_OD_ID_57 : 471|8@0+ (1,0) [0|255] ""  GW
 SG_ ARS_OD_MsgCounter_Obj_56_57 : 495|8@0+ (1,0) [0|255] ""  GW
 SG_ ARS_OD_CRC16_Checksum_Obj_56_57 : 503|16@0+ (1,0) [0|65535] ""  GW
 SG_ ARS_OD_AabsY_Obj_56 : 48|9@0+ (0.125,-31.875) [-31.875|32] "m/s^2"  GW
 SG_ ARS_OD_DistXStd_Obj_56 : 71|8@0+ (0.05,0) [0|12.75] "m"  GW
 SG_ ARS_OD_DistYStd_Obj_56 : 79|8@0+ (0.1,0) [0|25.5] "m"  GW
 SG_ ARS_OD_VabsXStd_Obj_56 : 87|7@0+ (0.1,0) [0|12.7] "m/s"  GW
 SG_ ARS_OD_VabsYStd_Obj_56 : 80|7@0+ (0.2,0) [0|25.4] "m/s"  GW
 SG_ ARS_OD_AabsXStd_Obj_56 : 89|7@0+ (0.25,0) [0|31.75] "m/s^2"  GW

BO_ 542 ARS_OD_58_59: 64 FR
 SG_ ARS_OD_DistX_Obj_58 : 7|12@0+ (0.0875,-100.0125) [-100.0125|258.3] "m"  GW
 SG_ ARS_OD_Classification_Obj_58 : 98|3@0+ (1,0) [0|7] ""  GW
 SG_ ARS_OD_AabsYStd_Obj_58 : 111|8@0+ (0.25,0) [0|63.75] "m/s^2"  GW
 SG_ ARS_OD_ClassConf_Obj_58 : 119|7@0+ (1,0) [0|127] "%"  GW
 SG_ ARS_OD_ProbOfExist_Obj_58 : 112|7@0+ (1,0) [0|127] "%"  GW
 SG_ ARS_OD_DynConf_Obj_58 : 121|7@0+ (1,0) [0|127] "%"  GW
 SG_ ARS_OD_VabsX_Obj_58 : 11|11@0+ (0.125,-128) [-128|127.875] "m/s"  GW
 SG_ ARS_OD_DynProp_Obj_58 : 130|3@0+ (1,0) [0|7] ""  GW
 SG_ ARS_OD_MirrorProb_Obj_58 : 143|7@0+ (1,0) [0|127] "%"  GW
 SG_ ARS_OD_Length_Obj_58 : 136|7@0+ (0.2,0) [0|25.4] "m"  GW
 SG_ ARS_OD_MaintenanceState_Obj_58 : 145|2@0+ (1,0) [0|3] ""  GW
 SG_ ARS_OD_Width_Obj_58 : 159|7@0+ (0.2,0) [0|25.4] "m"  GW
 SG_ ARS_OD_RCS_Obj_58 : 152|9@0+ (0.2,-51.2) [-51.2|51] "dBsm"  GW
 SG_ ARS_OD_Orientation_Obj_58 : 175|10@0+ (0.01,-5.11) [-5.11|5.12] "rad"  GW
 SG_ ARS_OD_YawRateAbs_Obj_58 : 181|10@0+ (0.001,-0.511) [-0.511|0.512] "rad/s"  GW
 SG_ ARS_OD_YawRateAbsStd_Obj_58 : 187|10@0+ (0.0001,0) [0|0.1023] "rad/s"  GW
 SG_ ARS_OD_RefPoint_Obj_58 : 193|2@0+ (1,0) [0|3] ""  GW
 SG_ ARS_OD_LifeCycle_Obj_58 : 207|16@0+ (1,0) [0|65535] ""  GW
 SG_ ARS_OD_DistX_Obj_59 : 223|12@0+ (0.0875,-100.0125) [-100.0125|258.3] "m"  GW
 SG_ ARS_OD_VabsX_Obj_59 : 227|11@0+ (0.125,-128) [-128|127.875] "m/s"  GW
 SG_ ARS_OD_AabsX_Obj_59 : 232|9@0+ (0.125,-31.875) [-31.875|32] "m/s^2"  GW
 SG_ ARS_OD_AabsX_Obj_58 : 16|9@0+ (0.125,-31.875) [-31.875|32] "m/s^2"  GW
 SG_ ARS_OD_DistY_Obj_59 : 255|12@0+ (0.0875,-179.1125) [-179.1125|179.2] "m"  GW
 SG_ ARS_OD_VabsY_Obj_59 : 259|11@0+ (0.125,-128) [-128|127.875] "m/s"  GW
 SG_ ARS_OD_AabsY_Obj_59 : 264|9@0+ (0.125,-31.875) [-31.875|32] "m/s^2"  GW
 SG_ ARS_OD_DistXStd_Obj_59 : 287|8@0+ (0.05,0) [0|12.75] "m"  GW
 SG_ ARS_OD_DistYStd_Obj_59 : 295|8@0+ (0.1,0) [0|25.5] "m"  GW
 SG_ ARS_OD_VabsXStd_Obj_59 : 303|7@0+ (0.1,0) [0|12.7] "m/s"  GW
 SG_ ARS_OD_VabsYStd_Obj_59 : 296|7@0+ (0.2,0) [0|25.4] "m/s"  GW
 SG_ ARS_OD_AabsXStd_Obj_59 : 305|7@0+ (0.25,0) [0|31.75] "m/s^2"  GW
 SG_ ARS_OD_Classification_Obj_59 : 314|3@0+ (1,0) [0|7] ""  GW
 SG_ ARS_OD_AabsYStd_Obj_59 : 327|8@0+ (0.25,0) [0|63.75] "m/s^2"  GW
 SG_ ARS_OD_ClassConf_Obj_59 : 335|7@0+ (1,0) [0|127] "%"  GW
 SG_ ARS_OD_DistY_Obj_58 : 39|12@0+ (0.0875,-179.1125) [-179.1125|179.2] "m"  GW
 SG_ ARS_OD_ProbOfExist_Obj_59 : 328|7@0+ (1,0) [0|127] "%"  GW
 SG_ ARS_OD_DynConf_Obj_59 : 337|7@0+ (1,0) [0|127] "%"  GW
 SG_ ARS_OD_DynProp_Obj_59 : 346|3@0+ (1,0) [0|7] ""  GW
 SG_ ARS_OD_MirrorProb_Obj_59 : 359|7@0+ (1,0) [0|127] "%"  GW
 SG_ ARS_OD_Length_Obj_59 : 352|7@0+ (0.2,0) [0|25.4] "m"  GW
 SG_ ARS_OD_MaintenanceState_Obj_59 : 361|2@0+ (1,0) [0|3] ""  GW
 SG_ ARS_OD_Width_Obj_59 : 375|7@0+ (0.2,0) [0|25.4] "m"  GW
 SG_ ARS_OD_RCS_Obj_59 : 368|9@0+ (0.2,-51.2) [-51.2|51] "dBsm"  GW
 SG_ ARS_OD_Orientation_Obj_59 : 391|10@0+ (0.01,-5.11) [-5.11|5.12] "rad"  GW
 SG_ ARS_OD_YawRateAbs_Obj_59 : 397|10@0+ (0.001,-0.511) [-0.511|0.512] "rad/s"  GW
 SG_ ARS_OD_YawRateAbsStd_Obj_59 : 403|10@0+ (0.0001,0) [0|0.1023] "rad/s"  GW
 SG_ ARS_OD_RefPoint_Obj_59 : 409|2@0+ (1,0) [0|3] ""  GW
 SG_ ARS_OD_LifeCycle_Obj_59 : 423|16@0+ (1,0) [0|65535] ""  GW
 SG_ ARS_OD_OrientationStd_Obj_58 : 439|4@0+ (0.002,0) [0|0.03] "rad"  GW
 SG_ ARS_OD_OrientationStd_Obj_59 : 435|4@0+ (0.002,0) [0|0.03] "rad"  GW
 SG_ ARS_OD_ObstacleProb_Obj_58 : 447|7@0+ (1,0) [0|127] "%"  GW
 SG_ ARS_OD_MicroDopplerFlag_58 : 440|1@0+ (1,0) [0|1] ""  GW
 SG_ ARS_OD_ObstacleProb_Obj_59 : 455|7@0+ (1,0) [0|127] "%"  GW
 SG_ ARS_OD_VabsY_Obj_58 : 43|11@0+ (0.125,-128) [-128|127.875] "m/s"  GW
 SG_ ARS_OD_MicroDopplerFlag_59 : 448|1@0+ (1,0) [0|1] ""  GW
 SG_ ARS_OD_ID_58 : 463|8@0+ (1,0) [0|255] ""  GW
 SG_ ARS_OD_ID_59 : 471|8@0+ (1,0) [0|255] ""  GW
 SG_ ARS_OD_MsgCounter_Obj_58_59 : 495|8@0+ (1,0) [0|255] ""  GW
 SG_ ARS_OD_CRC16_Checksum_Obj_58_59 : 503|16@0+ (1,0) [0|65535] ""  GW
 SG_ ARS_OD_AabsY_Obj_58 : 48|9@0+ (0.125,-31.875) [-31.875|32] "m/s^2"  GW
 SG_ ARS_OD_DistXStd_Obj_58 : 71|8@0+ (0.05,0) [0|12.75] "m"  GW
 SG_ ARS_OD_DistYStd_Obj_58 : 79|8@0+ (0.1,0) [0|25.5] "m"  GW
 SG_ ARS_OD_VabsXStd_Obj_58 : 87|7@0+ (0.1,0) [0|12.7] "m/s"  GW
 SG_ ARS_OD_VabsYStd_Obj_58 : 80|7@0+ (0.2,0) [0|25.4] "m/s"  GW
 SG_ ARS_OD_AabsXStd_Obj_58 : 89|7@0+ (0.25,0) [0|31.75] "m/s^2"  GW

BO_ 543 ARS_ROAD: 32 FR
 SG_ ARS_RD_ClothoidParam_1 : 7|12@0+ (0.001,-2.047) [-2.047|2.048] "rad"  GW
 SG_ ARS_RD_NofLane_Left : 96|2@0+ (1,0) [0|3] ""  GW
 SG_ ARS_RD_NofLaneProb_Left : 110|7@0+ (1,0) [0|127] "%"  GW
 SG_ ARS_RD_Confidence_Right : 119|7@0+ (1,0) [0|127] "%"  GW
 SG_ ARS_RD_NofLane_Right : 112|2@0+ (1,0) [0|3] ""  GW
 SG_ ARS_RD_NofLaneProb_Right : 126|7@0+ (1,0) [0|127] "%"  GW
 SG_ ARS_RD_ClothoidParam_2 : 11|10@0+ (0.0001,-0.0511) [-0.0511|0.0512] "1/m"  GW
 SG_ ARS_RD_RoadType : 17|2@0+ (1,0) [0|3] ""  GW
 SG_ ARS_RD_MsgCounter : 239|8@0+ (1,0) [0|255] ""  GW
 SG_ ARS_RD_CRC16_Checksum : 247|16@0+ (1,0) [0|65535] ""  GW
 SG_ ARS_RD_ClothoidParam_3 : 31|11@0+ (1E-006,-0.001023) [-0.001023|0.001024] "1/m^2"  GW
 SG_ ARS_RD_RoadTypeConf : 36|7@0+ (1,0) [0|127] "%"  GW
 SG_ ARS_RD_Xstart_Left : 45|9@0+ (0.5,0) [0|255.5] "m"  GW
 SG_ ARS_RD_Xstart_Right : 52|9@0+ (0.5,0) [0|255.5] "m"  GW
 SG_ ARS_RD_Xend_Left : 59|9@0+ (0.5,0) [0|255.5] "m"  GW
 SG_ ARS_RD_Xend_Right : 66|9@0+ (0.5,0) [0|255.5] "m"  GW
 SG_ ARS_RD_LatOffset_Left : 87|8@0+ (0.1,0) [0|25.5] "m"  GW
 SG_ ARS_RD_LatOffset_Right : 95|8@0+ (0.1,-25.5) [-25.5|0] "m"  GW
 SG_ ARS_RD_Confidence_Left : 103|7@0+ (1,0) [0|127] "%"  GW

BO_ 1793 ARS_Diag_Req: 64 GW
 SG_ ARS_DiagRequestData0 : 7|64@0+ (1,0) [0|0] ""  FR
 SG_ ARS_DiagRequestData2 : 135|64@0+ (1,0) [0|0] ""  FR
 SG_ ARS_DiagRequestData3 : 199|64@0+ (1,0) [0|0] ""  FR
 SG_ ARS_DiagRequestData4 : 263|64@0+ (1,0) [0|0] ""  FR
 SG_ ARS_DiagRequestData5 : 327|64@0+ (1,0) [0|0] ""  FR
 SG_ ARS_DiagRequestData6 : 391|64@0+ (1,0) [0|0] ""  FR
 SG_ ARS_DiagRequestData7 : 455|64@0+ (1,0) [0|0] ""  FR
 SG_ ARS_DiagRequestData1 : 71|64@0+ (1,0) [0|0] ""  FR

BO_ 1798 rearARS_Diag_Req: 64 GW
 SG_ reaARS_DiagRequestData0 : 7|64@0+ (1,0) [0|0] ""  FR
 SG_ reaARS_DiagRequestData2 : 135|64@0+ (1,0) [0|0] ""  FR
 SG_ reaARS_DiagRequestData3 : 199|64@0+ (1,0) [0|0] ""  FR
 SG_ reaARS_DiagRequestData4 : 263|64@0+ (1,0) [0|0] ""  FR
 SG_ reaARS_DiagRequestData5 : 327|64@0+ (1,0) [0|0] ""  FR
 SG_ reaARS_DiagRequestData6 : 391|64@0+ (1,0) [0|0] ""  FR
 SG_ reaARS_DiagRequestData7 : 455|64@0+ (1,0) [0|0] ""  FR
 SG_ reaARS_DiagRequestData1 : 71|64@0+ (1,0) [0|0] ""  FR

BO_ 1889 ARS_Diag_Resp: 64 FR
 SG_ ARS_DiagResponseData0 : 7|64@0+ (1,0) [0|0] ""  GW
 SG_ ARS_DiagResponseData2 : 135|64@0+ (1,0) [0|0] ""  GW
 SG_ ARS_DiagResponseData3 : 199|64@0+ (1,0) [0|0] ""  GW
 SG_ ARS_DiagResponseData4 : 263|64@0+ (1,0) [0|0] ""  GW
 SG_ ARS_DiagResponseData5 : 327|64@0+ (1,0) [0|0] ""  GW
 SG_ ARS_DiagResponseData6 : 391|64@0+ (1,0) [0|0] ""  GW
 SG_ ARS_DiagResponseData7 : 455|64@0+ (1,0) [0|0] ""  GW
 SG_ ARS_DiagResponseData1 : 71|64@0+ (1,0) [0|0] ""  GW

BO_ 1894 rearARS_Diag_Resp: 64 FR
 SG_ reaARS_DiagResponseData0 : 7|64@0+ (1,0) [0|0] ""  GW
 SG_ reaARS_DiagResponseData2 : 135|64@0+ (1,0) [0|0] ""  GW
 SG_ reaARS_DiagResponseData3 : 199|64@0+ (1,0) [0|0] ""  GW
 SG_ reaARS_DiagResponseData4 : 263|64@0+ (1,0) [0|0] ""  GW
 SG_ reaARS_DiagResponseData5 : 327|64@0+ (1,0) [0|0] ""  GW
 SG_ reaARS_DiagResponseData6 : 391|64@0+ (1,0) [0|0] ""  GW
 SG_ reaARS_DiagResponseData7 : 455|64@0+ (1,0) [0|0] ""  GW
 SG_ reaARS_DiagResponseData1 : 71|64@0+ (1,0) [0|0] ""  GW

BO_ 2015 Diag_Func: 64 GW
 SG_ DiagFunctionRequestData0 : 7|64@0+ (1,0) [0|0] ""  FR
 SG_ DiagFunctionRequestData2 : 135|64@0+ (1,0) [0|0] ""  FR
 SG_ DiagFunctionRequestData3 : 199|64@0+ (1,0) [0|0] ""  FR
 SG_ DiagFunctionRequestData4 : 263|64@0+ (1,0) [0|0] ""  FR
 SG_ DiagFunctionRequestData5 : 327|64@0+ (1,0) [0|0] ""  FR
 SG_ DiagFunctionRequestData6 : 391|64@0+ (1,0) [0|0] ""  FR
 SG_ DiagFunctionRequestData7 : 455|64@0+ (1,0) [0|0] ""  FR
 SG_ DiagFunctionRequestData1 : 71|64@0+ (1,0) [0|0] ""  FR

CM_ SG_ 527 ARS_OD_DistX_Obj_28 "Longitudinal distance of object_28
00????????";
CM_ SG_ 527 ARS_OD_Classification_Obj_28 "Classification of object_28
00??????";
CM_ SG_ 527 ARS_OD_AabsYStd_Obj_28 "Lateral absolution acceleration standard deviation of object_28
00????????????????";
CM_ SG_ 527 ARS_OD_ClassConf_Obj_28 "Classification confidence of object_28
00?????????";
CM_ SG_ 527 ARS_OD_ProbOfExist_Obj_28 "Existence probability of object_28
00????????";
CM_ SG_ 527 ARS_OD_DynConf_Obj_28 "Dynamic property confidence of object_28
00???????????";
CM_ SG_ 527 ARS_OD_VabsX_Obj_28 "Longitudinal absolution velocity over ground of object_28
00????????????";
CM_ SG_ 527 ARS_OD_DynProp_Obj_28 "Dynamic property of object_28
00????????";
CM_ SG_ 527 ARS_OD_MirrorProb_Obj_28 "Mirror probability of object_28
00????????";
CM_ SG_ 527 ARS_OD_Length_Obj_28 "Length of object_28
00??????";
CM_ SG_ 527 ARS_OD_MaintenanceState_Obj_28 "Maintenance state of object_28
00????????";
CM_ SG_ 527 ARS_OD_Width_Obj_28 "Width of object_28
00??????";
CM_ SG_ 527 ARS_OD_RCS_Obj_28 "RCS of object_28
00?????????";
CM_ SG_ 527 ARS_OD_Orientation_Obj_28 "Orientation of object_28
00???????";
CM_ SG_ 527 ARS_OD_YawRateAbs_Obj_28 "Yaw rate of object_28
00?????????";
CM_ SG_ 527 ARS_OD_YawRateAbsStd_Obj_28 "Yaw rate standard deviation of object_28
00????????????";
CM_ SG_ 527 ARS_OD_RefPoint_Obj_28 "Reference point of object_28
00???????";
CM_ SG_ 527 ARS_OD_LifeCycle_Obj_28 "Life cycle of object_28
00????????";
CM_ SG_ 527 ARS_OD_AabsX_Obj_28 "Longitudinal absolution acceleration over ground of object_28
00?????????????";
CM_ SG_ 527 ARS_OD_DistY_Obj_28 "Lateral distance of object_28
00????????";
CM_ SG_ 527 ARS_OD_OrientationStd_Obj_28 "Orientation standard deviation of object_28
00??????????";
CM_ SG_ 527 ARS_OD_ObstacleProb_Obj_28 "Obstacle probability of object_28
00?????????";
CM_ SG_ 527 ARS_OD_MicroDopplerFlag_28 "Micro-Doppler flag of object_28
00???????????";
CM_ SG_ 527 ARS_OD_VabsY_Obj_28 "Lateral absolution velocity over ground of object_28
00????????????";
CM_ SG_ 527 ARS_OD_AabsY_Obj_28 "Lateral absolution acceleration over ground of object_28
00?????????????";
CM_ SG_ 527 ARS_OD_DistXStd_Obj_28 "Longitudinal distance standard deviation of object_28
00???????????";
CM_ SG_ 527 ARS_OD_DistYStd_Obj_28 "Lateral distance standard deviation of object_28
00???????????";
CM_ SG_ 527 ARS_OD_VabsXStd_Obj_28 "Longitudinal absolution velocity standard deviation of object_28
00???????????????";
CM_ SG_ 527 ARS_OD_VabsYStd_Obj_28 "Lateral absolution velocity standard deviation of object_28
00???????????????";
CM_ SG_ 527 ARS_OD_AabsXStd_Obj_28 "Longitudinal absolution acceleration standard deviation of object_28
00????????????????";
CM_ SG_ 528 ARS_OD_DistX_Obj_30 "Longitudinal distance of object_30
00????????";
CM_ SG_ 528 ARS_OD_Classification_Obj_30 "Classification of object_30
00??????";
CM_ SG_ 528 ARS_OD_AabsYStd_Obj_30 "Lateral absolution acceleration standard deviation of object_30
00????????????????";
CM_ SG_ 528 ARS_OD_ClassConf_Obj_30 "Classification confidence of object_30
00?????????";
CM_ SG_ 528 ARS_OD_ProbOfExist_Obj_30 "Existence probability of object_30
00????????";
CM_ SG_ 528 ARS_OD_DynConf_Obj_30 "Dynamic property confidence of object_30
00???????????";
CM_ SG_ 528 ARS_OD_VabsX_Obj_30 "Longitudinal absolution velocity over ground of object_30
00????????????";
CM_ SG_ 528 ARS_OD_DynProp_Obj_30 "Dynamic property of object_30
00????????";
CM_ SG_ 528 ARS_OD_MirrorProb_Obj_30 "Mirror probability of object_30
00????????";
CM_ SG_ 528 ARS_OD_Length_Obj_30 "Length of object_30
00??????";
CM_ SG_ 528 ARS_OD_MaintenanceState_Obj_30 "Maintenance state of object_30
00????????";
CM_ SG_ 528 ARS_OD_Width_Obj_30 "Width of object_30
00??????";
CM_ SG_ 528 ARS_OD_RCS_Obj_30 "RCS of object_30
00?????????";
CM_ SG_ 528 ARS_OD_Orientation_Obj_30 "Orientation of object_30
00???????";
CM_ SG_ 528 ARS_OD_YawRateAbs_Obj_30 "Yaw rate of object_30
00?????????";
CM_ SG_ 528 ARS_OD_YawRateAbsStd_Obj_30 "Yaw rate standard deviation of object_30
00????????????";
CM_ SG_ 528 ARS_OD_RefPoint_Obj_30 "Reference point of object_30
00???????";
CM_ SG_ 528 ARS_OD_LifeCycle_Obj_30 "Life cycle of object_30
00????????";
CM_ SG_ 528 ARS_OD_AabsX_Obj_30 "Longitudinal absolution acceleration over ground of object_30
00?????????????";
CM_ SG_ 528 ARS_OD_DistY_Obj_30 "Lateral distance of object_30
00????????";
CM_ SG_ 528 ARS_OD_OrientationStd_Obj_30 "Orientation standard deviation of object_30
00??????????";
CM_ SG_ 528 ARS_OD_ObstacleProb_Obj_30 "Obstacle probability of object_30
00?????????";
CM_ SG_ 528 ARS_OD_MicroDopplerFlag_30 "Micro-Doppler flag of object_30
00???????????";
CM_ SG_ 528 ARS_OD_VabsY_Obj_30 "Lateral absolution velocity over ground of object_30
00????????????";
CM_ SG_ 528 ARS_OD_AabsY_Obj_30 "Lateral absolution acceleration over ground of object_30
00?????????????";
CM_ SG_ 528 ARS_OD_DistXStd_Obj_30 "Longitudinal distance standard deviation of object_30
00???????????";
CM_ SG_ 528 ARS_OD_DistYStd_Obj_30 "Lateral distance standard deviation of object_30
00???????????";
CM_ SG_ 528 ARS_OD_VabsXStd_Obj_30 "Longitudinal absolution velocity standard deviation of object_30
00???????????????";
CM_ SG_ 528 ARS_OD_VabsYStd_Obj_30 "Lateral absolution velocity standard deviation of object_30
00???????????????";
CM_ SG_ 528 ARS_OD_AabsXStd_Obj_30 "Longitudinal absolution acceleration standard deviation of object_30
00????????????????";
CM_ SG_ 529 ARS_OD_DistX_Obj_32 "Longitudinal distance of object_32
00????????";
CM_ SG_ 529 ARS_OD_Classification_Obj_32 "Classification of object_32
00??????";
CM_ SG_ 529 ARS_OD_AabsYStd_Obj_32 "Lateral absolution acceleration standard deviation of object_32
00????????????????";
CM_ SG_ 529 ARS_OD_ClassConf_Obj_32 "Classification confidence of object_32
00?????????";
CM_ SG_ 529 ARS_OD_ProbOfExist_Obj_32 "Existence probability of object_32
00????????";
CM_ SG_ 529 ARS_OD_DynConf_Obj_32 "Dynamic property confidence of object_32
00???????????";
CM_ SG_ 529 ARS_OD_VabsX_Obj_32 "Longitudinal absolution velocity over ground of object_32
00????????????";
CM_ SG_ 529 ARS_OD_DynProp_Obj_32 "Dynamic property of object_32
00????????";
CM_ SG_ 529 ARS_OD_MirrorProb_Obj_32 "Mirror probability of object_32
00????????";
CM_ SG_ 529 ARS_OD_Length_Obj_32 "Length of object_32
00??????";
CM_ SG_ 529 ARS_OD_MaintenanceState_Obj_32 "Maintenance state of object_32
00????????";
CM_ SG_ 529 ARS_OD_Width_Obj_32 "Width of object_32
00??????";
CM_ SG_ 529 ARS_OD_RCS_Obj_32 "RCS of object_32
00?????????";
CM_ SG_ 529 ARS_OD_Orientation_Obj_32 "Orientation of object_32
00???????";
CM_ SG_ 529 ARS_OD_YawRateAbs_Obj_32 "Yaw rate of object_32
00?????????";
CM_ SG_ 529 ARS_OD_YawRateAbsStd_Obj_32 "Yaw rate standard deviation of object_32
00????????????";
CM_ SG_ 529 ARS_OD_RefPoint_Obj_32 "Reference point of object_32
00???????";
CM_ SG_ 529 ARS_OD_LifeCycle_Obj_32 "Life cycle of object_32
00????????";
CM_ SG_ 529 ARS_OD_AabsX_Obj_32 "Longitudinal absolution acceleration over ground of object_32
00?????????????";
CM_ SG_ 529 ARS_OD_DistY_Obj_32 "Lateral distance of object_32
00????????";
CM_ SG_ 529 ARS_OD_OrientationStd_Obj_32 "Orientation standard deviation of object_32
00??????????";
CM_ SG_ 529 ARS_OD_ObstacleProb_Obj_32 "Obstacle probability of object_32
00?????????";
CM_ SG_ 529 ARS_OD_MicroDopplerFlag_32 "Micro-Doppler flag of object_32
00???????????";
CM_ SG_ 529 ARS_OD_VabsY_Obj_32 "Lateral absolution velocity over ground of object_32
00????????????";
CM_ SG_ 529 ARS_OD_AabsY_Obj_32 "Lateral absolution acceleration over ground of object_32
00?????????????";
CM_ SG_ 529 ARS_OD_DistXStd_Obj_32 "Longitudinal distance standard deviation of object_32
00???????????";
CM_ SG_ 529 ARS_OD_DistYStd_Obj_32 "Lateral distance standard deviation of object_32
00???????????";
CM_ SG_ 529 ARS_OD_VabsXStd_Obj_32 "Longitudinal absolution velocity standard deviation of object_32
00???????????????";
CM_ SG_ 529 ARS_OD_VabsYStd_Obj_32 "Lateral absolution velocity standard deviation of object_32
00???????????????";
CM_ SG_ 529 ARS_OD_AabsXStd_Obj_32 "Longitudinal absolution acceleration standard deviation of object_32
00????????????????";
CM_ SG_ 530 ARS_OD_DistX_Obj_34 "Longitudinal distance of object_34
00????????";
CM_ SG_ 530 ARS_OD_Classification_Obj_34 "Classification of object_34
00??????";
CM_ SG_ 530 ARS_OD_AabsYStd_Obj_34 "Lateral absolution acceleration standard deviation of object_34
00????????????????";
CM_ SG_ 530 ARS_OD_ClassConf_Obj_34 "Classification confidence of object_34
00?????????";
CM_ SG_ 530 ARS_OD_ProbOfExist_Obj_34 "Existence probability of object_34
00????????";
CM_ SG_ 530 ARS_OD_DynConf_Obj_34 "Dynamic property confidence of object_34
00???????????";
CM_ SG_ 530 ARS_OD_VabsX_Obj_34 "Longitudinal absolution velocity over ground of object_34
00????????????";
CM_ SG_ 530 ARS_OD_DynProp_Obj_34 "Dynamic property of object_34
00????????";
CM_ SG_ 530 ARS_OD_MirrorProb_Obj_34 "Mirror probability of object_34
00????????";
CM_ SG_ 530 ARS_OD_Length_Obj_34 "Length of object_34
00??????";
CM_ SG_ 530 ARS_OD_MaintenanceState_Obj_34 "Maintenance state of object_34
00????????";
CM_ SG_ 530 ARS_OD_Width_Obj_34 "Width of object_34
00??????";
CM_ SG_ 530 ARS_OD_RCS_Obj_34 "RCS of object_34
00?????????";
CM_ SG_ 530 ARS_OD_Orientation_Obj_34 "Orientation of object_34
00???????";
CM_ SG_ 530 ARS_OD_YawRateAbs_Obj_34 "Yaw rate of object_34
00?????????";
CM_ SG_ 530 ARS_OD_YawRateAbsStd_Obj_34 "Yaw rate standard deviation of object_34
00????????????";
CM_ SG_ 530 ARS_OD_RefPoint_Obj_34 "Reference point of object_34
00???????";
CM_ SG_ 530 ARS_OD_LifeCycle_Obj_34 "Life cycle of object_34
00????????";
CM_ SG_ 530 ARS_OD_AabsX_Obj_34 "Longitudinal absolution acceleration over ground of object_34
00?????????????";
CM_ SG_ 530 ARS_OD_DistY_Obj_34 "Lateral distance of object_34
00????????";
CM_ SG_ 530 ARS_OD_OrientationStd_Obj_34 "Orientation standard deviation of object_34
00??????????";
CM_ SG_ 530 ARS_OD_ObstacleProb_Obj_34 "Obstacle probability of object_34
00?????????";
CM_ SG_ 530 ARS_OD_MicroDopplerFlag_34 "Micro-Doppler flag of object_34
00???????????";
CM_ SG_ 530 ARS_OD_VabsY_Obj_34 "Lateral absolution velocity over ground of object_34
00????????????";
CM_ SG_ 530 ARS_OD_AabsY_Obj_34 "Lateral absolution acceleration over ground of object_34
00?????????????";
CM_ SG_ 530 ARS_OD_DistXStd_Obj_34 "Longitudinal distance standard deviation of object_34
00???????????";
CM_ SG_ 530 ARS_OD_DistYStd_Obj_34 "Lateral distance standard deviation of object_34
00???????????";
CM_ SG_ 530 ARS_OD_VabsXStd_Obj_34 "Longitudinal absolution velocity standard deviation of object_34
00???????????????";
CM_ SG_ 530 ARS_OD_VabsYStd_Obj_34 "Lateral absolution velocity standard deviation of object_34
00???????????????";
CM_ SG_ 530 ARS_OD_AabsXStd_Obj_34 "Longitudinal absolution acceleration standard deviation of object_34
00????????????????";
CM_ SG_ 531 ARS_OD_DistX_Obj_36 "Longitudinal distance of object_36
00????????";
CM_ SG_ 531 ARS_OD_Classification_Obj_36 "Classification of object_36
00??????";
CM_ SG_ 531 ARS_OD_AabsYStd_Obj_36 "Lateral absolution acceleration standard deviation of object_36
00????????????????";
CM_ SG_ 531 ARS_OD_ClassConf_Obj_36 "Classification confidence of object_36
00?????????";
CM_ SG_ 531 ARS_OD_ProbOfExist_Obj_36 "Existence probability of object_36
00????????";
CM_ SG_ 531 ARS_OD_DynConf_Obj_36 "Dynamic property confidence of object_36
00???????????";
CM_ SG_ 531 ARS_OD_VabsX_Obj_36 "Longitudinal absolution velocity over ground of object_36
00????????????";
CM_ SG_ 531 ARS_OD_DynProp_Obj_36 "Dynamic property of object_36
00????????";
CM_ SG_ 531 ARS_OD_MirrorProb_Obj_36 "Mirror probability of object_36
00????????";
CM_ SG_ 531 ARS_OD_Length_Obj_36 "Length of object_36
00??????";
CM_ SG_ 531 ARS_OD_MaintenanceState_Obj_36 "Maintenance state of object_36
00????????";
CM_ SG_ 531 ARS_OD_Width_Obj_36 "Width of object_36
00??????";
CM_ SG_ 531 ARS_OD_RCS_Obj_36 "RCS of object_36
00?????????";
CM_ SG_ 531 ARS_OD_Orientation_Obj_36 "Orientation of object_36
00???????";
CM_ SG_ 531 ARS_OD_YawRateAbs_Obj_36 "Yaw rate of object_36
00?????????";
CM_ SG_ 531 ARS_OD_YawRateAbsStd_Obj_36 "Yaw rate standard deviation of object_36
00????????????";
CM_ SG_ 531 ARS_OD_RefPoint_Obj_36 "Reference point of object_36
00???????";
CM_ SG_ 531 ARS_OD_LifeCycle_Obj_36 "Life cycle of object_36
00????????";
CM_ SG_ 531 ARS_OD_AabsX_Obj_36 "Longitudinal absolution acceleration over ground of object_36
00?????????????";
CM_ SG_ 531 ARS_OD_DistY_Obj_36 "Lateral distance of object_36
00????????";
CM_ SG_ 531 ARS_OD_OrientationStd_Obj_36 "Orientation standard deviation of object_36
00??????????";
CM_ SG_ 531 ARS_OD_ObstacleProb_Obj_36 "Obstacle probability of object_36
00?????????";
CM_ SG_ 531 ARS_OD_MicroDopplerFlag_36 "Micro-Doppler flag of object_36
00???????????";
CM_ SG_ 531 ARS_OD_VabsY_Obj_36 "Lateral absolution velocity over ground of object_36
00????????????";
CM_ SG_ 531 ARS_OD_AabsY_Obj_36 "Lateral absolution acceleration over ground of object_36
00?????????????";
CM_ SG_ 531 ARS_OD_DistXStd_Obj_36 "Longitudinal distance standard deviation of object_36
00???????????";
CM_ SG_ 531 ARS_OD_DistYStd_Obj_36 "Lateral distance standard deviation of object_36
00???????????";
CM_ SG_ 531 ARS_OD_VabsXStd_Obj_36 "Longitudinal absolution velocity standard deviation of object_36
00???????????????";
CM_ SG_ 531 ARS_OD_VabsYStd_Obj_36 "Lateral absolution velocity standard deviation of object_36
00???????????????";
CM_ SG_ 531 ARS_OD_AabsXStd_Obj_36 "Longitudinal absolution acceleration standard deviation of object_36
00????????????????";
CM_ SG_ 532 ARS_OD_DistX_Obj_38 "Longitudinal distance of object_38
00????????";
CM_ SG_ 532 ARS_OD_Classification_Obj_38 "Classification of object_38
00??????";
CM_ SG_ 532 ARS_OD_AabsYStd_Obj_38 "Lateral absolution acceleration standard deviation of object_38
00????????????????";
CM_ SG_ 532 ARS_OD_ClassConf_Obj_38 "Classification confidence of object_38
00?????????";
CM_ SG_ 532 ARS_OD_ProbOfExist_Obj_38 "Existence probability of object_38
00????????";
CM_ SG_ 532 ARS_OD_DynConf_Obj_38 "Dynamic property confidence of object_38
00???????????";
CM_ SG_ 532 ARS_OD_VabsX_Obj_38 "Longitudinal absolution velocity over ground of object_38
00????????????";
CM_ SG_ 532 ARS_OD_DynProp_Obj_38 "Dynamic property of object_38
00????????";
CM_ SG_ 532 ARS_OD_MirrorProb_Obj_38 "Mirror probability of object_38
00????????";
CM_ SG_ 532 ARS_OD_Length_Obj_38 "Length of object_38
00??????";
CM_ SG_ 532 ARS_OD_MaintenanceState_Obj_38 "Maintenance state of object_38
00????????";
CM_ SG_ 532 ARS_OD_Width_Obj_38 "Width of object_38
00??????";
CM_ SG_ 532 ARS_OD_RCS_Obj_38 "RCS of object_38
00?????????";
CM_ SG_ 532 ARS_OD_Orientation_Obj_38 "Orientation of object_38
00???????";
CM_ SG_ 532 ARS_OD_YawRateAbs_Obj_38 "Yaw rate of object_38
00?????????";
CM_ SG_ 532 ARS_OD_YawRateAbsStd_Obj_38 "Yaw rate standard deviation of object_38
00????????????";
CM_ SG_ 532 ARS_OD_RefPoint_Obj_38 "Reference point of object_38
00???????";
CM_ SG_ 532 ARS_OD_LifeCycle_Obj_38 "Life cycle of object_38
00????????";
CM_ SG_ 532 ARS_OD_AabsX_Obj_38 "Longitudinal absolution acceleration over ground of object_38
00?????????????";
CM_ SG_ 532 ARS_OD_DistY_Obj_38 "Lateral distance of object_38
00????????";
CM_ SG_ 532 ARS_OD_OrientationStd_Obj_38 "Orientation standard deviation of object_38
00??????????";
CM_ SG_ 532 ARS_OD_ObstacleProb_Obj_38 "Obstacle probability of object_38
00?????????";
CM_ SG_ 532 ARS_OD_MicroDopplerFlag_38 "Micro-Doppler flag of object_38
00???????????";
CM_ SG_ 532 ARS_OD_VabsY_Obj_38 "Lateral absolution velocity over ground of object_38
00????????????";
CM_ SG_ 532 ARS_OD_AabsY_Obj_38 "Lateral absolution acceleration over ground of object_38
00?????????????";
CM_ SG_ 532 ARS_OD_DistXStd_Obj_38 "Longitudinal distance standard deviation of object_38
00???????????";
CM_ SG_ 532 ARS_OD_DistYStd_Obj_38 "Lateral distance standard deviation of object_38
00???????????";
CM_ SG_ 532 ARS_OD_VabsXStd_Obj_38 "Longitudinal absolution velocity standard deviation of object_38
00???????????????";
CM_ SG_ 532 ARS_OD_VabsYStd_Obj_38 "Lateral absolution velocity standard deviation of object_38
00???????????????";
CM_ SG_ 532 ARS_OD_AabsXStd_Obj_38 "Longitudinal absolution acceleration standard deviation of object_38
00????????????????";
CM_ SG_ 533 ARS_OD_DistX_Obj_40 "Longitudinal distance of object_40
00????????";
CM_ SG_ 533 ARS_OD_Classification_Obj_40 "Classification of object_40
00??????";
CM_ SG_ 533 ARS_OD_AabsYStd_Obj_40 "Lateral absolution acceleration standard deviation of object_40
00????????????????";
CM_ SG_ 533 ARS_OD_ClassConf_Obj_40 "Classification confidence of object_40
00?????????";
CM_ SG_ 533 ARS_OD_ProbOfExist_Obj_40 "Existence probability of object_40
00????????";
CM_ SG_ 533 ARS_OD_DynConf_Obj_40 "Dynamic property confidence of object_40
00???????????";
CM_ SG_ 533 ARS_OD_VabsX_Obj_40 "Longitudinal absolution velocity over ground of object_40
00????????????";
CM_ SG_ 533 ARS_OD_DynProp_Obj_40 "Dynamic property of object_40
00????????";
CM_ SG_ 533 ARS_OD_MirrorProb_Obj_40 "Mirror probability of object_40
00????????";
CM_ SG_ 533 ARS_OD_Length_Obj_40 "Length of object_40
00??????";
CM_ SG_ 533 ARS_OD_MaintenanceState_Obj_40 "Maintenance state of object_40
00????????";
CM_ SG_ 533 ARS_OD_Width_Obj_40 "Width of object_40
00??????";
CM_ SG_ 533 ARS_OD_RCS_Obj_40 "RCS of object_40
00?????????";
CM_ SG_ 533 ARS_OD_Orientation_Obj_40 "Orientation of object_40
00???????";
CM_ SG_ 533 ARS_OD_YawRateAbs_Obj_40 "Yaw rate of object_40
00?????????";
CM_ SG_ 533 ARS_OD_YawRateAbsStd_Obj_40 "Yaw rate standard deviation of object_40
00????????????";
CM_ SG_ 533 ARS_OD_RefPoint_Obj_40 "Reference point of object_40
00???????";
CM_ SG_ 533 ARS_OD_LifeCycle_Obj_40 "Life cycle of object_40
00????????";
CM_ SG_ 533 ARS_OD_AabsX_Obj_40 "Longitudinal absolution acceleration over ground of object_40
00?????????????";
CM_ SG_ 533 ARS_OD_DistY_Obj_40 "Lateral distance of object_40
00????????";
CM_ SG_ 533 ARS_OD_OrientationStd_Obj_40 "Orientation standard deviation of object_40
00??????????";
CM_ SG_ 533 ARS_OD_ObstacleProb_Obj_40 "Obstacle probability of object_40
00?????????";
CM_ SG_ 533 ARS_OD_MicroDopplerFlag_40 "Micro-Doppler flag of object_40
00???????????";
CM_ SG_ 533 ARS_OD_VabsY_Obj_40 "Lateral absolution velocity over ground of object_40
00????????????";
CM_ SG_ 533 ARS_OD_AabsY_Obj_40 "Lateral absolution acceleration over ground of object_40
00?????????????";
CM_ SG_ 533 ARS_OD_DistXStd_Obj_40 "Longitudinal distance standard deviation of object_40
00???????????";
CM_ SG_ 533 ARS_OD_DistYStd_Obj_40 "Lateral distance standard deviation of object_40
00???????????";
CM_ SG_ 533 ARS_OD_VabsXStd_Obj_40 "Longitudinal absolution velocity standard deviation of object_40
00???????????????";
CM_ SG_ 533 ARS_OD_VabsYStd_Obj_40 "Lateral absolution velocity standard deviation of object_40
00???????????????";
CM_ SG_ 533 ARS_OD_AabsXStd_Obj_40 "Longitudinal absolution acceleration standard deviation of object_40
00????????????????";
CM_ SG_ 534 ARS_OD_DistX_Obj_42 "Longitudinal distance of object_42
00????????";
CM_ SG_ 534 ARS_OD_Classification_Obj_42 "Classification of object_42
00??????";
CM_ SG_ 534 ARS_OD_AabsYStd_Obj_42 "Lateral absolution acceleration standard deviation of object_42
00????????????????";
CM_ SG_ 534 ARS_OD_ClassConf_Obj_42 "Classification confidence of object_42
00?????????";
CM_ SG_ 534 ARS_OD_ProbOfExist_Obj_42 "Existence probability of object_42
00????????";
CM_ SG_ 534 ARS_OD_DynConf_Obj_42 "Dynamic property confidence of object_42
00???????????";
CM_ SG_ 534 ARS_OD_VabsX_Obj_42 "Longitudinal absolution velocity over ground of object_42
00????????????";
CM_ SG_ 534 ARS_OD_DynProp_Obj_42 "Dynamic property of object_42
00????????";
CM_ SG_ 534 ARS_OD_MirrorProb_Obj_42 "Mirror probability of object_42
00????????";
CM_ SG_ 534 ARS_OD_Length_Obj_42 "Length of object_42
00??????";
CM_ SG_ 534 ARS_OD_MaintenanceState_Obj_42 "Maintenance state of object_42
00????????";
CM_ SG_ 534 ARS_OD_Width_Obj_42 "Width of object_42
00??????";
CM_ SG_ 534 ARS_OD_RCS_Obj_42 "RCS of object_42
00?????????";
CM_ SG_ 534 ARS_OD_Orientation_Obj_42 "Orientation of object_42
00???????";
CM_ SG_ 534 ARS_OD_YawRateAbs_Obj_42 "Yaw rate of object_42
00?????????";
CM_ SG_ 534 ARS_OD_YawRateAbsStd_Obj_42 "Yaw rate standard deviation of object_42
00????????????";
CM_ SG_ 534 ARS_OD_RefPoint_Obj_42 "Reference point of object_42
00???????";
CM_ SG_ 534 ARS_OD_LifeCycle_Obj_42 "Life cycle of object_42
00????????";
CM_ SG_ 534 ARS_OD_AabsX_Obj_42 "Longitudinal absolution acceleration over ground of object_42
00?????????????";
CM_ SG_ 534 ARS_OD_DistY_Obj_42 "Lateral distance of object_42
00????????";
CM_ SG_ 534 ARS_OD_OrientationStd_Obj_42 "Orientation standard deviation of object_42
00??????????";
CM_ SG_ 534 ARS_OD_ObstacleProb_Obj_42 "Obstacle probability of object_42
00?????????";
CM_ SG_ 534 ARS_OD_MicroDopplerFlag_42 "Micro-Doppler flag of object_42
00???????????";
CM_ SG_ 534 ARS_OD_VabsY_Obj_42 "Lateral absolution velocity over ground of object_42
00????????????";
CM_ SG_ 534 ARS_OD_AabsY_Obj_42 "Lateral absolution acceleration over ground of object_42
00?????????????";
CM_ SG_ 534 ARS_OD_DistXStd_Obj_42 "Longitudinal distance standard deviation of object_42
00???????????";
CM_ SG_ 534 ARS_OD_DistYStd_Obj_42 "Lateral distance standard deviation of object_42
00???????????";
CM_ SG_ 534 ARS_OD_VabsXStd_Obj_42 "Longitudinal absolution velocity standard deviation of object_42
00???????????????";
CM_ SG_ 534 ARS_OD_VabsYStd_Obj_42 "Lateral absolution velocity standard deviation of object_42
00???????????????";
CM_ SG_ 534 ARS_OD_AabsXStd_Obj_42 "Longitudinal absolution acceleration standard deviation of object_42
00????????????????";
CM_ SG_ 535 ARS_OD_DistX_Obj_44 "Longitudinal distance of object_44
00????????";
CM_ SG_ 535 ARS_OD_Classification_Obj_44 "Classification of object_44
00??????";
CM_ SG_ 535 ARS_OD_AabsYStd_Obj_44 "Lateral absolution acceleration standard deviation of object_44
00????????????????";
CM_ SG_ 535 ARS_OD_ClassConf_Obj_44 "Classification confidence of object_44
00?????????";
CM_ SG_ 535 ARS_OD_ProbOfExist_Obj_44 "Existence probability of object_44
00????????";
CM_ SG_ 535 ARS_OD_DynConf_Obj_44 "Dynamic property confidence of object_44
00???????????";
CM_ SG_ 535 ARS_OD_VabsX_Obj_44 "Longitudinal absolution velocity over ground of object_44
00????????????";
CM_ SG_ 535 ARS_OD_DynProp_Obj_44 "Dynamic property of object_44
00????????";
CM_ SG_ 535 ARS_OD_MirrorProb_Obj_44 "Mirror probability of object_44
00????????";
CM_ SG_ 535 ARS_OD_Length_Obj_44 "Length of object_44
00??????";
CM_ SG_ 535 ARS_OD_MaintenanceState_Obj_44 "Maintenance state of object_44
00????????";
CM_ SG_ 535 ARS_OD_Width_Obj_44 "Width of object_44
00??????";
CM_ SG_ 535 ARS_OD_RCS_Obj_44 "RCS of object_44
00?????????";
CM_ SG_ 535 ARS_OD_Orientation_Obj_44 "Orientation of object_44
00???????";
CM_ SG_ 535 ARS_OD_YawRateAbs_Obj_44 "Yaw rate of object_44
00?????????";
CM_ SG_ 535 ARS_OD_YawRateAbsStd_Obj_44 "Yaw rate standard deviation of object_44
00????????????";
CM_ SG_ 535 ARS_OD_RefPoint_Obj_44 "Reference point of object_44
00???????";
CM_ SG_ 535 ARS_OD_LifeCycle_Obj_44 "Life cycle of object_44
00????????";
CM_ SG_ 535 ARS_OD_AabsX_Obj_44 "Longitudinal absolution acceleration over ground of object_44
00?????????????";
CM_ SG_ 535 ARS_OD_DistY_Obj_44 "Lateral distance of object_44
00????????";
CM_ SG_ 535 ARS_OD_OrientationStd_Obj_44 "Orientation standard deviation of object_44
00??????????";
CM_ SG_ 535 ARS_OD_ObstacleProb_Obj_44 "Obstacle probability of object_44
00?????????";
CM_ SG_ 535 ARS_OD_MicroDopplerFlag_44 "Micro-Doppler flag of object_44
00???????????";
CM_ SG_ 535 ARS_OD_VabsY_Obj_44 "Lateral absolution velocity over ground of object_44
00????????????";
CM_ SG_ 535 ARS_OD_AabsY_Obj_44 "Lateral absolution acceleration over ground of object_44
00?????????????";
CM_ SG_ 535 ARS_OD_DistXStd_Obj_44 "Longitudinal distance standard deviation of object_44
00???????????";
CM_ SG_ 535 ARS_OD_DistYStd_Obj_44 "Lateral distance standard deviation of object_44
00???????????";
CM_ SG_ 535 ARS_OD_VabsXStd_Obj_44 "Longitudinal absolution velocity standard deviation of object_44
00???????????????";
CM_ SG_ 535 ARS_OD_VabsYStd_Obj_44 "Lateral absolution velocity standard deviation of object_44
00???????????????";
CM_ SG_ 535 ARS_OD_AabsXStd_Obj_44 "Longitudinal absolution acceleration standard deviation of object_44
00????????????????";
CM_ SG_ 536 ARS_OD_DistX_Obj_46 "Longitudinal distance of object_46
00????????";
CM_ SG_ 536 ARS_OD_Classification_Obj_46 "Classification of object_46
00??????";
CM_ SG_ 536 ARS_OD_AabsYStd_Obj_46 "Lateral absolution acceleration standard deviation of object_46
00????????????????";
CM_ SG_ 536 ARS_OD_ClassConf_Obj_46 "Classification confidence of object_46
00?????????";
CM_ SG_ 536 ARS_OD_ProbOfExist_Obj_46 "Existence probability of object_46
00????????";
CM_ SG_ 536 ARS_OD_DynConf_Obj_46 "Dynamic property confidence of object_46
00???????????";
CM_ SG_ 536 ARS_OD_VabsX_Obj_46 "Longitudinal absolution velocity over ground of object_46
00????????????";
CM_ SG_ 536 ARS_OD_DynProp_Obj_46 "Dynamic property of object_46
00????????";
CM_ SG_ 536 ARS_OD_MirrorProb_Obj_46 "Mirror probability of object_46
00????????";
CM_ SG_ 536 ARS_OD_Length_Obj_46 "Length of object_46
00??????";
CM_ SG_ 536 ARS_OD_MaintenanceState_Obj_46 "Maintenance state of object_46
00????????";
CM_ SG_ 536 ARS_OD_Width_Obj_46 "Width of object_46
00??????";
CM_ SG_ 536 ARS_OD_RCS_Obj_46 "RCS of object_46
00?????????";
CM_ SG_ 536 ARS_OD_Orientation_Obj_46 "Orientation of object_46
00???????";
CM_ SG_ 536 ARS_OD_YawRateAbs_Obj_46 "Yaw rate of object_46
00?????????";
CM_ SG_ 536 ARS_OD_YawRateAbsStd_Obj_46 "Yaw rate standard deviation of object_46
00????????????";
CM_ SG_ 536 ARS_OD_RefPoint_Obj_46 "Reference point of object_46
00???????";
CM_ SG_ 536 ARS_OD_LifeCycle_Obj_46 "Life cycle of object_46
00????????";
CM_ SG_ 536 ARS_OD_AabsX_Obj_46 "Longitudinal absolution acceleration over ground of object_46
00?????????????";
CM_ SG_ 536 ARS_OD_DistY_Obj_46 "Lateral distance of object_46
00????????";
CM_ SG_ 536 ARS_OD_OrientationStd_Obj_46 "Orientation standard deviation of object_46
00??????????";
CM_ SG_ 536 ARS_OD_ObstacleProb_Obj_46 "Obstacle probability of object_46
00?????????";
CM_ SG_ 536 ARS_OD_MicroDopplerFlag_46 "Micro-Doppler flag of object_46
00???????????";
CM_ SG_ 536 ARS_OD_VabsY_Obj_46 "Lateral absolution velocity over ground of object_46
00????????????";
CM_ SG_ 536 ARS_OD_AabsY_Obj_46 "Lateral absolution acceleration over ground of object_46
00?????????????";
CM_ SG_ 536 ARS_OD_DistXStd_Obj_46 "Longitudinal distance standard deviation of object_46
00???????????";
CM_ SG_ 536 ARS_OD_DistYStd_Obj_46 "Lateral distance standard deviation of object_46
00???????????";
CM_ SG_ 536 ARS_OD_VabsXStd_Obj_46 "Longitudinal absolution velocity standard deviation of object_46
00???????????????";
CM_ SG_ 536 ARS_OD_VabsYStd_Obj_46 "Lateral absolution velocity standard deviation of object_46
00???????????????";
CM_ SG_ 536 ARS_OD_AabsXStd_Obj_46 "Longitudinal absolution acceleration standard deviation of object_46
00????????????????";
CM_ SG_ 537 ARS_OD_DistX_Obj_48 "Longitudinal distance of object_48
00????????";
CM_ SG_ 537 ARS_OD_Classification_Obj_48 "Classification of object_48
00??????";
CM_ SG_ 537 ARS_OD_AabsYStd_Obj_48 "Lateral absolution acceleration standard deviation of object_48
00????????????????";
CM_ SG_ 537 ARS_OD_ClassConf_Obj_48 "Classification confidence of object_48
00?????????";
CM_ SG_ 537 ARS_OD_ProbOfExist_Obj_48 "Existence probability of object_48
00????????";
CM_ SG_ 537 ARS_OD_DynConf_Obj_48 "Dynamic property confidence of object_48
00???????????";
CM_ SG_ 537 ARS_OD_VabsX_Obj_48 "Longitudinal absolution velocity over ground of object_48
00????????????";
CM_ SG_ 537 ARS_OD_DynProp_Obj_48 "Dynamic property of object_48
00????????";
CM_ SG_ 537 ARS_OD_MirrorProb_Obj_48 "Mirror probability of object_48
00????????";
CM_ SG_ 537 ARS_OD_Length_Obj_48 "Length of object_48
00??????";
CM_ SG_ 537 ARS_OD_MaintenanceState_Obj_48 "Maintenance state of object_48
00????????";
CM_ SG_ 537 ARS_OD_Width_Obj_48 "Width of object_48
00??????";
CM_ SG_ 537 ARS_OD_RCS_Obj_48 "RCS of object_48
00?????????";
CM_ SG_ 537 ARS_OD_Orientation_Obj_48 "Orientation of object_48
00???????";
CM_ SG_ 537 ARS_OD_YawRateAbs_Obj_48 "Yaw rate of object_48
00?????????";
CM_ SG_ 537 ARS_OD_YawRateAbsStd_Obj_48 "Yaw rate standard deviation of object_48
00????????????";
CM_ SG_ 537 ARS_OD_RefPoint_Obj_48 "Reference point of object_48
00???????";
CM_ SG_ 537 ARS_OD_LifeCycle_Obj_48 "Life cycle of object_48
00????????";
CM_ SG_ 537 ARS_OD_AabsX_Obj_48 "Longitudinal absolution acceleration over ground of object_48
00?????????????";
CM_ SG_ 537 ARS_OD_DistY_Obj_48 "Lateral distance of object_48
00????????";
CM_ SG_ 537 ARS_OD_OrientationStd_Obj_48 "Orientation standard deviation of object_48
00??????????";
CM_ SG_ 537 ARS_OD_ObstacleProb_Obj_48 "Obstacle probability of object_48
00?????????";
CM_ SG_ 537 ARS_OD_MicroDopplerFlag_48 "Micro-Doppler flag of object_48
00???????????";
CM_ SG_ 537 ARS_OD_VabsY_Obj_48 "Lateral absolution velocity over ground of object_48
00????????????";
CM_ SG_ 537 ARS_OD_AabsY_Obj_48 "Lateral absolution acceleration over ground of object_48
00?????????????";
CM_ SG_ 537 ARS_OD_DistXStd_Obj_48 "Longitudinal distance standard deviation of object_48
00???????????";
CM_ SG_ 537 ARS_OD_DistYStd_Obj_48 "Lateral distance standard deviation of object_48
00???????????";
CM_ SG_ 537 ARS_OD_VabsXStd_Obj_48 "Longitudinal absolution velocity standard deviation of object_48
00???????????????";
CM_ SG_ 537 ARS_OD_VabsYStd_Obj_48 "Lateral absolution velocity standard deviation of object_48
00???????????????";
CM_ SG_ 537 ARS_OD_AabsXStd_Obj_48 "Longitudinal absolution acceleration standard deviation of object_48
00????????????????";
CM_ SG_ 538 ARS_OD_DistX_Obj_50 "Longitudinal distance of object_50
00????????";
CM_ SG_ 538 ARS_OD_Classification_Obj_50 "Classification of object_50
00??????";
CM_ SG_ 538 ARS_OD_AabsYStd_Obj_50 "Lateral absolution acceleration standard deviation of object_50
00????????????????";
CM_ SG_ 538 ARS_OD_ClassConf_Obj_50 "Classification confidence of object_50
00?????????";
CM_ SG_ 538 ARS_OD_ProbOfExist_Obj_50 "Existence probability of object_50
00????????";
CM_ SG_ 538 ARS_OD_DynConf_Obj_50 "Dynamic property confidence of object_50
00???????????";
CM_ SG_ 538 ARS_OD_VabsX_Obj_50 "Longitudinal absolution velocity over ground of object_50
00????????????";
CM_ SG_ 538 ARS_OD_DynProp_Obj_50 "Dynamic property of object_50
00????????";
CM_ SG_ 538 ARS_OD_MirrorProb_Obj_50 "Mirror probability of object_50
00????????";
CM_ SG_ 538 ARS_OD_Length_Obj_50 "Length of object_50
00??????";
CM_ SG_ 538 ARS_OD_MaintenanceState_Obj_50 "Maintenance state of object_50
00????????";
CM_ SG_ 538 ARS_OD_Width_Obj_50 "Width of object_50
00??????";
CM_ SG_ 538 ARS_OD_RCS_Obj_50 "RCS of object_50
00?????????";
CM_ SG_ 538 ARS_OD_Orientation_Obj_50 "Orientation of object_50
00???????";
CM_ SG_ 538 ARS_OD_YawRateAbs_Obj_50 "Yaw rate of object_50
00?????????";
CM_ SG_ 538 ARS_OD_YawRateAbsStd_Obj_50 "Yaw rate standard deviation of object_50
00????????????";
CM_ SG_ 538 ARS_OD_RefPoint_Obj_50 "Reference point of object_50
00???????";
CM_ SG_ 538 ARS_OD_LifeCycle_Obj_50 "Life cycle of object_50
00????????";
CM_ SG_ 538 ARS_OD_AabsX_Obj_50 "Longitudinal absolution acceleration over ground of object_50
00?????????????";
CM_ SG_ 538 ARS_OD_DistY_Obj_50 "Lateral distance of object_50
00????????";
CM_ SG_ 538 ARS_OD_OrientationStd_Obj_50 "Orientation standard deviation of object_50
00??????????";
CM_ SG_ 538 ARS_OD_ObstacleProb_Obj_50 "Obstacle probability of object_50
00?????????";
CM_ SG_ 538 ARS_OD_MicroDopplerFlag_50 "Micro-Doppler flag of object_50
00???????????";
CM_ SG_ 538 ARS_OD_VabsY_Obj_50 "Lateral absolution velocity over ground of object_50
00????????????";
CM_ SG_ 538 ARS_OD_AabsY_Obj_50 "Lateral absolution acceleration over ground of object_50
00?????????????";
CM_ SG_ 538 ARS_OD_DistXStd_Obj_50 "Longitudinal distance standard deviation of object_50
00???????????";
CM_ SG_ 538 ARS_OD_DistYStd_Obj_50 "Lateral distance standard deviation of object_50
00???????????";
CM_ SG_ 538 ARS_OD_VabsXStd_Obj_50 "Longitudinal absolution velocity standard deviation of object_50
00???????????????";
CM_ SG_ 538 ARS_OD_VabsYStd_Obj_50 "Lateral absolution velocity standard deviation of object_50
00???????????????";
CM_ SG_ 538 ARS_OD_AabsXStd_Obj_50 "Longitudinal absolution acceleration standard deviation of object_50
00????????????????";
CM_ SG_ 539 ARS_OD_DistX_Obj_52 "Longitudinal distance of object_52
00????????";
CM_ SG_ 539 ARS_OD_Classification_Obj_52 "Classification of object_52
00??????";
CM_ SG_ 539 ARS_OD_AabsYStd_Obj_52 "Lateral absolution acceleration standard deviation of object_52
00????????????????";
CM_ SG_ 539 ARS_OD_ClassConf_Obj_52 "Classification confidence of object_52
00?????????";
CM_ SG_ 539 ARS_OD_ProbOfExist_Obj_52 "Existence probability of object_52
00????????";
CM_ SG_ 539 ARS_OD_DynConf_Obj_52 "Dynamic property confidence of object_52
00???????????";
CM_ SG_ 539 ARS_OD_VabsX_Obj_52 "Longitudinal absolution velocity over ground of object_52
00????????????";
CM_ SG_ 539 ARS_OD_DynProp_Obj_52 "Dynamic property of object_52
00????????";
CM_ SG_ 539 ARS_OD_MirrorProb_Obj_52 "Mirror probability of object_52
00????????";
CM_ SG_ 539 ARS_OD_Length_Obj_52 "Length of object_52
00??????";
CM_ SG_ 539 ARS_OD_MaintenanceState_Obj_52 "Maintenance state of object_52
00????????";
CM_ SG_ 539 ARS_OD_Width_Obj_52 "Width of object_52
00??????";
CM_ SG_ 539 ARS_OD_RCS_Obj_52 "RCS of object_52
00?????????";
CM_ SG_ 539 ARS_OD_Orientation_Obj_52 "Orientation of object_52
00???????";
CM_ SG_ 539 ARS_OD_YawRateAbs_Obj_52 "Yaw rate of object_52
00?????????";
CM_ SG_ 539 ARS_OD_YawRateAbsStd_Obj_52 "Yaw rate standard deviation of object_52
00????????????";
CM_ SG_ 539 ARS_OD_RefPoint_Obj_52 "Reference point of object_52
00???????";
CM_ SG_ 539 ARS_OD_LifeCycle_Obj_52 "Life cycle of object_52
00????????";
CM_ SG_ 539 ARS_OD_AabsX_Obj_52 "Longitudinal absolution acceleration over ground of object_52
00?????????????";
CM_ SG_ 539 ARS_OD_DistY_Obj_52 "Lateral distance of object_52
00????????";
CM_ SG_ 539 ARS_OD_OrientationStd_Obj_52 "Orientation standard deviation of object_52
00??????????";
CM_ SG_ 539 ARS_OD_ObstacleProb_Obj_52 "Obstacle probability of object_52
00?????????";
CM_ SG_ 539 ARS_OD_MicroDopplerFlag_52 "Micro-Doppler flag of object_52
00???????????";
CM_ SG_ 539 ARS_OD_VabsY_Obj_52 "Lateral absolution velocity over ground of object_52
00????????????";
CM_ SG_ 539 ARS_OD_AabsY_Obj_52 "Lateral absolution acceleration over ground of object_52
00?????????????";
CM_ SG_ 539 ARS_OD_DistXStd_Obj_52 "Longitudinal distance standard deviation of object_52
00???????????";
CM_ SG_ 539 ARS_OD_DistYStd_Obj_52 "Lateral distance standard deviation of object_52
00???????????";
CM_ SG_ 539 ARS_OD_VabsXStd_Obj_52 "Longitudinal absolution velocity standard deviation of object_52
00???????????????";
CM_ SG_ 539 ARS_OD_VabsYStd_Obj_52 "Lateral absolution velocity standard deviation of object_52
00???????????????";
CM_ SG_ 539 ARS_OD_AabsXStd_Obj_52 "Longitudinal absolution acceleration standard deviation of object_52
00????????????????";
CM_ SG_ 540 ARS_OD_DistX_Obj_54 "Longitudinal distance of object_54
00????????";
CM_ SG_ 540 ARS_OD_Classification_Obj_54 "Classification of object_54
00??????";
CM_ SG_ 540 ARS_OD_AabsYStd_Obj_54 "Lateral absolution acceleration standard deviation of object_54
00????????????????";
CM_ SG_ 540 ARS_OD_ClassConf_Obj_54 "Classification confidence of object_54
00?????????";
CM_ SG_ 540 ARS_OD_ProbOfExist_Obj_54 "Existence probability of object_54
00????????";
CM_ SG_ 540 ARS_OD_DynConf_Obj_54 "Dynamic property confidence of object_54
00???????????";
CM_ SG_ 540 ARS_OD_VabsX_Obj_54 "Longitudinal absolution velocity over ground of object_54
00????????????";
CM_ SG_ 540 ARS_OD_DynProp_Obj_54 "Dynamic property of object_54
00????????";
CM_ SG_ 540 ARS_OD_MirrorProb_Obj_54 "Mirror probability of object_54
00????????";
CM_ SG_ 540 ARS_OD_Length_Obj_54 "Length of object_54
00??????";
CM_ SG_ 540 ARS_OD_MaintenanceState_Obj_54 "Maintenance state of object_54
00????????";
CM_ SG_ 540 ARS_OD_Width_Obj_54 "Width of object_54
00??????";
CM_ SG_ 540 ARS_OD_RCS_Obj_54 "RCS of object_54
00?????????";
CM_ SG_ 540 ARS_OD_Orientation_Obj_54 "Orientation of object_54
00???????";
CM_ SG_ 540 ARS_OD_YawRateAbs_Obj_54 "Yaw rate of object_54
00?????????";
CM_ SG_ 540 ARS_OD_YawRateAbsStd_Obj_54 "Yaw rate standard deviation of object_54
00????????????";
CM_ SG_ 540 ARS_OD_RefPoint_Obj_54 "Reference point of object_54
00???????";
CM_ SG_ 540 ARS_OD_LifeCycle_Obj_54 "Life cycle of object_54
00????????";
CM_ SG_ 540 ARS_OD_AabsX_Obj_54 "Longitudinal absolution acceleration over ground of object_54
00?????????????";
CM_ SG_ 540 ARS_OD_DistY_Obj_54 "Lateral distance of object_54
00????????";
CM_ SG_ 540 ARS_OD_OrientationStd_Obj_54 "Orientation standard deviation of object_54
00??????????";
CM_ SG_ 540 ARS_OD_ObstacleProb_Obj_54 "Obstacle probability of object_54
00?????????";
CM_ SG_ 540 ARS_OD_MicroDopplerFlag_54 "Micro-Doppler flag of object_54
00???????????";
CM_ SG_ 540 ARS_OD_VabsY_Obj_54 "Lateral absolution velocity over ground of object_54
00????????????";
CM_ SG_ 540 ARS_OD_AabsY_Obj_54 "Lateral absolution acceleration over ground of object_54
00?????????????";
CM_ SG_ 540 ARS_OD_DistXStd_Obj_54 "Longitudinal distance standard deviation of object_54
00???????????";
CM_ SG_ 540 ARS_OD_DistYStd_Obj_54 "Lateral distance standard deviation of object_54
00???????????";
CM_ SG_ 540 ARS_OD_VabsXStd_Obj_54 "Longitudinal absolution velocity standard deviation of object_54
00???????????????";
CM_ SG_ 540 ARS_OD_VabsYStd_Obj_54 "Lateral absolution velocity standard deviation of object_54
00???????????????";
CM_ SG_ 540 ARS_OD_AabsXStd_Obj_54 "Longitudinal absolution acceleration standard deviation of object_54
00????????????????";
CM_ SG_ 541 ARS_OD_DistX_Obj_56 "Longitudinal distance of object_56
00????????";
CM_ SG_ 541 ARS_OD_Classification_Obj_56 "Classification of object_56
00??????";
CM_ SG_ 541 ARS_OD_AabsYStd_Obj_56 "Lateral absolution acceleration standard deviation of object_56
00????????????????";
CM_ SG_ 541 ARS_OD_ClassConf_Obj_56 "Classification confidence of object_56
00?????????";
CM_ SG_ 541 ARS_OD_ProbOfExist_Obj_56 "Existence probability of object_56
00????????";
CM_ SG_ 541 ARS_OD_DynConf_Obj_56 "Dynamic property confidence of object_56
00???????????";
CM_ SG_ 541 ARS_OD_VabsX_Obj_56 "Longitudinal absolution velocity over ground of object_56
00????????????";
CM_ SG_ 541 ARS_OD_DynProp_Obj_56 "Dynamic property of object_56
00????????";
CM_ SG_ 541 ARS_OD_MirrorProb_Obj_56 "Mirror probability of object_56
00????????";
CM_ SG_ 541 ARS_OD_Length_Obj_56 "Length of object_56
00??????";
CM_ SG_ 541 ARS_OD_MaintenanceState_Obj_56 "Maintenance state of object_56
00????????";
CM_ SG_ 541 ARS_OD_Width_Obj_56 "Width of object_56
00??????";
CM_ SG_ 541 ARS_OD_RCS_Obj_56 "RCS of object_56
00?????????";
CM_ SG_ 541 ARS_OD_Orientation_Obj_56 "Orientation of object_56
00???????";
CM_ SG_ 541 ARS_OD_YawRateAbs_Obj_56 "Yaw rate of object_56
00?????????";
CM_ SG_ 541 ARS_OD_YawRateAbsStd_Obj_56 "Yaw rate standard deviation of object_56
00????????????";
CM_ SG_ 541 ARS_OD_RefPoint_Obj_56 "Reference point of object_56
00???????";
CM_ SG_ 541 ARS_OD_LifeCycle_Obj_56 "Life cycle of object_56
00????????";
CM_ SG_ 541 ARS_OD_AabsX_Obj_56 "Longitudinal absolution acceleration over ground of object_56
00?????????????";
CM_ SG_ 541 ARS_OD_DistY_Obj_56 "Lateral distance of object_56
00????????";
CM_ SG_ 541 ARS_OD_OrientationStd_Obj_56 "Orientation standard deviation of object_56
00??????????";
CM_ SG_ 541 ARS_OD_ObstacleProb_Obj_56 "Obstacle probability of object_56
00?????????";
CM_ SG_ 541 ARS_OD_MicroDopplerFlag_56 "Micro-Doppler flag of object_56
00???????????";
CM_ SG_ 541 ARS_OD_VabsY_Obj_56 "Lateral absolution velocity over ground of object_56
00????????????";
CM_ SG_ 541 ARS_OD_AabsY_Obj_56 "Lateral absolution acceleration over ground of object_56
00?????????????";
CM_ SG_ 541 ARS_OD_DistXStd_Obj_56 "Longitudinal distance standard deviation of object_56
00???????????";
CM_ SG_ 541 ARS_OD_DistYStd_Obj_56 "Lateral distance standard deviation of object_56
00???????????";
CM_ SG_ 541 ARS_OD_VabsXStd_Obj_56 "Longitudinal absolution velocity standard deviation of object_56
00???????????????";
CM_ SG_ 541 ARS_OD_VabsYStd_Obj_56 "Lateral absolution velocity standard deviation of object_56
00???????????????";
CM_ SG_ 541 ARS_OD_AabsXStd_Obj_56 "Longitudinal absolution acceleration standard deviation of object_56
00????????????????";
CM_ SG_ 542 ARS_OD_DistX_Obj_58 "Longitudinal distance of object_58
00????????";
CM_ SG_ 542 ARS_OD_Classification_Obj_58 "Classification of object_58
00??????";
CM_ SG_ 542 ARS_OD_AabsYStd_Obj_58 "Lateral absolution acceleration standard deviation of object_58
00????????????????";
CM_ SG_ 542 ARS_OD_ClassConf_Obj_58 "Classification confidence of object_58
00?????????";
CM_ SG_ 542 ARS_OD_ProbOfExist_Obj_58 "Existence probability of object_58
00????????";
CM_ SG_ 542 ARS_OD_DynConf_Obj_58 "Dynamic property confidence of object_58
00???????????";
CM_ SG_ 542 ARS_OD_VabsX_Obj_58 "Longitudinal absolution velocity over ground of object_58
00????????????";
CM_ SG_ 542 ARS_OD_DynProp_Obj_58 "Dynamic property of object_58
00????????";
CM_ SG_ 542 ARS_OD_MirrorProb_Obj_58 "Mirror probability of object_58
00????????";
CM_ SG_ 542 ARS_OD_Length_Obj_58 "Length of object_58
00??????";
CM_ SG_ 542 ARS_OD_MaintenanceState_Obj_58 "Maintenance state of object_58
00????????";
CM_ SG_ 542 ARS_OD_Width_Obj_58 "Width of object_58
00??????";
CM_ SG_ 542 ARS_OD_RCS_Obj_58 "RCS of object_58
00?????????";
CM_ SG_ 542 ARS_OD_Orientation_Obj_58 "Orientation of object_58
00???????";
CM_ SG_ 542 ARS_OD_YawRateAbs_Obj_58 "Yaw rate of object_58
00?????????";
CM_ SG_ 542 ARS_OD_YawRateAbsStd_Obj_58 "Yaw rate standard deviation of object_58
00????????????";
CM_ SG_ 542 ARS_OD_RefPoint_Obj_58 "Reference point of object_58
00???????";
CM_ SG_ 542 ARS_OD_LifeCycle_Obj_58 "Life cycle of object_58
00????????";
CM_ SG_ 542 ARS_OD_AabsX_Obj_58 "Longitudinal absolution acceleration over ground of object_58
00?????????????";
CM_ SG_ 542 ARS_OD_DistY_Obj_58 "Lateral distance of object_58
00????????";
CM_ SG_ 542 ARS_OD_OrientationStd_Obj_58 "Orientation standard deviation of object_58
00??????????";
CM_ SG_ 542 ARS_OD_ObstacleProb_Obj_58 "Obstacle probability of object_58
00?????????";
CM_ SG_ 542 ARS_OD_MicroDopplerFlag_58 "Micro-Doppler flag of object_58
00???????????";
CM_ SG_ 542 ARS_OD_VabsY_Obj_58 "Lateral absolution velocity over ground of object_58
00????????????";
CM_ SG_ 542 ARS_OD_AabsY_Obj_58 "Lateral absolution acceleration over ground of object_58
00?????????????";
CM_ SG_ 542 ARS_OD_DistXStd_Obj_58 "Longitudinal distance standard deviation of object_58
00???????????";
CM_ SG_ 542 ARS_OD_DistYStd_Obj_58 "Lateral distance standard deviation of object_58
00???????????";
CM_ SG_ 542 ARS_OD_VabsXStd_Obj_58 "Longitudinal absolution velocity standard deviation of object_58
00???????????????";
CM_ SG_ 542 ARS_OD_VabsYStd_Obj_58 "Lateral absolution velocity standard deviation of object_58
00???????????????";
CM_ SG_ 542 ARS_OD_AabsXStd_Obj_58 "Longitudinal absolution acceleration standard deviation of object_58
00????????????????";
CM_ SG_ 543 ARS_RD_ClothoidParam_1 "Parameter 1 of 3rd-order cloithoid for road model
??clothoid????????1";
CM_ SG_ 543 ARS_RD_NofLane_Left "Number of lanes on the left to the ego lane
????????";
CM_ SG_ 543 ARS_RD_NofLaneProb_Left "Probability of number of lanes on the left to the ego lane
??????????";
CM_ SG_ 543 ARS_RD_Confidence_Right "Condidence right curve
???????";
CM_ SG_ 543 ARS_RD_NofLane_Right "Number of lanes on the right to the ego lane
????????";
CM_ SG_ 543 ARS_RD_NofLaneProb_Right "Probability of number of lanes on the right to the ego lane
??????????";
CM_ SG_ 543 ARS_RD_ClothoidParam_2 "Parameter 2 of 3rd-order cloithoid for road model
??clothoid????????2";
CM_ SG_ 543 ARS_RD_RoadType "Road type
????";
CM_ SG_ 543 ARS_RD_ClothoidParam_3 "Parameter 3 of 3rd-order cloithoid for road model
??clothoid????????3";
CM_ SG_ 543 ARS_RD_RoadTypeConf "Road type confidence
???????";
CM_ SG_ 543 ARS_RD_Xstart_Left "Longitudinal start of left curve
???????????";
CM_ SG_ 543 ARS_RD_Xstart_Right "Longitudinal start of right curve
???????????";
CM_ SG_ 543 ARS_RD_Xend_Left "Longitudinal end of left curve
???????????";
CM_ SG_ 543 ARS_RD_Xend_Right "Longitudinal end of right curve
???????????";
CM_ SG_ 543 ARS_RD_LatOffset_Left "Lateral offset of left curve
????????";
CM_ SG_ 543 ARS_RD_LatOffset_Right "Lateral offset of right curve
????????";
CM_ SG_ 543 ARS_RD_Confidence_Left "Condidence left curve
???????";
BA_DEF_ BO_  "DiagRequest" ENUM  "no","yes";
BA_DEF_ BO_  "DiagResponse" ENUM  "no","yes";
BA_DEF_ BO_  "GenMsgCycleTime" INT 0 0;
BA_DEF_ BO_  "GenMsgSendType" ENUM  "Cyclic","NotUsed","Event","NotUsed","NotUsed","NotUsed","NotUsed","IfActive","NoMsgSendType","NotUsed";
BA_DEF_ BO_  "VFrameFormat" ENUM  "StandardCAN","ExtendedCAN","RESERVED","RESERVED","RESERVED","RESERVED","RESERVED","RESERVED","RESERVED","RESERVED","RESERVED","RESERVED","RESERVED","RESERVED","StandardCAN_FD","ExtendedCAN_FD";
BA_DEF_ SG_  "GenSigSendType" ENUM  "Cyclic","OnWrite","OnWriteWithRepetition","OnChange","OnChangeWithRepetition","IfActive","IfActiveWithRepetition","NoSigSendType","NotUsed","NotUsed","NotUsed","NotUsed","NotUsed";
BA_DEF_ SG_  "GenSigStartValue" INT 0 0;
BA_DEF_ SG_  "SystemSignalLongSymbol" STRING ;
BA_DEF_DEF_  "DiagRequest" "no";
BA_DEF_DEF_  "DiagResponse" "no";
BA_DEF_DEF_  "GenMsgCycleTime" 0;
BA_DEF_DEF_  "GenMsgSendType" "Cyclic";
BA_DEF_DEF_  "VFrameFormat" "ExtendedCAN_FD";
BA_DEF_DEF_  "GenSigSendType" "Cyclic";
BA_DEF_DEF_  "GenSigStartValue" 0;
BA_DEF_DEF_  "SystemSignalLongSymbol" "";
BA_ "GenMsgSendType" BO_ 527 2;
BA_ "VFrameFormat" BO_ 527 14;
BA_ "GenMsgSendType" BO_ 528 2;
BA_ "VFrameFormat" BO_ 528 14;
BA_ "GenMsgSendType" BO_ 529 2;
BA_ "VFrameFormat" BO_ 529 14;
BA_ "GenMsgSendType" BO_ 530 2;
BA_ "VFrameFormat" BO_ 530 14;
BA_ "GenMsgSendType" BO_ 531 2;
BA_ "VFrameFormat" BO_ 531 14;
BA_ "GenMsgSendType" BO_ 532 2;
BA_ "VFrameFormat" BO_ 532 14;
BA_ "GenMsgSendType" BO_ 533 2;
BA_ "VFrameFormat" BO_ 533 14;
BA_ "GenMsgSendType" BO_ 534 2;
BA_ "VFrameFormat" BO_ 534 14;
BA_ "GenMsgSendType" BO_ 535 2;
BA_ "VFrameFormat" BO_ 535 14;
BA_ "GenMsgSendType" BO_ 536 2;
BA_ "VFrameFormat" BO_ 536 14;
BA_ "GenMsgSendType" BO_ 537 2;
BA_ "VFrameFormat" BO_ 537 14;
BA_ "GenMsgSendType" BO_ 538 2;
BA_ "VFrameFormat" BO_ 538 14;
BA_ "GenMsgSendType" BO_ 539 2;
BA_ "VFrameFormat" BO_ 539 14;
BA_ "GenMsgSendType" BO_ 540 2;
BA_ "VFrameFormat" BO_ 540 14;
BA_ "GenMsgSendType" BO_ 541 2;
BA_ "VFrameFormat" BO_ 541 14;
BA_ "GenMsgSendType" BO_ 542 2;
BA_ "VFrameFormat" BO_ 542 14;
BA_ "GenMsgSendType" BO_ 543 2;
BA_ "VFrameFormat" BO_ 543 14;
BA_ "GenMsgSendType" BO_ 1793 2;
BA_ "VFrameFormat" BO_ 1793 14;
BA_ "GenMsgSendType" BO_ 1798 2;
BA_ "DiagRequest" BO_ 1798 1;
BA_ "VFrameFormat" BO_ 1798 14;
BA_ "GenMsgSendType" BO_ 1889 2;
BA_ "VFrameFormat" BO_ 1889 14;
BA_ "DiagResponse" BO_ 1894 1;
BA_ "GenMsgSendType" BO_ 1894 2;
BA_ "VFrameFormat" BO_ 1894 14;
BA_ "GenMsgSendType" BO_ 2015 2;
BA_ "VFrameFormat" BO_ 2015 14;
BA_ "GenSigStartValue" SG_ 527 ARS_OD_DistX_Obj_28 1143;
BA_ "GenSigStartValue" SG_ 527 ARS_OD_VabsX_Obj_28 1024;
BA_ "GenSigStartValue" SG_ 527 ARS_OD_RCS_Obj_28 256;
BA_ "GenSigStartValue" SG_ 527 ARS_OD_Orientation_Obj_28 511;
BA_ "GenSigStartValue" SG_ 527 ARS_OD_YawRateAbs_Obj_28 511;
BA_ "GenSigStartValue" SG_ 527 ARS_OD_DistX_Obj_29 1143;
BA_ "GenSigStartValue" SG_ 527 ARS_OD_VabsX_Obj_29 1024;
BA_ "GenSigStartValue" SG_ 527 ARS_OD_AabsX_Obj_29 255;
BA_ "GenSigStartValue" SG_ 527 ARS_OD_AabsX_Obj_28 255;
BA_ "GenSigStartValue" SG_ 527 ARS_OD_DistY_Obj_29 2047;
BA_ "GenSigStartValue" SG_ 527 ARS_OD_VabsY_Obj_29 1024;
BA_ "GenSigStartValue" SG_ 527 ARS_OD_AabsY_Obj_29 255;
BA_ "GenSigStartValue" SG_ 527 ARS_OD_DistY_Obj_28 2047;
BA_ "GenSigStartValue" SG_ 527 ARS_OD_RCS_Obj_29 256;
BA_ "GenSigStartValue" SG_ 527 ARS_OD_Orientation_Obj_29 511;
BA_ "GenSigStartValue" SG_ 527 ARS_OD_YawRateAbs_Obj_29 511;
BA_ "GenSigStartValue" SG_ 527 ARS_OD_VabsY_Obj_28 1024;
BA_ "GenSigStartValue" SG_ 527 ARS_OD_ID_28 255;
BA_ "GenSigStartValue" SG_ 527 ARS_OD_ID_29 255;
BA_ "GenSigStartValue" SG_ 527 ARS_OD_AabsY_Obj_28 255;
BA_ "GenSigStartValue" SG_ 528 ARS_OD_DistX_Obj_30 1143;
BA_ "GenSigStartValue" SG_ 528 ARS_OD_VabsX_Obj_30 1024;
BA_ "GenSigStartValue" SG_ 528 ARS_OD_RCS_Obj_30 256;
BA_ "GenSigStartValue" SG_ 528 ARS_OD_Orientation_Obj_30 511;
BA_ "GenSigStartValue" SG_ 528 ARS_OD_YawRateAbs_Obj_30 511;
BA_ "GenSigStartValue" SG_ 528 ARS_OD_DistX_Obj_31 1143;
BA_ "GenSigStartValue" SG_ 528 ARS_OD_VabsX_Obj_31 1024;
BA_ "GenSigStartValue" SG_ 528 ARS_OD_AabsX_Obj_31 255;
BA_ "GenSigStartValue" SG_ 528 ARS_OD_AabsX_Obj_30 255;
BA_ "GenSigStartValue" SG_ 528 ARS_OD_DistY_Obj_31 2047;
BA_ "GenSigStartValue" SG_ 528 ARS_OD_VabsY_Obj_31 1024;
BA_ "GenSigStartValue" SG_ 528 ARS_OD_AabsY_Obj_31 255;
BA_ "GenSigStartValue" SG_ 528 ARS_OD_DistY_Obj_30 2047;
BA_ "GenSigStartValue" SG_ 528 ARS_OD_RCS_Obj_31 256;
BA_ "GenSigStartValue" SG_ 528 ARS_OD_Orientation_Obj_31 511;
BA_ "GenSigStartValue" SG_ 528 ARS_OD_YawRateAbs_Obj_31 511;
BA_ "GenSigStartValue" SG_ 528 ARS_OD_VabsY_Obj_30 1024;
BA_ "GenSigStartValue" SG_ 528 ARS_OD_ID_30 255;
BA_ "GenSigStartValue" SG_ 528 ARS_OD_ID_31 255;
BA_ "GenSigStartValue" SG_ 528 ARS_OD_AabsY_Obj_30 255;
BA_ "GenSigStartValue" SG_ 529 ARS_OD_DistX_Obj_32 1143;
BA_ "GenSigStartValue" SG_ 529 ARS_OD_VabsX_Obj_32 1024;
BA_ "GenSigStartValue" SG_ 529 ARS_OD_RCS_Obj_32 256;
BA_ "GenSigStartValue" SG_ 529 ARS_OD_Orientation_Obj_32 511;
BA_ "GenSigStartValue" SG_ 529 ARS_OD_YawRateAbs_Obj_32 511;
BA_ "GenSigStartValue" SG_ 529 ARS_OD_DistX_Obj_33 1143;
BA_ "GenSigStartValue" SG_ 529 ARS_OD_VabsX_Obj_33 1024;
BA_ "GenSigStartValue" SG_ 529 ARS_OD_AabsX_Obj_33 255;
BA_ "GenSigStartValue" SG_ 529 ARS_OD_AabsX_Obj_32 255;
BA_ "GenSigStartValue" SG_ 529 ARS_OD_DistY_Obj_33 2047;
BA_ "GenSigStartValue" SG_ 529 ARS_OD_VabsY_Obj_33 1024;
BA_ "GenSigStartValue" SG_ 529 ARS_OD_AabsY_Obj_33 255;
BA_ "GenSigStartValue" SG_ 529 ARS_OD_DistY_Obj_32 2047;
BA_ "GenSigStartValue" SG_ 529 ARS_OD_RCS_Obj_33 256;
BA_ "GenSigStartValue" SG_ 529 ARS_OD_Orientation_Obj_33 511;
BA_ "GenSigStartValue" SG_ 529 ARS_OD_YawRateAbs_Obj_33 511;
BA_ "GenSigStartValue" SG_ 529 ARS_OD_VabsY_Obj_32 1024;
BA_ "GenSigStartValue" SG_ 529 ARS_OD_ID_32 255;
BA_ "GenSigStartValue" SG_ 529 ARS_OD_ID_33 255;
BA_ "GenSigStartValue" SG_ 529 ARS_OD_AabsY_Obj_32 255;
BA_ "GenSigStartValue" SG_ 530 ARS_OD_DistX_Obj_34 1143;
BA_ "GenSigStartValue" SG_ 530 ARS_OD_VabsX_Obj_34 1024;
BA_ "GenSigStartValue" SG_ 530 ARS_OD_RCS_Obj_34 256;
BA_ "GenSigStartValue" SG_ 530 ARS_OD_Orientation_Obj_34 511;
BA_ "GenSigStartValue" SG_ 530 ARS_OD_YawRateAbs_Obj_34 511;
BA_ "GenSigStartValue" SG_ 530 ARS_OD_DistX_Obj_35 1143;
BA_ "GenSigStartValue" SG_ 530 ARS_OD_VabsX_Obj_35 1024;
BA_ "GenSigStartValue" SG_ 530 ARS_OD_AabsX_Obj_35 255;
BA_ "GenSigStartValue" SG_ 530 ARS_OD_AabsX_Obj_34 255;
BA_ "GenSigStartValue" SG_ 530 ARS_OD_DistY_Obj_35 2047;
BA_ "GenSigStartValue" SG_ 530 ARS_OD_VabsY_Obj_35 1024;
BA_ "GenSigStartValue" SG_ 530 ARS_OD_AabsY_Obj_35 255;
BA_ "GenSigStartValue" SG_ 530 ARS_OD_DistY_Obj_34 2047;
BA_ "GenSigStartValue" SG_ 530 ARS_OD_RCS_Obj_35 256;
BA_ "GenSigStartValue" SG_ 530 ARS_OD_Orientation_Obj_35 511;
BA_ "GenSigStartValue" SG_ 530 ARS_OD_YawRateAbs_Obj_35 511;
BA_ "GenSigStartValue" SG_ 530 ARS_OD_VabsY_Obj_34 1024;
BA_ "GenSigStartValue" SG_ 530 ARS_OD_ID_34 255;
BA_ "GenSigStartValue" SG_ 530 ARS_OD_ID_35 255;
BA_ "GenSigStartValue" SG_ 530 ARS_OD_AabsY_Obj_34 255;
BA_ "GenSigStartValue" SG_ 531 ARS_OD_DistX_Obj_36 1143;
BA_ "GenSigStartValue" SG_ 531 ARS_OD_VabsX_Obj_36 1024;
BA_ "GenSigStartValue" SG_ 531 ARS_OD_RCS_Obj_36 256;
BA_ "GenSigStartValue" SG_ 531 ARS_OD_Orientation_Obj_36 511;
BA_ "GenSigStartValue" SG_ 531 ARS_OD_YawRateAbs_Obj_36 511;
BA_ "GenSigStartValue" SG_ 531 ARS_OD_DistX_Obj_37 1143;
BA_ "GenSigStartValue" SG_ 531 ARS_OD_VabsX_Obj_37 1024;
BA_ "GenSigStartValue" SG_ 531 ARS_OD_AabsX_Obj_37 255;
BA_ "GenSigStartValue" SG_ 531 ARS_OD_AabsX_Obj_36 255;
BA_ "GenSigStartValue" SG_ 531 ARS_OD_DistY_Obj_37 2047;
BA_ "GenSigStartValue" SG_ 531 ARS_OD_VabsY_Obj_37 1024;
BA_ "GenSigStartValue" SG_ 531 ARS_OD_AabsY_Obj_37 255;
BA_ "GenSigStartValue" SG_ 531 ARS_OD_DistY_Obj_36 2047;
BA_ "GenSigStartValue" SG_ 531 ARS_OD_RCS_Obj_37 256;
BA_ "GenSigStartValue" SG_ 531 ARS_OD_Orientation_Obj_37 511;
BA_ "GenSigStartValue" SG_ 531 ARS_OD_YawRateAbs_Obj_37 511;
BA_ "GenSigStartValue" SG_ 531 ARS_OD_VabsY_Obj_36 1024;
BA_ "GenSigStartValue" SG_ 531 ARS_OD_ID_36 255;
BA_ "GenSigStartValue" SG_ 531 ARS_OD_ID_37 255;
BA_ "GenSigStartValue" SG_ 531 ARS_OD_AabsY_Obj_36 255;
BA_ "GenSigStartValue" SG_ 532 ARS_OD_DistX_Obj_38 1143;
BA_ "GenSigStartValue" SG_ 532 ARS_OD_VabsX_Obj_38 1024;
BA_ "GenSigStartValue" SG_ 532 ARS_OD_RCS_Obj_38 256;
BA_ "GenSigStartValue" SG_ 532 ARS_OD_Orientation_Obj_38 511;
BA_ "GenSigStartValue" SG_ 532 ARS_OD_YawRateAbs_Obj_38 511;
BA_ "GenSigStartValue" SG_ 532 ARS_OD_DistX_Obj_39 1143;
BA_ "GenSigStartValue" SG_ 532 ARS_OD_VabsX_Obj_39 1024;
BA_ "GenSigStartValue" SG_ 532 ARS_OD_AabsX_Obj_39 255;
BA_ "GenSigStartValue" SG_ 532 ARS_OD_AabsX_Obj_38 255;
BA_ "GenSigStartValue" SG_ 532 ARS_OD_DistY_Obj_39 2047;
BA_ "GenSigStartValue" SG_ 532 ARS_OD_VabsY_Obj_39 1024;
BA_ "GenSigStartValue" SG_ 532 ARS_OD_AabsY_Obj_39 255;
BA_ "GenSigStartValue" SG_ 532 ARS_OD_DistY_Obj_38 2047;
BA_ "GenSigStartValue" SG_ 532 ARS_OD_RCS_Obj_39 256;
BA_ "GenSigStartValue" SG_ 532 ARS_OD_Orientation_Obj_39 511;
BA_ "GenSigStartValue" SG_ 532 ARS_OD_YawRateAbs_Obj_39 511;
BA_ "GenSigStartValue" SG_ 532 ARS_OD_VabsY_Obj_38 1024;
BA_ "GenSigStartValue" SG_ 532 ARS_OD_ID_38 255;
BA_ "GenSigStartValue" SG_ 532 ARS_OD_ID_39 255;
BA_ "GenSigStartValue" SG_ 532 ARS_OD_AabsY_Obj_38 255;
BA_ "GenSigStartValue" SG_ 533 ARS_OD_DistX_Obj_40 1143;
BA_ "GenSigStartValue" SG_ 533 ARS_OD_VabsX_Obj_40 1024;
BA_ "GenSigStartValue" SG_ 533 ARS_OD_RCS_Obj_40 256;
BA_ "GenSigStartValue" SG_ 533 ARS_OD_Orientation_Obj_40 511;
BA_ "GenSigStartValue" SG_ 533 ARS_OD_YawRateAbs_Obj_40 511;
BA_ "GenSigStartValue" SG_ 533 ARS_OD_DistX_Obj_41 1143;
BA_ "GenSigStartValue" SG_ 533 ARS_OD_VabsX_Obj_41 1024;
BA_ "GenSigStartValue" SG_ 533 ARS_OD_AabsX_Obj_41 255;
BA_ "GenSigStartValue" SG_ 533 ARS_OD_AabsX_Obj_40 255;
BA_ "GenSigStartValue" SG_ 533 ARS_OD_DistY_Obj_41 2047;
BA_ "GenSigStartValue" SG_ 533 ARS_OD_VabsY_Obj_41 1024;
BA_ "GenSigStartValue" SG_ 533 ARS_OD_AabsY_Obj_41 255;
BA_ "GenSigStartValue" SG_ 533 ARS_OD_DistY_Obj_40 2047;
BA_ "GenSigStartValue" SG_ 533 ARS_OD_RCS_Obj_41 256;
BA_ "GenSigStartValue" SG_ 533 ARS_OD_Orientation_Obj_41 511;
BA_ "GenSigStartValue" SG_ 533 ARS_OD_YawRateAbs_Obj_41 511;
BA_ "GenSigStartValue" SG_ 533 ARS_OD_VabsY_Obj_40 1024;
BA_ "GenSigStartValue" SG_ 533 ARS_OD_ID_40 255;
BA_ "GenSigStartValue" SG_ 533 ARS_OD_ID_41 255;
BA_ "GenSigStartValue" SG_ 533 ARS_OD_AabsY_Obj_40 255;
BA_ "GenSigStartValue" SG_ 534 ARS_OD_DistX_Obj_42 1143;
BA_ "GenSigStartValue" SG_ 534 ARS_OD_VabsX_Obj_42 1024;
BA_ "GenSigStartValue" SG_ 534 ARS_OD_RCS_Obj_42 256;
BA_ "GenSigStartValue" SG_ 534 ARS_OD_Orientation_Obj_42 511;
BA_ "GenSigStartValue" SG_ 534 ARS_OD_YawRateAbs_Obj_42 511;
BA_ "GenSigStartValue" SG_ 534 ARS_OD_DistX_Obj_43 1143;
BA_ "GenSigStartValue" SG_ 534 ARS_OD_VabsX_Obj_43 1024;
BA_ "GenSigStartValue" SG_ 534 ARS_OD_AabsX_Obj_43 255;
BA_ "GenSigStartValue" SG_ 534 ARS_OD_AabsX_Obj_42 255;
BA_ "GenSigStartValue" SG_ 534 ARS_OD_DistY_Obj_43 2047;
BA_ "GenSigStartValue" SG_ 534 ARS_OD_VabsY_Obj_43 1024;
BA_ "GenSigStartValue" SG_ 534 ARS_OD_AabsY_Obj_43 255;
BA_ "GenSigStartValue" SG_ 534 ARS_OD_DistY_Obj_42 2047;
BA_ "GenSigStartValue" SG_ 534 ARS_OD_RCS_Obj_43 256;
BA_ "GenSigStartValue" SG_ 534 ARS_OD_Orientation_Obj_43 511;
BA_ "GenSigStartValue" SG_ 534 ARS_OD_YawRateAbs_Obj_43 511;
BA_ "GenSigStartValue" SG_ 534 ARS_OD_VabsY_Obj_42 1024;
BA_ "GenSigStartValue" SG_ 534 ARS_OD_ID_42 255;
BA_ "GenSigStartValue" SG_ 534 ARS_OD_ID_43 255;
BA_ "GenSigStartValue" SG_ 534 ARS_OD_AabsY_Obj_42 255;
BA_ "GenSigStartValue" SG_ 535 ARS_OD_DistX_Obj_44 1143;
BA_ "GenSigStartValue" SG_ 535 ARS_OD_VabsX_Obj_44 1024;
BA_ "GenSigStartValue" SG_ 535 ARS_OD_RCS_Obj_44 256;
BA_ "GenSigStartValue" SG_ 535 ARS_OD_Orientation_Obj_44 511;
BA_ "GenSigStartValue" SG_ 535 ARS_OD_YawRateAbs_Obj_44 511;
BA_ "GenSigStartValue" SG_ 535 ARS_OD_DistX_Obj_45 1143;
BA_ "GenSigStartValue" SG_ 535 ARS_OD_VabsX_Obj_45 1024;
BA_ "GenSigStartValue" SG_ 535 ARS_OD_AabsX_Obj_45 255;
BA_ "GenSigStartValue" SG_ 535 ARS_OD_AabsX_Obj_44 255;
BA_ "GenSigStartValue" SG_ 535 ARS_OD_DistY_Obj_45 2047;
BA_ "GenSigStartValue" SG_ 535 ARS_OD_VabsY_Obj_45 1024;
BA_ "GenSigStartValue" SG_ 535 ARS_OD_AabsY_Obj_45 255;
BA_ "GenSigStartValue" SG_ 535 ARS_OD_DistY_Obj_44 2047;
BA_ "GenSigStartValue" SG_ 535 ARS_OD_RCS_Obj_45 256;
BA_ "GenSigStartValue" SG_ 535 ARS_OD_Orientation_Obj_45 511;
BA_ "GenSigStartValue" SG_ 535 ARS_OD_YawRateAbs_Obj_45 511;
BA_ "GenSigStartValue" SG_ 535 ARS_OD_VabsY_Obj_44 1024;
BA_ "GenSigStartValue" SG_ 535 ARS_OD_ID_44 255;
BA_ "GenSigStartValue" SG_ 535 ARS_OD_ID_45 255;
BA_ "GenSigStartValue" SG_ 535 ARS_OD_AabsY_Obj_44 255;
BA_ "GenSigStartValue" SG_ 536 ARS_OD_DistX_Obj_46 1143;
BA_ "GenSigStartValue" SG_ 536 ARS_OD_VabsX_Obj_46 1024;
BA_ "GenSigStartValue" SG_ 536 ARS_OD_RCS_Obj_46 256;
BA_ "GenSigStartValue" SG_ 536 ARS_OD_Orientation_Obj_46 511;
BA_ "GenSigStartValue" SG_ 536 ARS_OD_YawRateAbs_Obj_46 511;
BA_ "GenSigStartValue" SG_ 536 ARS_OD_DistX_Obj_47 1143;
BA_ "GenSigStartValue" SG_ 536 ARS_OD_VabsX_Obj_47 1024;
BA_ "GenSigStartValue" SG_ 536 ARS_OD_AabsX_Obj_47 255;
BA_ "GenSigStartValue" SG_ 536 ARS_OD_AabsX_Obj_46 255;
BA_ "GenSigStartValue" SG_ 536 ARS_OD_DistY_Obj_47 2047;
BA_ "GenSigStartValue" SG_ 536 ARS_OD_VabsY_Obj_47 1024;
BA_ "GenSigStartValue" SG_ 536 ARS_OD_AabsY_Obj_47 255;
BA_ "GenSigStartValue" SG_ 536 ARS_OD_DistY_Obj_46 2047;
BA_ "GenSigStartValue" SG_ 536 ARS_OD_RCS_Obj_47 256;
BA_ "GenSigStartValue" SG_ 536 ARS_OD_Orientation_Obj_47 511;
BA_ "GenSigStartValue" SG_ 536 ARS_OD_YawRateAbs_Obj_47 511;
BA_ "GenSigStartValue" SG_ 536 ARS_OD_VabsY_Obj_46 1024;
BA_ "GenSigStartValue" SG_ 536 ARS_OD_ID_46 255;
BA_ "GenSigStartValue" SG_ 536 ARS_OD_ID_47 255;
BA_ "GenSigStartValue" SG_ 536 ARS_OD_AabsY_Obj_46 255;
BA_ "GenSigStartValue" SG_ 537 ARS_OD_DistX_Obj_48 1143;
BA_ "GenSigStartValue" SG_ 537 ARS_OD_VabsX_Obj_48 1024;
BA_ "GenSigStartValue" SG_ 537 ARS_OD_RCS_Obj_48 256;
BA_ "GenSigStartValue" SG_ 537 ARS_OD_Orientation_Obj_48 511;
BA_ "GenSigStartValue" SG_ 537 ARS_OD_YawRateAbs_Obj_48 511;
BA_ "GenSigStartValue" SG_ 537 ARS_OD_DistX_Obj_49 1143;
BA_ "GenSigStartValue" SG_ 537 ARS_OD_VabsX_Obj_49 1024;
BA_ "GenSigStartValue" SG_ 537 ARS_OD_AabsX_Obj_49 255;
BA_ "GenSigStartValue" SG_ 537 ARS_OD_AabsX_Obj_48 255;
BA_ "GenSigStartValue" SG_ 537 ARS_OD_DistY_Obj_49 2047;
BA_ "GenSigStartValue" SG_ 537 ARS_OD_VabsY_Obj_49 1024;
BA_ "GenSigStartValue" SG_ 537 ARS_OD_AabsY_Obj_49 255;
BA_ "GenSigStartValue" SG_ 537 ARS_OD_DistY_Obj_48 2047;
BA_ "GenSigStartValue" SG_ 537 ARS_OD_RCS_Obj_49 256;
BA_ "GenSigStartValue" SG_ 537 ARS_OD_Orientation_Obj_49 511;
BA_ "GenSigStartValue" SG_ 537 ARS_OD_YawRateAbs_Obj_49 511;
BA_ "GenSigStartValue" SG_ 537 ARS_OD_VabsY_Obj_48 1024;
BA_ "GenSigStartValue" SG_ 537 ARS_OD_ID_48 255;
BA_ "GenSigStartValue" SG_ 537 ARS_OD_ID_49 255;
BA_ "GenSigStartValue" SG_ 537 ARS_OD_AabsY_Obj_48 255;
BA_ "GenSigStartValue" SG_ 538 ARS_OD_DistX_Obj_50 1143;
BA_ "GenSigStartValue" SG_ 538 ARS_OD_VabsX_Obj_50 1024;
BA_ "GenSigStartValue" SG_ 538 ARS_OD_RCS_Obj_50 256;
BA_ "GenSigStartValue" SG_ 538 ARS_OD_Orientation_Obj_50 511;
BA_ "GenSigStartValue" SG_ 538 ARS_OD_YawRateAbs_Obj_50 511;
BA_ "GenSigStartValue" SG_ 538 ARS_OD_DistX_Obj_51 1143;
BA_ "GenSigStartValue" SG_ 538 ARS_OD_VabsX_Obj_51 1024;
BA_ "GenSigStartValue" SG_ 538 ARS_OD_AabsX_Obj_51 255;
BA_ "GenSigStartValue" SG_ 538 ARS_OD_AabsX_Obj_50 255;
BA_ "GenSigStartValue" SG_ 538 ARS_OD_DistY_Obj_51 2047;
BA_ "GenSigStartValue" SG_ 538 ARS_OD_VabsY_Obj_51 1024;
BA_ "GenSigStartValue" SG_ 538 ARS_OD_AabsY_Obj_51 255;
BA_ "GenSigStartValue" SG_ 538 ARS_OD_DistY_Obj_50 2047;
BA_ "GenSigStartValue" SG_ 538 ARS_OD_RCS_Obj_51 256;
BA_ "GenSigStartValue" SG_ 538 ARS_OD_Orientation_Obj_51 511;
BA_ "GenSigStartValue" SG_ 538 ARS_OD_YawRateAbs_Obj_51 511;
BA_ "GenSigStartValue" SG_ 538 ARS_OD_VabsY_Obj_50 1024;
BA_ "GenSigStartValue" SG_ 538 ARS_OD_ID_50 255;
BA_ "GenSigStartValue" SG_ 538 ARS_OD_ID_51 255;
BA_ "GenSigStartValue" SG_ 538 ARS_OD_AabsY_Obj_50 255;
BA_ "GenSigStartValue" SG_ 539 ARS_OD_DistX_Obj_52 1143;
BA_ "GenSigStartValue" SG_ 539 ARS_OD_VabsX_Obj_52 1024;
BA_ "GenSigStartValue" SG_ 539 ARS_OD_RCS_Obj_52 256;
BA_ "GenSigStartValue" SG_ 539 ARS_OD_Orientation_Obj_52 511;
BA_ "GenSigStartValue" SG_ 539 ARS_OD_YawRateAbs_Obj_52 511;
BA_ "GenSigStartValue" SG_ 539 ARS_OD_DistX_Obj_53 1143;
BA_ "GenSigStartValue" SG_ 539 ARS_OD_VabsX_Obj_53 1024;
BA_ "GenSigStartValue" SG_ 539 ARS_OD_AabsX_Obj_53 255;
BA_ "GenSigStartValue" SG_ 539 ARS_OD_AabsX_Obj_52 255;
BA_ "GenSigStartValue" SG_ 539 ARS_OD_DistY_Obj_53 2047;
BA_ "GenSigStartValue" SG_ 539 ARS_OD_VabsY_Obj_53 1024;
BA_ "GenSigStartValue" SG_ 539 ARS_OD_AabsY_Obj_53 255;
BA_ "GenSigStartValue" SG_ 539 ARS_OD_DistY_Obj_52 2047;
BA_ "GenSigStartValue" SG_ 539 ARS_OD_RCS_Obj_53 256;
BA_ "GenSigStartValue" SG_ 539 ARS_OD_Orientation_Obj_53 511;
BA_ "GenSigStartValue" SG_ 539 ARS_OD_YawRateAbs_Obj_53 511;
BA_ "GenSigStartValue" SG_ 539 ARS_OD_VabsY_Obj_52 1024;
BA_ "GenSigStartValue" SG_ 539 ARS_OD_ID_52 255;
BA_ "GenSigStartValue" SG_ 539 ARS_OD_ID_53 255;
BA_ "GenSigStartValue" SG_ 539 ARS_OD_AabsY_Obj_52 255;
BA_ "GenSigStartValue" SG_ 540 ARS_OD_DistX_Obj_54 1143;
BA_ "GenSigStartValue" SG_ 540 ARS_OD_VabsX_Obj_54 1024;
BA_ "GenSigStartValue" SG_ 540 ARS_OD_RCS_Obj_54 256;
BA_ "GenSigStartValue" SG_ 540 ARS_OD_Orientation_Obj_54 511;
BA_ "GenSigStartValue" SG_ 540 ARS_OD_YawRateAbs_Obj_54 511;
BA_ "GenSigStartValue" SG_ 540 ARS_OD_DistX_Obj_55 1143;
BA_ "GenSigStartValue" SG_ 540 ARS_OD_VabsX_Obj_55 1024;
BA_ "GenSigStartValue" SG_ 540 ARS_OD_AabsX_Obj_55 255;
BA_ "GenSigStartValue" SG_ 540 ARS_OD_AabsX_Obj_54 255;
BA_ "GenSigStartValue" SG_ 540 ARS_OD_DistY_Obj_55 2047;
BA_ "GenSigStartValue" SG_ 540 ARS_OD_VabsY_Obj_55 1024;
BA_ "GenSigStartValue" SG_ 540 ARS_OD_AabsY_Obj_55 255;
BA_ "GenSigStartValue" SG_ 540 ARS_OD_DistY_Obj_54 2047;
BA_ "GenSigStartValue" SG_ 540 ARS_OD_RCS_Obj_55 256;
BA_ "GenSigStartValue" SG_ 540 ARS_OD_Orientation_Obj_55 511;
BA_ "GenSigStartValue" SG_ 540 ARS_OD_YawRateAbs_Obj_55 511;
BA_ "GenSigStartValue" SG_ 540 ARS_OD_VabsY_Obj_54 1024;
BA_ "GenSigStartValue" SG_ 540 ARS_OD_ID_54 255;
BA_ "GenSigStartValue" SG_ 540 ARS_OD_ID_55 255;
BA_ "GenSigStartValue" SG_ 540 ARS_OD_AabsY_Obj_54 255;
BA_ "GenSigStartValue" SG_ 541 ARS_OD_DistX_Obj_56 1143;
BA_ "GenSigStartValue" SG_ 541 ARS_OD_VabsX_Obj_56 1024;
BA_ "GenSigStartValue" SG_ 541 ARS_OD_RCS_Obj_56 256;
BA_ "GenSigStartValue" SG_ 541 ARS_OD_Orientation_Obj_56 511;
BA_ "GenSigStartValue" SG_ 541 ARS_OD_YawRateAbs_Obj_56 511;
BA_ "GenSigStartValue" SG_ 541 ARS_OD_DistX_Obj_57 1143;
BA_ "GenSigStartValue" SG_ 541 ARS_OD_VabsX_Obj_57 1024;
BA_ "GenSigStartValue" SG_ 541 ARS_OD_AabsX_Obj_57 255;
BA_ "GenSigStartValue" SG_ 541 ARS_OD_AabsX_Obj_56 255;
BA_ "GenSigStartValue" SG_ 541 ARS_OD_DistY_Obj_57 2047;
BA_ "GenSigStartValue" SG_ 541 ARS_OD_VabsY_Obj_57 1024;
BA_ "GenSigStartValue" SG_ 541 ARS_OD_AabsY_Obj_57 255;
BA_ "GenSigStartValue" SG_ 541 ARS_OD_DistY_Obj_56 2047;
BA_ "GenSigStartValue" SG_ 541 ARS_OD_RCS_Obj_57 256;
BA_ "GenSigStartValue" SG_ 541 ARS_OD_Orientation_Obj_57 511;
BA_ "GenSigStartValue" SG_ 541 ARS_OD_YawRateAbs_Obj_57 511;
BA_ "GenSigStartValue" SG_ 541 ARS_OD_VabsY_Obj_56 1024;
BA_ "GenSigStartValue" SG_ 541 ARS_OD_ID_56 255;
BA_ "GenSigStartValue" SG_ 541 ARS_OD_ID_57 255;
BA_ "GenSigStartValue" SG_ 541 ARS_OD_AabsY_Obj_56 255;
BA_ "GenSigStartValue" SG_ 542 ARS_OD_DistX_Obj_58 1143;
BA_ "GenSigStartValue" SG_ 542 ARS_OD_VabsX_Obj_58 1024;
BA_ "GenSigStartValue" SG_ 542 ARS_OD_RCS_Obj_58 256;
BA_ "GenSigStartValue" SG_ 542 ARS_OD_Orientation_Obj_58 511;
BA_ "GenSigStartValue" SG_ 542 ARS_OD_YawRateAbs_Obj_58 511;
BA_ "GenSigStartValue" SG_ 542 ARS_OD_DistX_Obj_59 1143;
BA_ "GenSigStartValue" SG_ 542 ARS_OD_VabsX_Obj_59 1024;
BA_ "GenSigStartValue" SG_ 542 ARS_OD_AabsX_Obj_59 255;
BA_ "GenSigStartValue" SG_ 542 ARS_OD_AabsX_Obj_58 255;
BA_ "GenSigStartValue" SG_ 542 ARS_OD_DistY_Obj_59 2047;
BA_ "GenSigStartValue" SG_ 542 ARS_OD_VabsY_Obj_59 1024;
BA_ "GenSigStartValue" SG_ 542 ARS_OD_AabsY_Obj_59 255;
BA_ "GenSigStartValue" SG_ 542 ARS_OD_DistY_Obj_58 2047;
BA_ "GenSigStartValue" SG_ 542 ARS_OD_RCS_Obj_59 256;
BA_ "GenSigStartValue" SG_ 542 ARS_OD_Orientation_Obj_59 511;
BA_ "GenSigStartValue" SG_ 542 ARS_OD_YawRateAbs_Obj_59 511;
BA_ "GenSigStartValue" SG_ 542 ARS_OD_VabsY_Obj_58 1024;
BA_ "GenSigStartValue" SG_ 542 ARS_OD_ID_58 255;
BA_ "GenSigStartValue" SG_ 542 ARS_OD_ID_59 255;
BA_ "GenSigStartValue" SG_ 542 ARS_OD_AabsY_Obj_58 255;
BA_ "GenSigStartValue" SG_ 543 ARS_RD_ClothoidParam_1 2047;
BA_ "GenSigStartValue" SG_ 543 ARS_RD_NofLane_Left 3;
BA_ "GenSigStartValue" SG_ 543 ARS_RD_NofLane_Right 3;
BA_ "GenSigStartValue" SG_ 543 ARS_RD_ClothoidParam_2 511;
BA_ "GenSigStartValue" SG_ 543 ARS_RD_ClothoidParam_3 1023;
BA_ "GenSigStartValue" SG_ 543 ARS_RD_LatOffset_Right 255;
VAL_ 527 ARS_OD_Classification_Obj_28 0 "POINT" 1 "CAR" 2 "TRUCK" 3 "PEDESTRIAN" 4 "MOTORCYCLE" 5 "BICYCLE" 6 "WIDE" 7 "UNCLASSIFIED" ;
VAL_ 527 ARS_OD_DynProp_Obj_28 0 "MOVING" 1 "STATIONARY" 2 "ONCOMING" 3 "CROSSING_LEFT2RIGHT" 4 "CROSSING_RIGHT2LEFT" 5 "UNKNOWN" 6 "STOPPED" 7 "RESERVED" ;
VAL_ 527 ARS_OD_MaintenanceState_Obj_28 0 "INVALID" 1 "NEW" 2 "MEASURED" 3 "PREDICTED" ;
VAL_ 527 ARS_OD_RefPoint_Obj_28 0 "REAR" 1 "LEFT" 2 "FRONT" 3 "RIGHT" ;
VAL_ 527 ARS_OD_Classification_Obj_29 0 "POINT" 1 "CAR" 2 "TRUCK" 3 "PEDESTRIAN" 4 "MOTORCYCLE" 5 "BICYCLE" 6 "WIDE" 7 "UNCLASSIFIED" ;
VAL_ 527 ARS_OD_DynProp_Obj_29 0 "MOVING" 1 "STATIONARY" 2 "ONCOMING" 3 "CROSSING_LEFT2RIGHT" 4 "CROSSING_RIGHT2LEFT" 5 "UNKNOWN" 6 "STOPPED" 7 "RESERVED" ;
VAL_ 527 ARS_OD_MaintenanceState_Obj_29 0 "INVALID" 1 "NEW" 2 "MEASURED" 3 "PREDICTED" ;
VAL_ 527 ARS_OD_RefPoint_Obj_29 0 "REAR" 1 "LEFT" 2 "FRONT" 3 "RIGHT" ;
VAL_ 527 ARS_OD_MicroDopplerFlag_28 0 "FALSE" 1 "TRUE" ;
VAL_ 527 ARS_OD_MicroDopplerFlag_29 0 "FALSE" 1 "TRUE" ;
VAL_ 528 ARS_OD_Classification_Obj_30 0 "POINT" 1 "CAR" 2 "TRUCK" 3 "PEDESTRIAN" 4 "MOTORCYCLE" 5 "BICYCLE" 6 "WIDE" 7 "UNCLASSIFIED" ;
VAL_ 528 ARS_OD_DynProp_Obj_30 0 "MOVING" 1 "STATIONARY" 2 "ONCOMING" 3 "CROSSING_LEFT2RIGHT" 4 "CROSSING_RIGHT2LEFT" 5 "UNKNOWN" 6 "STOPPED" 7 "RESERVED" ;
VAL_ 528 ARS_OD_MaintenanceState_Obj_30 0 "INVALID" 1 "NEW" 2 "MEASURED" 3 "PREDICTED" ;
VAL_ 528 ARS_OD_RefPoint_Obj_30 0 "REAR" 1 "LEFT" 2 "FRONT" 3 "RIGHT" ;
VAL_ 528 ARS_OD_Classification_Obj_31 0 "POINT" 1 "CAR" 2 "TRUCK" 3 "PEDESTRIAN" 4 "MOTORCYCLE" 5 "BICYCLE" 6 "WIDE" 7 "UNCLASSIFIED" ;
VAL_ 528 ARS_OD_DynProp_Obj_31 0 "MOVING" 1 "STATIONARY" 2 "ONCOMING" 3 "CROSSING_LEFT2RIGHT" 4 "CROSSING_RIGHT2LEFT" 5 "UNKNOWN" 6 "STOPPED" 7 "RESERVED" ;
VAL_ 528 ARS_OD_MaintenanceState_Obj_31 0 "INVALID" 1 "NEW" 2 "MEASURED" 3 "PREDICTED" ;
VAL_ 528 ARS_OD_RefPoint_Obj_31 0 "REAR" 1 "LEFT" 2 "FRONT" 3 "RIGHT" ;
VAL_ 528 ARS_OD_MicroDopplerFlag_30 0 "FALSE" 1 "TRUE" ;
VAL_ 528 ARS_OD_MicroDopplerFlag_31 0 "FALSE" 1 "TRUE" ;
VAL_ 529 ARS_OD_Classification_Obj_32 0 "POINT" 1 "CAR" 2 "TRUCK" 3 "PEDESTRIAN" 4 "MOTORCYCLE" 5 "BICYCLE" 6 "WIDE" 7 "UNCLASSIFIED" ;
VAL_ 529 ARS_OD_DynProp_Obj_32 0 "MOVING" 1 "STATIONARY" 2 "ONCOMING" 3 "CROSSING_LEFT2RIGHT" 4 "CROSSING_RIGHT2LEFT" 5 "UNKNOWN" 6 "STOPPED" 7 "RESERVED" ;
VAL_ 529 ARS_OD_MaintenanceState_Obj_32 0 "INVALID" 1 "NEW" 2 "MEASURED" 3 "PREDICTED" ;
VAL_ 529 ARS_OD_RefPoint_Obj_32 0 "REAR" 1 "LEFT" 2 "FRONT" 3 "RIGHT" ;
VAL_ 529 ARS_OD_Classification_Obj_33 0 "POINT" 1 "CAR" 2 "TRUCK" 3 "PEDESTRIAN" 4 "MOTORCYCLE" 5 "BICYCLE" 6 "WIDE" 7 "UNCLASSIFIED" ;
VAL_ 529 ARS_OD_DynProp_Obj_33 0 "MOVING" 1 "STATIONARY" 2 "ONCOMING" 3 "CROSSING_LEFT2RIGHT" 4 "CROSSING_RIGHT2LEFT" 5 "UNKNOWN" 6 "STOPPED" 7 "RESERVED" ;
VAL_ 529 ARS_OD_MaintenanceState_Obj_33 0 "INVALID" 1 "NEW" 2 "MEASURED" 3 "PREDICTED" ;
VAL_ 529 ARS_OD_RefPoint_Obj_33 0 "REAR" 1 "LEFT" 2 "FRONT" 3 "RIGHT" ;
VAL_ 529 ARS_OD_MicroDopplerFlag_32 0 "FALSE" 1 "TRUE" ;
VAL_ 529 ARS_OD_MicroDopplerFlag_33 0 "FALSE" 1 "TRUE" ;
VAL_ 530 ARS_OD_Classification_Obj_34 0 "POINT" 1 "CAR" 2 "TRUCK" 3 "PEDESTRIAN" 4 "MOTORCYCLE" 5 "BICYCLE" 6 "WIDE" 7 "UNCLASSIFIED" ;
VAL_ 530 ARS_OD_DynProp_Obj_34 0 "MOVING" 1 "STATIONARY" 2 "ONCOMING" 3 "CROSSING_LEFT2RIGHT" 4 "CROSSING_RIGHT2LEFT" 5 "UNKNOWN" 6 "STOPPED" 7 "RESERVED" ;
VAL_ 530 ARS_OD_MaintenanceState_Obj_34 0 "INVALID" 1 "NEW" 2 "MEASURED" 3 "PREDICTED" ;
VAL_ 530 ARS_OD_RefPoint_Obj_34 0 "REAR" 1 "LEFT" 2 "FRONT" 3 "RIGHT" ;
VAL_ 530 ARS_OD_Classification_Obj_35 0 "POINT" 1 "CAR" 2 "TRUCK" 3 "PEDESTRIAN" 4 "MOTORCYCLE" 5 "BICYCLE" 6 "WIDE" 7 "UNCLASSIFIED" ;
VAL_ 530 ARS_OD_DynProp_Obj_35 0 "MOVING" 1 "STATIONARY" 2 "ONCOMING" 3 "CROSSING_LEFT2RIGHT" 4 "CROSSING_RIGHT2LEFT" 5 "UNKNOWN" 6 "STOPPED" 7 "RESERVED" ;
VAL_ 530 ARS_OD_MaintenanceState_Obj_35 0 "INVALID" 1 "NEW" 2 "MEASURED" 3 "PREDICTED" ;
VAL_ 530 ARS_OD_RefPoint_Obj_35 0 "REAR" 1 "LEFT" 2 "FRONT" 3 "RIGHT" ;
VAL_ 530 ARS_OD_MicroDopplerFlag_34 0 "FALSE" 1 "TRUE" ;
VAL_ 530 ARS_OD_MicroDopplerFlag_35 0 "FALSE" 1 "TRUE" ;
VAL_ 531 ARS_OD_Classification_Obj_36 0 "POINT" 1 "CAR" 2 "TRUCK" 3 "PEDESTRIAN" 4 "MOTORCYCLE" 5 "BICYCLE" 6 "WIDE" 7 "UNCLASSIFIED" ;
VAL_ 531 ARS_OD_DynProp_Obj_36 0 "MOVING" 1 "STATIONARY" 2 "ONCOMING" 3 "CROSSING_LEFT2RIGHT" 4 "CROSSING_RIGHT2LEFT" 5 "UNKNOWN" 6 "STOPPED" 7 "RESERVED" ;
VAL_ 531 ARS_OD_MaintenanceState_Obj_36 0 "INVALID" 1 "NEW" 2 "MEASURED" 3 "PREDICTED" ;
VAL_ 531 ARS_OD_RefPoint_Obj_36 0 "REAR" 1 "LEFT" 2 "FRONT" 3 "RIGHT" ;
VAL_ 531 ARS_OD_Classification_Obj_37 0 "POINT" 1 "CAR" 2 "TRUCK" 3 "PEDESTRIAN" 4 "MOTORCYCLE" 5 "BICYCLE" 6 "WIDE" 7 "UNCLASSIFIED" ;
VAL_ 531 ARS_OD_DynProp_Obj_37 0 "MOVING" 1 "STATIONARY" 2 "ONCOMING" 3 "CROSSING_LEFT2RIGHT" 4 "CROSSING_RIGHT2LEFT" 5 "UNKNOWN" 6 "STOPPED" 7 "RESERVED" ;
VAL_ 531 ARS_OD_MaintenanceState_Obj_37 0 "INVALID" 1 "NEW" 2 "MEASURED" 3 "PREDICTED" ;
VAL_ 531 ARS_OD_RefPoint_Obj_37 0 "REAR" 1 "LEFT" 2 "FRONT" 3 "RIGHT" ;
VAL_ 531 ARS_OD_MicroDopplerFlag_36 0 "FALSE" 1 "TRUE" ;
VAL_ 531 ARS_OD_MicroDopplerFlag_37 0 "FALSE" 1 "TRUE" ;
VAL_ 532 ARS_OD_Classification_Obj_38 0 "POINT" 1 "CAR" 2 "TRUCK" 3 "PEDESTRIAN" 4 "MOTORCYCLE" 5 "BICYCLE" 6 "WIDE" 7 "UNCLASSIFIED" ;
VAL_ 532 ARS_OD_DynProp_Obj_38 0 "MOVING" 1 "STATIONARY" 2 "ONCOMING" 3 "CROSSING_LEFT2RIGHT" 4 "CROSSING_RIGHT2LEFT" 5 "UNKNOWN" 6 "STOPPED" 7 "RESERVED" ;
VAL_ 532 ARS_OD_MaintenanceState_Obj_38 0 "INVALID" 1 "NEW" 2 "MEASURED" 3 "PREDICTED" ;
VAL_ 532 ARS_OD_RefPoint_Obj_38 0 "REAR" 1 "LEFT" 2 "FRONT" 3 "RIGHT" ;
VAL_ 532 ARS_OD_Classification_Obj_39 0 "POINT" 1 "CAR" 2 "TRUCK" 3 "PEDESTRIAN" 4 "MOTORCYCLE" 5 "BICYCLE" 6 "WIDE" 7 "UNCLASSIFIED" ;
VAL_ 532 ARS_OD_DynProp_Obj_39 0 "MOVING" 1 "STATIONARY" 2 "ONCOMING" 3 "CROSSING_LEFT2RIGHT" 4 "CROSSING_RIGHT2LEFT" 5 "UNKNOWN" 6 "STOPPED" 7 "RESERVED" ;
VAL_ 532 ARS_OD_MaintenanceState_Obj_39 0 "INVALID" 1 "NEW" 2 "MEASURED" 3 "PREDICTED" ;
VAL_ 532 ARS_OD_RefPoint_Obj_39 0 "REAR" 1 "LEFT" 2 "FRONT" 3 "RIGHT" ;
VAL_ 532 ARS_OD_MicroDopplerFlag_38 0 "FALSE" 1 "TRUE" ;
VAL_ 532 ARS_OD_MicroDopplerFlag_39 0 "FALSE" 1 "TRUE" ;
VAL_ 533 ARS_OD_Classification_Obj_40 0 "POINT" 1 "CAR" 2 "TRUCK" 3 "PEDESTRIAN" 4 "MOTORCYCLE" 5 "BICYCLE" 6 "WIDE" 7 "UNCLASSIFIED" ;
VAL_ 533 ARS_OD_DynProp_Obj_40 0 "MOVING" 1 "STATIONARY" 2 "ONCOMING" 3 "CROSSING_LEFT2RIGHT" 4 "CROSSING_RIGHT2LEFT" 5 "UNKNOWN" 6 "STOPPED" 7 "RESERVED" ;
VAL_ 533 ARS_OD_MaintenanceState_Obj_40 0 "INVALID" 1 "NEW" 2 "MEASURED" 3 "PREDICTED" ;
VAL_ 533 ARS_OD_RefPoint_Obj_40 0 "REAR" 1 "LEFT" 2 "FRONT" 3 "RIGHT" ;
VAL_ 533 ARS_OD_Classification_Obj_41 0 "POINT" 1 "CAR" 2 "TRUCK" 3 "PEDESTRIAN" 4 "MOTORCYCLE" 5 "BICYCLE" 6 "WIDE" 7 "UNCLASSIFIED" ;
VAL_ 533 ARS_OD_DynProp_Obj_41 0 "MOVING" 1 "STATIONARY" 2 "ONCOMING" 3 "CROSSING_LEFT2RIGHT" 4 "CROSSING_RIGHT2LEFT" 5 "UNKNOWN" 6 "STOPPED" 7 "RESERVED" ;
VAL_ 533 ARS_OD_MaintenanceState_Obj_41 0 "INVALID" 1 "NEW" 2 "MEASURED" 3 "PREDICTED" ;
VAL_ 533 ARS_OD_RefPoint_Obj_41 0 "REAR" 1 "LEFT" 2 "FRONT" 3 "RIGHT" ;
VAL_ 533 ARS_OD_MicroDopplerFlag_40 0 "FALSE" 1 "TRUE" ;
VAL_ 533 ARS_OD_MicroDopplerFlag_41 0 "FALSE" 1 "TRUE" ;
VAL_ 534 ARS_OD_Classification_Obj_42 0 "POINT" 1 "CAR" 2 "TRUCK" 3 "PEDESTRIAN" 4 "MOTORCYCLE" 5 "BICYCLE" 6 "WIDE" 7 "UNCLASSIFIED" ;
VAL_ 534 ARS_OD_DynProp_Obj_42 0 "MOVING" 1 "STATIONARY" 2 "ONCOMING" 3 "CROSSING_LEFT2RIGHT" 4 "CROSSING_RIGHT2LEFT" 5 "UNKNOWN" 6 "STOPPED" 7 "RESERVED" ;
VAL_ 534 ARS_OD_MaintenanceState_Obj_42 0 "INVALID" 1 "NEW" 2 "MEASURED" 3 "PREDICTED" ;
VAL_ 534 ARS_OD_RefPoint_Obj_42 0 "REAR" 1 "LEFT" 2 "FRONT" 3 "RIGHT" ;
VAL_ 534 ARS_OD_Classification_Obj_43 0 "POINT" 1 "CAR" 2 "TRUCK" 3 "PEDESTRIAN" 4 "MOTORCYCLE" 5 "BICYCLE" 6 "WIDE" 7 "UNCLASSIFIED" ;
VAL_ 534 ARS_OD_DynProp_Obj_43 0 "MOVING" 1 "STATIONARY" 2 "ONCOMING" 3 "CROSSING_LEFT2RIGHT" 4 "CROSSING_RIGHT2LEFT" 5 "UNKNOWN" 6 "STOPPED" 7 "RESERVED" ;
VAL_ 534 ARS_OD_MaintenanceState_Obj_43 0 "INVALID" 1 "NEW" 2 "MEASURED" 3 "PREDICTED" ;
VAL_ 534 ARS_OD_RefPoint_Obj_43 0 "REAR" 1 "LEFT" 2 "FRONT" 3 "RIGHT" ;
VAL_ 534 ARS_OD_MicroDopplerFlag_42 0 "FALSE" 1 "TRUE" ;
VAL_ 534 ARS_OD_MicroDopplerFlag_43 0 "FALSE" 1 "TRUE" ;
VAL_ 535 ARS_OD_Classification_Obj_44 0 "POINT" 1 "CAR" 2 "TRUCK" 3 "PEDESTRIAN" 4 "MOTORCYCLE" 5 "BICYCLE" 6 "WIDE" 7 "UNCLASSIFIED" ;
VAL_ 535 ARS_OD_DynProp_Obj_44 0 "MOVING" 1 "STATIONARY" 2 "ONCOMING" 3 "CROSSING_LEFT2RIGHT" 4 "CROSSING_RIGHT2LEFT" 5 "UNKNOWN" 6 "STOPPED" 7 "RESERVED" ;
VAL_ 535 ARS_OD_MaintenanceState_Obj_44 0 "INVALID" 1 "NEW" 2 "MEASURED" 3 "PREDICTED" ;
VAL_ 535 ARS_OD_RefPoint_Obj_44 0 "REAR" 1 "LEFT" 2 "FRONT" 3 "RIGHT" ;
VAL_ 535 ARS_OD_Classification_Obj_45 0 "POINT" 1 "CAR" 2 "TRUCK" 3 "PEDESTRIAN" 4 "MOTORCYCLE" 5 "BICYCLE" 6 "WIDE" 7 "UNCLASSIFIED" ;
VAL_ 535 ARS_OD_DynProp_Obj_45 0 "MOVING" 1 "STATIONARY" 2 "ONCOMING" 3 "CROSSING_LEFT2RIGHT" 4 "CROSSING_RIGHT2LEFT" 5 "UNKNOWN" 6 "STOPPED" 7 "RESERVED" ;
VAL_ 535 ARS_OD_MaintenanceState_Obj_45 0 "INVALID" 1 "NEW" 2 "MEASURED" 3 "PREDICTED" ;
VAL_ 535 ARS_OD_RefPoint_Obj_45 0 "REAR" 1 "LEFT" 2 "FRONT" 3 "RIGHT" ;
VAL_ 535 ARS_OD_MicroDopplerFlag_44 0 "FALSE" 1 "TRUE" ;
VAL_ 535 ARS_OD_MicroDopplerFlag_45 0 "FALSE" 1 "TRUE" ;
VAL_ 536 ARS_OD_Classification_Obj_46 0 "POINT" 1 "CAR" 2 "TRUCK" 3 "PEDESTRIAN" 4 "MOTORCYCLE" 5 "BICYCLE" 6 "WIDE" 7 "UNCLASSIFIED" ;
VAL_ 536 ARS_OD_DynProp_Obj_46 0 "MOVING" 1 "STATIONARY" 2 "ONCOMING" 3 "CROSSING_LEFT2RIGHT" 4 "CROSSING_RIGHT2LEFT" 5 "UNKNOWN" 6 "STOPPED" 7 "RESERVED" ;
VAL_ 536 ARS_OD_MaintenanceState_Obj_46 0 "INVALID" 1 "NEW" 2 "MEASURED" 3 "PREDICTED" ;
VAL_ 536 ARS_OD_RefPoint_Obj_46 0 "REAR" 1 "LEFT" 2 "FRONT" 3 "RIGHT" ;
VAL_ 536 ARS_OD_Classification_Obj_47 0 "POINT" 1 "CAR" 2 "TRUCK" 3 "PEDESTRIAN" 4 "MOTORCYCLE" 5 "BICYCLE" 6 "WIDE" 7 "UNCLASSIFIED" ;
VAL_ 536 ARS_OD_DynProp_Obj_47 0 "MOVING" 1 "STATIONARY" 2 "ONCOMING" 3 "CROSSING_LEFT2RIGHT" 4 "CROSSING_RIGHT2LEFT" 5 "UNKNOWN" 6 "STOPPED" 7 "RESERVED" ;
VAL_ 536 ARS_OD_MaintenanceState_Obj_47 0 "INVALID" 1 "NEW" 2 "MEASURED" 3 "PREDICTED" ;
VAL_ 536 ARS_OD_RefPoint_Obj_47 0 "REAR" 1 "LEFT" 2 "FRONT" 3 "RIGHT" ;
VAL_ 536 ARS_OD_MicroDopplerFlag_46 0 "FALSE" 1 "TRUE" ;
VAL_ 536 ARS_OD_MicroDopplerFlag_47 0 "FALSE" 1 "TRUE" ;
VAL_ 537 ARS_OD_Classification_Obj_48 0 "POINT" 1 "CAR" 2 "TRUCK" 3 "PEDESTRIAN" 4 "MOTORCYCLE" 5 "BICYCLE" 6 "WIDE" 7 "UNCLASSIFIED" ;
VAL_ 537 ARS_OD_DynProp_Obj_48 0 "MOVING" 1 "STATIONARY" 2 "ONCOMING" 3 "CROSSING_LEFT2RIGHT" 4 "CROSSING_RIGHT2LEFT" 5 "UNKNOWN" 6 "STOPPED" 7 "RESERVED" ;
VAL_ 537 ARS_OD_MaintenanceState_Obj_48 0 "INVALID" 1 "NEW" 2 "MEASURED" 3 "PREDICTED" ;
VAL_ 537 ARS_OD_RefPoint_Obj_48 0 "REAR" 1 "LEFT" 2 "FRONT" 3 "RIGHT" ;
VAL_ 537 ARS_OD_Classification_Obj_49 0 "POINT" 1 "CAR" 2 "TRUCK" 3 "PEDESTRIAN" 4 "MOTORCYCLE" 5 "BICYCLE" 6 "WIDE" 7 "UNCLASSIFIED" ;
VAL_ 537 ARS_OD_DynProp_Obj_49 0 "MOVING" 1 "STATIONARY" 2 "ONCOMING" 3 "CROSSING_LEFT2RIGHT" 4 "CROSSING_RIGHT2LEFT" 5 "UNKNOWN" 6 "STOPPED" 7 "RESERVED" ;
VAL_ 537 ARS_OD_MaintenanceState_Obj_49 0 "INVALID" 1 "NEW" 2 "MEASURED" 3 "PREDICTED" ;
VAL_ 537 ARS_OD_RefPoint_Obj_49 0 "REAR" 1 "LEFT" 2 "FRONT" 3 "RIGHT" ;
VAL_ 537 ARS_OD_MicroDopplerFlag_48 0 "FALSE" 1 "TRUE" ;
VAL_ 537 ARS_OD_MicroDopplerFlag_49 0 "FALSE" 1 "TRUE" ;
VAL_ 538 ARS_OD_Classification_Obj_50 0 "POINT" 1 "CAR" 2 "TRUCK" 3 "PEDESTRIAN" 4 "MOTORCYCLE" 5 "BICYCLE" 6 "WIDE" 7 "UNCLASSIFIED" ;
VAL_ 538 ARS_OD_DynProp_Obj_50 0 "MOVING" 1 "STATIONARY" 2 "ONCOMING" 3 "CROSSING_LEFT2RIGHT" 4 "CROSSING_RIGHT2LEFT" 5 "UNKNOWN" 6 "STOPPED" 7 "RESERVED" ;
VAL_ 538 ARS_OD_MaintenanceState_Obj_50 0 "INVALID" 1 "NEW" 2 "MEASURED" 3 "PREDICTED" ;
VAL_ 538 ARS_OD_RefPoint_Obj_50 0 "REAR" 1 "LEFT" 2 "FRONT" 3 "RIGHT" ;
VAL_ 538 ARS_OD_Classification_Obj_51 0 "POINT" 1 "CAR" 2 "TRUCK" 3 "PEDESTRIAN" 4 "MOTORCYCLE" 5 "BICYCLE" 6 "WIDE" 7 "UNCLASSIFIED" ;
VAL_ 538 ARS_OD_DynProp_Obj_51 0 "MOVING" 1 "STATIONARY" 2 "ONCOMING" 3 "CROSSING_LEFT2RIGHT" 4 "CROSSING_RIGHT2LEFT" 5 "UNKNOWN" 6 "STOPPED" 7 "RESERVED" ;
VAL_ 538 ARS_OD_MaintenanceState_Obj_51 0 "INVALID" 1 "NEW" 2 "MEASURED" 3 "PREDICTED" ;
VAL_ 538 ARS_OD_RefPoint_Obj_51 0 "REAR" 1 "LEFT" 2 "FRONT" 3 "RIGHT" ;
VAL_ 538 ARS_OD_MicroDopplerFlag_50 0 "FALSE" 1 "TRUE" ;
VAL_ 538 ARS_OD_MicroDopplerFlag_51 0 "FALSE" 1 "TRUE" ;
VAL_ 539 ARS_OD_Classification_Obj_52 0 "POINT" 1 "CAR" 2 "TRUCK" 3 "PEDESTRIAN" 4 "MOTORCYCLE" 5 "BICYCLE" 6 "WIDE" 7 "UNCLASSIFIED" ;
VAL_ 539 ARS_OD_DynProp_Obj_52 0 "MOVING" 1 "STATIONARY" 2 "ONCOMING" 3 "CROSSING_LEFT2RIGHT" 4 "CROSSING_RIGHT2LEFT" 5 "UNKNOWN" 6 "STOPPED" 7 "RESERVED" ;
VAL_ 539 ARS_OD_MaintenanceState_Obj_52 0 "INVALID" 1 "NEW" 2 "MEASURED" 3 "PREDICTED" ;
VAL_ 539 ARS_OD_RefPoint_Obj_52 0 "REAR" 1 "LEFT" 2 "FRONT" 3 "RIGHT" ;
VAL_ 539 ARS_OD_Classification_Obj_53 0 "POINT" 1 "CAR" 2 "TRUCK" 3 "PEDESTRIAN" 4 "MOTORCYCLE" 5 "BICYCLE" 6 "WIDE" 7 "UNCLASSIFIED" ;
VAL_ 539 ARS_OD_DynProp_Obj_53 0 "MOVING" 1 "STATIONARY" 2 "ONCOMING" 3 "CROSSING_LEFT2RIGHT" 4 "CROSSING_RIGHT2LEFT" 5 "UNKNOWN" 6 "STOPPED" 7 "RESERVED" ;
VAL_ 539 ARS_OD_MaintenanceState_Obj_53 0 "INVALID" 1 "NEW" 2 "MEASURED" 3 "PREDICTED" ;
VAL_ 539 ARS_OD_RefPoint_Obj_53 0 "REAR" 1 "LEFT" 2 "FRONT" 3 "RIGHT" ;
VAL_ 539 ARS_OD_MicroDopplerFlag_52 0 "FALSE" 1 "TRUE" ;
VAL_ 539 ARS_OD_MicroDopplerFlag_53 0 "FALSE" 1 "TRUE" ;
VAL_ 540 ARS_OD_Classification_Obj_54 0 "POINT" 1 "CAR" 2 "TRUCK" 3 "PEDESTRIAN" 4 "MOTORCYCLE" 5 "BICYCLE" 6 "WIDE" 7 "UNCLASSIFIED" ;
VAL_ 540 ARS_OD_DynProp_Obj_54 0 "MOVING" 1 "STATIONARY" 2 "ONCOMING" 3 "CROSSING_LEFT2RIGHT" 4 "CROSSING_RIGHT2LEFT" 5 "UNKNOWN" 6 "STOPPED" 7 "RESERVED" ;
VAL_ 540 ARS_OD_MaintenanceState_Obj_54 0 "INVALID" 1 "NEW" 2 "MEASURED" 3 "PREDICTED" ;
VAL_ 540 ARS_OD_RefPoint_Obj_54 0 "REAR" 1 "LEFT" 2 "FRONT" 3 "RIGHT" ;
VAL_ 540 ARS_OD_Classification_Obj_55 0 "POINT" 1 "CAR" 2 "TRUCK" 3 "PEDESTRIAN" 4 "MOTORCYCLE" 5 "BICYCLE" 6 "WIDE" 7 "UNCLASSIFIED" ;
VAL_ 540 ARS_OD_DynProp_Obj_55 0 "MOVING" 1 "STATIONARY" 2 "ONCOMING" 3 "CROSSING_LEFT2RIGHT" 4 "CROSSING_RIGHT2LEFT" 5 "UNKNOWN" 6 "STOPPED" 7 "RESERVED" ;
VAL_ 540 ARS_OD_MaintenanceState_Obj_55 0 "INVALID" 1 "NEW" 2 "MEASURED" 3 "PREDICTED" ;
VAL_ 540 ARS_OD_RefPoint_Obj_55 0 "REAR" 1 "LEFT" 2 "FRONT" 3 "RIGHT" ;
VAL_ 540 ARS_OD_MicroDopplerFlag_54 0 "FALSE" 1 "TRUE" ;
VAL_ 540 ARS_OD_MicroDopplerFlag_55 0 "FALSE" 1 "TRUE" ;
VAL_ 541 ARS_OD_Classification_Obj_56 0 "POINT" 1 "CAR" 2 "TRUCK" 3 "PEDESTRIAN" 4 "MOTORCYCLE" 5 "BICYCLE" 6 "WIDE" 7 "UNCLASSIFIED" ;
VAL_ 541 ARS_OD_DynProp_Obj_56 0 "MOVING" 1 "STATIONARY" 2 "ONCOMING" 3 "CROSSING_LEFT2RIGHT" 4 "CROSSING_RIGHT2LEFT" 5 "UNKNOWN" 6 "STOPPED" 7 "RESERVED" ;
VAL_ 541 ARS_OD_MaintenanceState_Obj_56 0 "INVALID" 1 "NEW" 2 "MEASURED" 3 "PREDICTED" ;
VAL_ 541 ARS_OD_RefPoint_Obj_56 0 "REAR" 1 "LEFT" 2 "FRONT" 3 "RIGHT" ;
VAL_ 541 ARS_OD_Classification_Obj_57 0 "POINT" 1 "CAR" 2 "TRUCK" 3 "PEDESTRIAN" 4 "MOTORCYCLE" 5 "BICYCLE" 6 "WIDE" 7 "UNCLASSIFIED" ;
VAL_ 541 ARS_OD_DynProp_Obj_57 0 "MOVING" 1 "STATIONARY" 2 "ONCOMING" 3 "CROSSING_LEFT2RIGHT" 4 "CROSSING_RIGHT2LEFT" 5 "UNKNOWN" 6 "STOPPED" 7 "RESERVED" ;
VAL_ 541 ARS_OD_MaintenanceState_Obj_57 0 "INVALID" 1 "NEW" 2 "MEASURED" 3 "PREDICTED" ;
VAL_ 541 ARS_OD_RefPoint_Obj_57 0 "REAR" 1 "LEFT" 2 "FRONT" 3 "RIGHT" ;
VAL_ 541 ARS_OD_MicroDopplerFlag_56 0 "FALSE" 1 "TRUE" ;
VAL_ 541 ARS_OD_MicroDopplerFlag_57 0 "FALSE" 1 "TRUE" ;
VAL_ 542 ARS_OD_Classification_Obj_58 0 "POINT" 1 "CAR" 2 "TRUCK" 3 "PEDESTRIAN" 4 "MOTORCYCLE" 5 "BICYCLE" 6 "WIDE" 7 "UNCLASSIFIED" ;
VAL_ 542 ARS_OD_DynProp_Obj_58 0 "MOVING" 1 "STATIONARY" 2 "ONCOMING" 3 "CROSSING_LEFT2RIGHT" 4 "CROSSING_RIGHT2LEFT" 5 "UNKNOWN" 6 "STOPPED" 7 "RESERVED" ;
VAL_ 542 ARS_OD_MaintenanceState_Obj_58 0 "INVALID" 1 "NEW" 2 "MEASURED" 3 "PREDICTED" ;
VAL_ 542 ARS_OD_RefPoint_Obj_58 0 "REAR" 1 "LEFT" 2 "FRONT" 3 "RIGHT" ;
VAL_ 542 ARS_OD_Classification_Obj_59 0 "POINT" 1 "CAR" 2 "TRUCK" 3 "PEDESTRIAN" 4 "MOTORCYCLE" 5 "BICYCLE" 6 "WIDE" 7 "UNCLASSIFIED" ;
VAL_ 542 ARS_OD_DynProp_Obj_59 0 "MOVING" 1 "STATIONARY" 2 "ONCOMING" 3 "CROSSING_LEFT2RIGHT" 4 "CROSSING_RIGHT2LEFT" 5 "UNKNOWN" 6 "STOPPED" 7 "RESERVED" ;
VAL_ 542 ARS_OD_MaintenanceState_Obj_59 0 "INVALID" 1 "NEW" 2 "MEASURED" 3 "PREDICTED" ;
VAL_ 542 ARS_OD_RefPoint_Obj_59 0 "REAR" 1 "LEFT" 2 "FRONT" 3 "RIGHT" ;
VAL_ 542 ARS_OD_MicroDopplerFlag_58 0 "FALSE" 1 "TRUE" ;
VAL_ 542 ARS_OD_MicroDopplerFlag_59 0 "FALSE" 1 "TRUE" ;
VAL_ 543 ARS_RD_RoadType 0 "UNKNOWN" 1 "CITY" 2 "COUNTRY" 3 "HIGHWAY" ;
SIG_GROUP_ 527 Signal_Group_ARS_OD_28_29 1 : ARS_OD_DistX_Obj_28 ARS_OD_Classification_Obj_28 ARS_OD_AabsYStd_Obj_28 ARS_OD_ClassConf_Obj_28 ARS_OD_ProbOfExist_Obj_28 ARS_OD_DynConf_Obj_28 ARS_OD_VabsX_Obj_28 ARS_OD_DynProp_Obj_28 ARS_OD_MirrorProb_Obj_28 ARS_OD_Length_Obj_28 ARS_OD_MaintenanceState_Obj_28 ARS_OD_Width_Obj_28 ARS_OD_RCS_Obj_28 ARS_OD_Orientation_Obj_28 ARS_OD_YawRateAbs_Obj_28 ARS_OD_YawRateAbsStd_Obj_28 ARS_OD_RefPoint_Obj_28 ARS_OD_LifeCycle_Obj_28 ARS_OD_DistX_Obj_29 ARS_OD_VabsX_Obj_29 ARS_OD_AabsX_Obj_29 ARS_OD_AabsX_Obj_28 ARS_OD_DistY_Obj_29 ARS_OD_VabsY_Obj_29 ARS_OD_AabsY_Obj_29 ARS_OD_DistXStd_Obj_29 ARS_OD_DistYStd_Obj_29 ARS_OD_VabsXStd_Obj_29 ARS_OD_VabsYStd_Obj_29 ARS_OD_AabsXStd_Obj_29 ARS_OD_Classification_Obj_29 ARS_OD_AabsYStd_Obj_29 ARS_OD_ClassConf_Obj_29 ARS_OD_DistY_Obj_28 ARS_OD_ProbOfExist_Obj_29 ARS_OD_DynConf_Obj_29 ARS_OD_DynProp_Obj_29 ARS_OD_MirrorProb_Obj_29 ARS_OD_Length_Obj_29 ARS_OD_MaintenanceState_Obj_29 ARS_OD_Width_Obj_29 ARS_OD_RCS_Obj_29 ARS_OD_Orientation_Obj_29 ARS_OD_YawRateAbs_Obj_29 ARS_OD_YawRateAbsStd_Obj_29 ARS_OD_RefPoint_Obj_29 ARS_OD_LifeCycle_Obj_29 ARS_OD_OrientationStd_Obj_28 ARS_OD_OrientationStd_Obj_29 ARS_OD_ObstacleProb_Obj_28 ARS_OD_MicroDopplerFlag_28 ARS_OD_ObstacleProb_Obj_29 ARS_OD_VabsY_Obj_28 ARS_OD_MicroDopplerFlag_29 ARS_OD_ID_28 ARS_OD_ID_29 ARS_OD_MsgCounter_Obj_28_29 ARS_OD_CRC16_Checksum_Obj_28_29 ARS_OD_AabsY_Obj_28 ARS_OD_DistXStd_Obj_28 ARS_OD_DistYStd_Obj_28 ARS_OD_VabsXStd_Obj_28 ARS_OD_VabsYStd_Obj_28 ARS_OD_AabsXStd_Obj_28;
SIG_GROUP_ 528 Signal_Group_ARS_OD_30_31 1 : ARS_OD_DistX_Obj_30 ARS_OD_Classification_Obj_30 ARS_OD_AabsYStd_Obj_30 ARS_OD_ClassConf_Obj_30 ARS_OD_ProbOfExist_Obj_30 ARS_OD_DynConf_Obj_30 ARS_OD_VabsX_Obj_30 ARS_OD_DynProp_Obj_30 ARS_OD_MirrorProb_Obj_30 ARS_OD_Length_Obj_30 ARS_OD_MaintenanceState_Obj_30 ARS_OD_Width_Obj_30 ARS_OD_RCS_Obj_30 ARS_OD_Orientation_Obj_30 ARS_OD_YawRateAbs_Obj_30 ARS_OD_YawRateAbsStd_Obj_30 ARS_OD_RefPoint_Obj_30 ARS_OD_LifeCycle_Obj_30 ARS_OD_DistX_Obj_31 ARS_OD_VabsX_Obj_31 ARS_OD_AabsX_Obj_31 ARS_OD_AabsX_Obj_30 ARS_OD_DistY_Obj_31 ARS_OD_VabsY_Obj_31 ARS_OD_AabsY_Obj_31 ARS_OD_DistXStd_Obj_31 ARS_OD_DistYStd_Obj_31 ARS_OD_VabsXStd_Obj_31 ARS_OD_VabsYStd_Obj_31 ARS_OD_AabsXStd_Obj_31 ARS_OD_Classification_Obj_31 ARS_OD_AabsYStd_Obj_31 ARS_OD_ClassConf_Obj_31 ARS_OD_DistY_Obj_30 ARS_OD_ProbOfExist_Obj_31 ARS_OD_DynConf_Obj_31 ARS_OD_DynProp_Obj_31 ARS_OD_MirrorProb_Obj_31 ARS_OD_Length_Obj_31 ARS_OD_MaintenanceState_Obj_31 ARS_OD_Width_Obj_31 ARS_OD_RCS_Obj_31 ARS_OD_Orientation_Obj_31 ARS_OD_YawRateAbs_Obj_31 ARS_OD_YawRateAbsStd_Obj_31 ARS_OD_RefPoint_Obj_31 ARS_OD_LifeCycle_Obj_31 ARS_OD_OrientationStd_Obj_30 ARS_OD_OrientationStd_Obj_31 ARS_OD_ObstacleProb_Obj_30 ARS_OD_MicroDopplerFlag_30 ARS_OD_ObstacleProb_Obj_31 ARS_OD_VabsY_Obj_30 ARS_OD_MicroDopplerFlag_31 ARS_OD_ID_30 ARS_OD_ID_31 ARS_OD_MsgCounter_Obj_30_31 ARS_OD_CRC16_Checksum_Obj_30_31 ARS_OD_AabsY_Obj_30 ARS_OD_DistXStd_Obj_30 ARS_OD_DistYStd_Obj_30 ARS_OD_VabsXStd_Obj_30 ARS_OD_VabsYStd_Obj_30 ARS_OD_AabsXStd_Obj_30;
SIG_GROUP_ 529 Signal_Group_ARS_OD_32_33 1 : ARS_OD_DistX_Obj_32 ARS_OD_Classification_Obj_32 ARS_OD_AabsYStd_Obj_32 ARS_OD_ClassConf_Obj_32 ARS_OD_ProbOfExist_Obj_32 ARS_OD_DynConf_Obj_32 ARS_OD_VabsX_Obj_32 ARS_OD_DynProp_Obj_32 ARS_OD_MirrorProb_Obj_32 ARS_OD_Length_Obj_32 ARS_OD_MaintenanceState_Obj_32 ARS_OD_Width_Obj_32 ARS_OD_RCS_Obj_32 ARS_OD_Orientation_Obj_32 ARS_OD_YawRateAbs_Obj_32 ARS_OD_YawRateAbsStd_Obj_32 ARS_OD_RefPoint_Obj_32 ARS_OD_LifeCycle_Obj_32 ARS_OD_DistX_Obj_33 ARS_OD_VabsX_Obj_33 ARS_OD_AabsX_Obj_33 ARS_OD_AabsX_Obj_32 ARS_OD_DistY_Obj_33 ARS_OD_VabsY_Obj_33 ARS_OD_AabsY_Obj_33 ARS_OD_DistXStd_Obj_33 ARS_OD_DistYStd_Obj_33 ARS_OD_VabsXStd_Obj_33 ARS_OD_VabsYStd_Obj_33 ARS_OD_AabsXStd_Obj_33 ARS_OD_Classification_Obj_33 ARS_OD_AabsYStd_Obj_33 ARS_OD_ClassConf_Obj_33 ARS_OD_DistY_Obj_32 ARS_OD_ProbOfExist_Obj_33 ARS_OD_DynConf_Obj_33 ARS_OD_DynProp_Obj_33 ARS_OD_MirrorProb_Obj_33 ARS_OD_Length_Obj_33 ARS_OD_MaintenanceState_Obj_33 ARS_OD_Width_Obj_33 ARS_OD_RCS_Obj_33 ARS_OD_Orientation_Obj_33 ARS_OD_YawRateAbs_Obj_33 ARS_OD_YawRateAbsStd_Obj_33 ARS_OD_RefPoint_Obj_33 ARS_OD_LifeCycle_Obj_33 ARS_OD_OrientationStd_Obj_32 ARS_OD_OrientationStd_Obj_33 ARS_OD_ObstacleProb_Obj_32 ARS_OD_MicroDopplerFlag_32 ARS_OD_ObstacleProb_Obj_33 ARS_OD_VabsY_Obj_32 ARS_OD_MicroDopplerFlag_33 ARS_OD_ID_32 ARS_OD_ID_33 ARS_OD_MsgCounter_Obj_32_33 ARS_OD_CRC16_Checksum_Obj_32_33 ARS_OD_AabsY_Obj_32 ARS_OD_DistXStd_Obj_32 ARS_OD_DistYStd_Obj_32 ARS_OD_VabsXStd_Obj_32 ARS_OD_VabsYStd_Obj_32 ARS_OD_AabsXStd_Obj_32;
SIG_GROUP_ 530 Signal_Group_ARS_OD_34_35 1 : ARS_OD_DistX_Obj_34 ARS_OD_Classification_Obj_34 ARS_OD_AabsYStd_Obj_34 ARS_OD_ClassConf_Obj_34 ARS_OD_ProbOfExist_Obj_34 ARS_OD_DynConf_Obj_34 ARS_OD_VabsX_Obj_34 ARS_OD_DynProp_Obj_34 ARS_OD_MirrorProb_Obj_34 ARS_OD_Length_Obj_34 ARS_OD_MaintenanceState_Obj_34 ARS_OD_Width_Obj_34 ARS_OD_RCS_Obj_34 ARS_OD_Orientation_Obj_34 ARS_OD_YawRateAbs_Obj_34 ARS_OD_YawRateAbsStd_Obj_34 ARS_OD_RefPoint_Obj_34 ARS_OD_LifeCycle_Obj_34 ARS_OD_DistX_Obj_35 ARS_OD_VabsX_Obj_35 ARS_OD_AabsX_Obj_35 ARS_OD_AabsX_Obj_34 ARS_OD_DistY_Obj_35 ARS_OD_VabsY_Obj_35 ARS_OD_AabsY_Obj_35 ARS_OD_DistXStd_Obj_35 ARS_OD_DistYStd_Obj_35 ARS_OD_VabsXStd_Obj_35 ARS_OD_VabsYStd_Obj_35 ARS_OD_AabsXStd_Obj_35 ARS_OD_Classification_Obj_35 ARS_OD_AabsYStd_Obj_35 ARS_OD_ClassConf_Obj_35 ARS_OD_DistY_Obj_34 ARS_OD_ProbOfExist_Obj_35 ARS_OD_DynConf_Obj_35 ARS_OD_DynProp_Obj_35 ARS_OD_MirrorProb_Obj_35 ARS_OD_Length_Obj_35 ARS_OD_MaintenanceState_Obj_35 ARS_OD_Width_Obj_35 ARS_OD_RCS_Obj_35 ARS_OD_Orientation_Obj_35 ARS_OD_YawRateAbs_Obj_35 ARS_OD_YawRateAbsStd_Obj_35 ARS_OD_RefPoint_Obj_35 ARS_OD_LifeCycle_Obj_35 ARS_OD_OrientationStd_Obj_34 ARS_OD_OrientationStd_Obj_35 ARS_OD_ObstacleProb_Obj_34 ARS_OD_MicroDopplerFlag_34 ARS_OD_ObstacleProb_Obj_35 ARS_OD_VabsY_Obj_34 ARS_OD_MicroDopplerFlag_35 ARS_OD_ID_34 ARS_OD_ID_35 ARS_OD_MsgCounter_Obj_34_35 ARS_OD_CRC16_Checksum_Obj_34_35 ARS_OD_AabsY_Obj_34 ARS_OD_DistXStd_Obj_34 ARS_OD_DistYStd_Obj_34 ARS_OD_VabsXStd_Obj_34 ARS_OD_VabsYStd_Obj_34 ARS_OD_AabsXStd_Obj_34;
SIG_GROUP_ 531 Signal_Group_ARS_OD_36_37 1 : ARS_OD_DistX_Obj_36 ARS_OD_Classification_Obj_36 ARS_OD_AabsYStd_Obj_36 ARS_OD_ClassConf_Obj_36 ARS_OD_ProbOfExist_Obj_36 ARS_OD_DynConf_Obj_36 ARS_OD_VabsX_Obj_36 ARS_OD_DynProp_Obj_36 ARS_OD_MirrorProb_Obj_36 ARS_OD_Length_Obj_36 ARS_OD_MaintenanceState_Obj_36 ARS_OD_Width_Obj_36 ARS_OD_RCS_Obj_36 ARS_OD_Orientation_Obj_36 ARS_OD_YawRateAbs_Obj_36 ARS_OD_YawRateAbsStd_Obj_36 ARS_OD_RefPoint_Obj_36 ARS_OD_LifeCycle_Obj_36 ARS_OD_DistX_Obj_37 ARS_OD_VabsX_Obj_37 ARS_OD_AabsX_Obj_37 ARS_OD_AabsX_Obj_36 ARS_OD_DistY_Obj_37 ARS_OD_VabsY_Obj_37 ARS_OD_AabsY_Obj_37 ARS_OD_DistXStd_Obj_37 ARS_OD_DistYStd_Obj_37 ARS_OD_VabsXStd_Obj_37 ARS_OD_VabsYStd_Obj_37 ARS_OD_AabsXStd_Obj_37 ARS_OD_Classification_Obj_37 ARS_OD_AabsYStd_Obj_37 ARS_OD_ClassConf_Obj_37 ARS_OD_DistY_Obj_36 ARS_OD_ProbOfExist_Obj_37 ARS_OD_DynConf_Obj_37 ARS_OD_DynProp_Obj_37 ARS_OD_MirrorProb_Obj_37 ARS_OD_Length_Obj_37 ARS_OD_MaintenanceState_Obj_37 ARS_OD_Width_Obj_37 ARS_OD_RCS_Obj_37 ARS_OD_Orientation_Obj_37 ARS_OD_YawRateAbs_Obj_37 ARS_OD_YawRateAbsStd_Obj_37 ARS_OD_RefPoint_Obj_37 ARS_OD_LifeCycle_Obj_37 ARS_OD_OrientationStd_Obj_36 ARS_OD_OrientationStd_Obj_37 ARS_OD_ObstacleProb_Obj_36 ARS_OD_MicroDopplerFlag_36 ARS_OD_ObstacleProb_Obj_37 ARS_OD_VabsY_Obj_36 ARS_OD_MicroDopplerFlag_37 ARS_OD_ID_36 ARS_OD_ID_37 ARS_OD_MsgCounter_Obj_36_37 ARS_OD_CRC16_Checksum_Obj_36_37 ARS_OD_AabsY_Obj_36 ARS_OD_DistXStd_Obj_36 ARS_OD_DistYStd_Obj_36 ARS_OD_VabsXStd_Obj_36 ARS_OD_VabsYStd_Obj_36 ARS_OD_AabsXStd_Obj_36;
SIG_GROUP_ 532 Signal_Group_ARS_OD_38_39 1 : ARS_OD_DistX_Obj_38 ARS_OD_Classification_Obj_38 ARS_OD_AabsYStd_Obj_38 ARS_OD_ClassConf_Obj_38 ARS_OD_ProbOfExist_Obj_38 ARS_OD_DynConf_Obj_38 ARS_OD_VabsX_Obj_38 ARS_OD_DynProp_Obj_38 ARS_OD_MirrorProb_Obj_38 ARS_OD_Length_Obj_38 ARS_OD_MaintenanceState_Obj_38 ARS_OD_Width_Obj_38 ARS_OD_RCS_Obj_38 ARS_OD_Orientation_Obj_38 ARS_OD_YawRateAbs_Obj_38 ARS_OD_YawRateAbsStd_Obj_38 ARS_OD_RefPoint_Obj_38 ARS_OD_LifeCycle_Obj_38 ARS_OD_DistX_Obj_39 ARS_OD_VabsX_Obj_39 ARS_OD_AabsX_Obj_39 ARS_OD_AabsX_Obj_38 ARS_OD_DistY_Obj_39 ARS_OD_VabsY_Obj_39 ARS_OD_AabsY_Obj_39 ARS_OD_DistXStd_Obj_39 ARS_OD_DistYStd_Obj_39 ARS_OD_VabsXStd_Obj_39 ARS_OD_VabsYStd_Obj_39 ARS_OD_AabsXStd_Obj_39 ARS_OD_Classification_Obj_39 ARS_OD_AabsYStd_Obj_39 ARS_OD_ClassConf_Obj_39 ARS_OD_DistY_Obj_38 ARS_OD_ProbOfExist_Obj_39 ARS_OD_DynConf_Obj_39 ARS_OD_DynProp_Obj_39 ARS_OD_MirrorProb_Obj_39 ARS_OD_Length_Obj_39 ARS_OD_MaintenanceState_Obj_39 ARS_OD_Width_Obj_39 ARS_OD_RCS_Obj_39 ARS_OD_Orientation_Obj_39 ARS_OD_YawRateAbs_Obj_39 ARS_OD_YawRateAbsStd_Obj_39 ARS_OD_RefPoint_Obj_39 ARS_OD_LifeCycle_Obj_39 ARS_OD_OrientationStd_Obj_38 ARS_OD_OrientationStd_Obj_39 ARS_OD_ObstacleProb_Obj_38 ARS_OD_MicroDopplerFlag_38 ARS_OD_ObstacleProb_Obj_39 ARS_OD_VabsY_Obj_38 ARS_OD_MicroDopplerFlag_39 ARS_OD_ID_38 ARS_OD_ID_39 ARS_OD_MsgCounter_Obj_38_39 ARS_OD_CRC16_Checksum_Obj_38_39 ARS_OD_AabsY_Obj_38 ARS_OD_DistXStd_Obj_38 ARS_OD_DistYStd_Obj_38 ARS_OD_VabsXStd_Obj_38 ARS_OD_VabsYStd_Obj_38 ARS_OD_AabsXStd_Obj_38;
SIG_GROUP_ 533 Signal_Group_ARS_OD_40_41 1 : ARS_OD_DistX_Obj_40 ARS_OD_Classification_Obj_40 ARS_OD_AabsYStd_Obj_40 ARS_OD_ClassConf_Obj_40 ARS_OD_ProbOfExist_Obj_40 ARS_OD_DynConf_Obj_40 ARS_OD_VabsX_Obj_40 ARS_OD_DynProp_Obj_40 ARS_OD_MirrorProb_Obj_40 ARS_OD_Length_Obj_40 ARS_OD_MaintenanceState_Obj_40 ARS_OD_Width_Obj_40 ARS_OD_RCS_Obj_40 ARS_OD_Orientation_Obj_40 ARS_OD_YawRateAbs_Obj_40 ARS_OD_YawRateAbsStd_Obj_40 ARS_OD_RefPoint_Obj_40 ARS_OD_LifeCycle_Obj_40 ARS_OD_DistX_Obj_41 ARS_OD_VabsX_Obj_41 ARS_OD_AabsX_Obj_41 ARS_OD_AabsX_Obj_40 ARS_OD_DistY_Obj_41 ARS_OD_VabsY_Obj_41 ARS_OD_AabsY_Obj_41 ARS_OD_DistXStd_Obj_41 ARS_OD_DistYStd_Obj_41 ARS_OD_VabsXStd_Obj_41 ARS_OD_VabsYStd_Obj_41 ARS_OD_AabsXStd_Obj_41 ARS_OD_Classification_Obj_41 ARS_OD_AabsYStd_Obj_41 ARS_OD_ClassConf_Obj_41 ARS_OD_DistY_Obj_40 ARS_OD_ProbOfExist_Obj_41 ARS_OD_DynConf_Obj_41 ARS_OD_DynProp_Obj_41 ARS_OD_MirrorProb_Obj_41 ARS_OD_Length_Obj_41 ARS_OD_MaintenanceState_Obj_41 ARS_OD_Width_Obj_41 ARS_OD_RCS_Obj_41 ARS_OD_Orientation_Obj_41 ARS_OD_YawRateAbs_Obj_41 ARS_OD_YawRateAbsStd_Obj_41 ARS_OD_RefPoint_Obj_41 ARS_OD_LifeCycle_Obj_41 ARS_OD_OrientationStd_Obj_40 ARS_OD_OrientationStd_Obj_41 ARS_OD_ObstacleProb_Obj_40 ARS_OD_MicroDopplerFlag_40 ARS_OD_ObstacleProb_Obj_41 ARS_OD_VabsY_Obj_40 ARS_OD_MicroDopplerFlag_41 ARS_OD_ID_40 ARS_OD_ID_41 ARS_OD_MsgCounter_Obj_40_41 ARS_OD_CRC16_Checksum_Obj_40_41 ARS_OD_AabsY_Obj_40 ARS_OD_DistXStd_Obj_40 ARS_OD_DistYStd_Obj_40 ARS_OD_VabsXStd_Obj_40 ARS_OD_VabsYStd_Obj_40 ARS_OD_AabsXStd_Obj_40;
SIG_GROUP_ 534 Signal_Group_ARS_OD_42_43 1 : ARS_OD_DistX_Obj_42 ARS_OD_Classification_Obj_42 ARS_OD_AabsYStd_Obj_42 ARS_OD_ClassConf_Obj_42 ARS_OD_ProbOfExist_Obj_42 ARS_OD_DynConf_Obj_42 ARS_OD_VabsX_Obj_42 ARS_OD_DynProp_Obj_42 ARS_OD_MirrorProb_Obj_42 ARS_OD_Length_Obj_42 ARS_OD_MaintenanceState_Obj_42 ARS_OD_Width_Obj_42 ARS_OD_RCS_Obj_42 ARS_OD_Orientation_Obj_42 ARS_OD_YawRateAbs_Obj_42 ARS_OD_YawRateAbsStd_Obj_42 ARS_OD_RefPoint_Obj_42 ARS_OD_LifeCycle_Obj_42 ARS_OD_DistX_Obj_43 ARS_OD_VabsX_Obj_43 ARS_OD_AabsX_Obj_43 ARS_OD_AabsX_Obj_42 ARS_OD_DistY_Obj_43 ARS_OD_VabsY_Obj_43 ARS_OD_AabsY_Obj_43 ARS_OD_DistXStd_Obj_43 ARS_OD_DistYStd_Obj_43 ARS_OD_VabsXStd_Obj_43 ARS_OD_VabsYStd_Obj_43 ARS_OD_AabsXStd_Obj_43 ARS_OD_Classification_Obj_43 ARS_OD_AabsYStd_Obj_43 ARS_OD_ClassConf_Obj_43 ARS_OD_DistY_Obj_42 ARS_OD_ProbOfExist_Obj_43 ARS_OD_DynConf_Obj_43 ARS_OD_DynProp_Obj_43 ARS_OD_MirrorProb_Obj_43 ARS_OD_Length_Obj_43 ARS_OD_MaintenanceState_Obj_43 ARS_OD_Width_Obj_43 ARS_OD_RCS_Obj_43 ARS_OD_Orientation_Obj_43 ARS_OD_YawRateAbs_Obj_43 ARS_OD_YawRateAbsStd_Obj_43 ARS_OD_RefPoint_Obj_43 ARS_OD_LifeCycle_Obj_43 ARS_OD_OrientationStd_Obj_42 ARS_OD_OrientationStd_Obj_43 ARS_OD_ObstacleProb_Obj_42 ARS_OD_MicroDopplerFlag_42 ARS_OD_ObstacleProb_Obj_43 ARS_OD_VabsY_Obj_42 ARS_OD_MicroDopplerFlag_43 ARS_OD_ID_42 ARS_OD_ID_43 ARS_OD_MsgCounter_Obj_42_43 ARS_OD_CRC16_Checksum_Obj_42_43 ARS_OD_AabsY_Obj_42 ARS_OD_DistXStd_Obj_42 ARS_OD_DistYStd_Obj_42 ARS_OD_VabsXStd_Obj_42 ARS_OD_VabsYStd_Obj_42 ARS_OD_AabsXStd_Obj_42;
SIG_GROUP_ 535 Signal_Group_ARS_OD_44_45 1 : ARS_OD_DistX_Obj_44 ARS_OD_Classification_Obj_44 ARS_OD_AabsYStd_Obj_44 ARS_OD_ClassConf_Obj_44 ARS_OD_ProbOfExist_Obj_44 ARS_OD_DynConf_Obj_44 ARS_OD_VabsX_Obj_44 ARS_OD_DynProp_Obj_44 ARS_OD_MirrorProb_Obj_44 ARS_OD_Length_Obj_44 ARS_OD_MaintenanceState_Obj_44 ARS_OD_Width_Obj_44 ARS_OD_RCS_Obj_44 ARS_OD_Orientation_Obj_44 ARS_OD_YawRateAbs_Obj_44 ARS_OD_YawRateAbsStd_Obj_44 ARS_OD_RefPoint_Obj_44 ARS_OD_LifeCycle_Obj_44 ARS_OD_DistX_Obj_45 ARS_OD_VabsX_Obj_45 ARS_OD_AabsX_Obj_45 ARS_OD_AabsX_Obj_44 ARS_OD_DistY_Obj_45 ARS_OD_VabsY_Obj_45 ARS_OD_AabsY_Obj_45 ARS_OD_DistXStd_Obj_45 ARS_OD_DistYStd_Obj_45 ARS_OD_VabsXStd_Obj_45 ARS_OD_VabsYStd_Obj_45 ARS_OD_AabsXStd_Obj_45 ARS_OD_Classification_Obj_45 ARS_OD_AabsYStd_Obj_45 ARS_OD_ClassConf_Obj_45 ARS_OD_DistY_Obj_44 ARS_OD_ProbOfExist_Obj_45 ARS_OD_DynConf_Obj_45 ARS_OD_DynProp_Obj_45 ARS_OD_MirrorProb_Obj_45 ARS_OD_Length_Obj_45 ARS_OD_MaintenanceState_Obj_45 ARS_OD_Width_Obj_45 ARS_OD_RCS_Obj_45 ARS_OD_Orientation_Obj_45 ARS_OD_YawRateAbs_Obj_45 ARS_OD_YawRateAbsStd_Obj_45 ARS_OD_RefPoint_Obj_45 ARS_OD_LifeCycle_Obj_45 ARS_OD_OrientationStd_Obj_44 ARS_OD_OrientationStd_Obj_45 ARS_OD_ObstacleProb_Obj_44 ARS_OD_MicroDopplerFlag_44 ARS_OD_ObstacleProb_Obj_45 ARS_OD_VabsY_Obj_44 ARS_OD_MicroDopplerFlag_45 ARS_OD_ID_44 ARS_OD_ID_45 ARS_OD_MsgCounter_Obj_44_45 ARS_OD_CRC16_Checksum_Obj_44_45 ARS_OD_AabsY_Obj_44 ARS_OD_DistXStd_Obj_44 ARS_OD_DistYStd_Obj_44 ARS_OD_VabsXStd_Obj_44 ARS_OD_VabsYStd_Obj_44 ARS_OD_AabsXStd_Obj_44;
SIG_GROUP_ 536 Signal_Group_ARS_OD_46_47 1 : ARS_OD_DistX_Obj_46 ARS_OD_Classification_Obj_46 ARS_OD_AabsYStd_Obj_46 ARS_OD_ClassConf_Obj_46 ARS_OD_ProbOfExist_Obj_46 ARS_OD_DynConf_Obj_46 ARS_OD_VabsX_Obj_46 ARS_OD_DynProp_Obj_46 ARS_OD_MirrorProb_Obj_46 ARS_OD_Length_Obj_46 ARS_OD_MaintenanceState_Obj_46 ARS_OD_Width_Obj_46 ARS_OD_RCS_Obj_46 ARS_OD_Orientation_Obj_46 ARS_OD_YawRateAbs_Obj_46 ARS_OD_YawRateAbsStd_Obj_46 ARS_OD_RefPoint_Obj_46 ARS_OD_LifeCycle_Obj_46 ARS_OD_DistX_Obj_47 ARS_OD_VabsX_Obj_47 ARS_OD_AabsX_Obj_47 ARS_OD_AabsX_Obj_46 ARS_OD_DistY_Obj_47 ARS_OD_VabsY_Obj_47 ARS_OD_AabsY_Obj_47 ARS_OD_DistXStd_Obj_47 ARS_OD_DistYStd_Obj_47 ARS_OD_VabsXStd_Obj_47 ARS_OD_VabsYStd_Obj_47 ARS_OD_AabsXStd_Obj_47 ARS_OD_Classification_Obj_47 ARS_OD_AabsYStd_Obj_47 ARS_OD_ClassConf_Obj_47 ARS_OD_DistY_Obj_46 ARS_OD_ProbOfExist_Obj_47 ARS_OD_DynConf_Obj_47 ARS_OD_DynProp_Obj_47 ARS_OD_MirrorProb_Obj_47 ARS_OD_Length_Obj_47 ARS_OD_MaintenanceState_Obj_47 ARS_OD_Width_Obj_47 ARS_OD_RCS_Obj_47 ARS_OD_Orientation_Obj_47 ARS_OD_YawRateAbs_Obj_47 ARS_OD_YawRateAbsStd_Obj_47 ARS_OD_RefPoint_Obj_47 ARS_OD_LifeCycle_Obj_47 ARS_OD_OrientationStd_Obj_46 ARS_OD_OrientationStd_Obj_47 ARS_OD_ObstacleProb_Obj_46 ARS_OD_MicroDopplerFlag_46 ARS_OD_ObstacleProb_Obj_47 ARS_OD_VabsY_Obj_46 ARS_OD_MicroDopplerFlag_47 ARS_OD_ID_46 ARS_OD_ID_47 ARS_OD_MsgCounter_Obj_46_47 ARS_OD_CRC16_Checksum_Obj_46_47 ARS_OD_AabsY_Obj_46 ARS_OD_DistXStd_Obj_46 ARS_OD_DistYStd_Obj_46 ARS_OD_VabsXStd_Obj_46 ARS_OD_VabsYStd_Obj_46 ARS_OD_AabsXStd_Obj_46;
SIG_GROUP_ 537 Signal_Group_ARS_OD_48_49 1 : ARS_OD_DistX_Obj_48 ARS_OD_Classification_Obj_48 ARS_OD_AabsYStd_Obj_48 ARS_OD_ClassConf_Obj_48 ARS_OD_ProbOfExist_Obj_48 ARS_OD_DynConf_Obj_48 ARS_OD_VabsX_Obj_48 ARS_OD_DynProp_Obj_48 ARS_OD_MirrorProb_Obj_48 ARS_OD_Length_Obj_48 ARS_OD_MaintenanceState_Obj_48 ARS_OD_Width_Obj_48 ARS_OD_RCS_Obj_48 ARS_OD_Orientation_Obj_48 ARS_OD_YawRateAbs_Obj_48 ARS_OD_YawRateAbsStd_Obj_48 ARS_OD_RefPoint_Obj_48 ARS_OD_LifeCycle_Obj_48 ARS_OD_DistX_Obj_49 ARS_OD_VabsX_Obj_49 ARS_OD_AabsX_Obj_49 ARS_OD_AabsX_Obj_48 ARS_OD_DistY_Obj_49 ARS_OD_VabsY_Obj_49 ARS_OD_AabsY_Obj_49 ARS_OD_DistXStd_Obj_49 ARS_OD_DistYStd_Obj_49 ARS_OD_VabsXStd_Obj_49 ARS_OD_VabsYStd_Obj_49 ARS_OD_AabsXStd_Obj_49 ARS_OD_Classification_Obj_49 ARS_OD_AabsYStd_Obj_49 ARS_OD_ClassConf_Obj_49 ARS_OD_DistY_Obj_48 ARS_OD_ProbOfExist_Obj_49 ARS_OD_DynConf_Obj_49 ARS_OD_DynProp_Obj_49 ARS_OD_MirrorProb_Obj_49 ARS_OD_Length_Obj_49 ARS_OD_MaintenanceState_Obj_49 ARS_OD_Width_Obj_49 ARS_OD_RCS_Obj_49 ARS_OD_Orientation_Obj_49 ARS_OD_YawRateAbs_Obj_49 ARS_OD_YawRateAbsStd_Obj_49 ARS_OD_RefPoint_Obj_49 ARS_OD_LifeCycle_Obj_49 ARS_OD_OrientationStd_Obj_48 ARS_OD_OrientationStd_Obj_49 ARS_OD_ObstacleProb_Obj_48 ARS_OD_MicroDopplerFlag_48 ARS_OD_ObstacleProb_Obj_49 ARS_OD_VabsY_Obj_48 ARS_OD_MicroDopplerFlag_49 ARS_OD_ID_48 ARS_OD_ID_49 ARS_OD_MsgCounter_Obj_48_49 ARS_OD_CRC16_Checksum_Obj_48_49 ARS_OD_AabsY_Obj_48 ARS_OD_DistXStd_Obj_48 ARS_OD_DistYStd_Obj_48 ARS_OD_VabsXStd_Obj_48 ARS_OD_VabsYStd_Obj_48 ARS_OD_AabsXStd_Obj_48;
SIG_GROUP_ 538 Signal_Group_ARS_OD_50_51 1 : ARS_OD_DistX_Obj_50 ARS_OD_Classification_Obj_50 ARS_OD_AabsYStd_Obj_50 ARS_OD_ClassConf_Obj_50 ARS_OD_ProbOfExist_Obj_50 ARS_OD_DynConf_Obj_50 ARS_OD_VabsX_Obj_50 ARS_OD_DynProp_Obj_50 ARS_OD_MirrorProb_Obj_50 ARS_OD_Length_Obj_50 ARS_OD_MaintenanceState_Obj_50 ARS_OD_Width_Obj_50 ARS_OD_RCS_Obj_50 ARS_OD_Orientation_Obj_50 ARS_OD_YawRateAbs_Obj_50 ARS_OD_YawRateAbsStd_Obj_50 ARS_OD_RefPoint_Obj_50 ARS_OD_LifeCycle_Obj_50 ARS_OD_DistX_Obj_51 ARS_OD_VabsX_Obj_51 ARS_OD_AabsX_Obj_51 ARS_OD_AabsX_Obj_50 ARS_OD_DistY_Obj_51 ARS_OD_VabsY_Obj_51 ARS_OD_AabsY_Obj_51 ARS_OD_DistXStd_Obj_51 ARS_OD_DistYStd_Obj_51 ARS_OD_VabsXStd_Obj_51 ARS_OD_VabsYStd_Obj_51 ARS_OD_AabsXStd_Obj_51 ARS_OD_Classification_Obj_51 ARS_OD_AabsYStd_Obj_51 ARS_OD_ClassConf_Obj_51 ARS_OD_DistY_Obj_50 ARS_OD_ProbOfExist_Obj_51 ARS_OD_DynConf_Obj_51 ARS_OD_DynProp_Obj_51 ARS_OD_MirrorProb_Obj_51 ARS_OD_Length_Obj_51 ARS_OD_MaintenanceState_Obj_51 ARS_OD_Width_Obj_51 ARS_OD_RCS_Obj_51 ARS_OD_Orientation_Obj_51 ARS_OD_YawRateAbs_Obj_51 ARS_OD_YawRateAbsStd_Obj_51 ARS_OD_RefPoint_Obj_51 ARS_OD_LifeCycle_Obj_51 ARS_OD_OrientationStd_Obj_50 ARS_OD_OrientationStd_Obj_51 ARS_OD_ObstacleProb_Obj_50 ARS_OD_MicroDopplerFlag_50 ARS_OD_ObstacleProb_Obj_51 ARS_OD_VabsY_Obj_50 ARS_OD_MicroDopplerFlag_51 ARS_OD_ID_50 ARS_OD_ID_51 ARS_OD_MsgCounter_Obj_50_51 ARS_OD_CRC16_Checksum_Obj_50_51 ARS_OD_AabsY_Obj_50 ARS_OD_DistXStd_Obj_50 ARS_OD_DistYStd_Obj_50 ARS_OD_VabsXStd_Obj_50 ARS_OD_VabsYStd_Obj_50 ARS_OD_AabsXStd_Obj_50;
SIG_GROUP_ 539 Signal_Group_ARS_OD_52_53 1 : ARS_OD_DistX_Obj_52 ARS_OD_Classification_Obj_52 ARS_OD_AabsYStd_Obj_52 ARS_OD_ClassConf_Obj_52 ARS_OD_ProbOfExist_Obj_52 ARS_OD_DynConf_Obj_52 ARS_OD_VabsX_Obj_52 ARS_OD_DynProp_Obj_52 ARS_OD_MirrorProb_Obj_52 ARS_OD_Length_Obj_52 ARS_OD_MaintenanceState_Obj_52 ARS_OD_Width_Obj_52 ARS_OD_RCS_Obj_52 ARS_OD_Orientation_Obj_52 ARS_OD_YawRateAbs_Obj_52 ARS_OD_YawRateAbsStd_Obj_52 ARS_OD_RefPoint_Obj_52 ARS_OD_LifeCycle_Obj_52 ARS_OD_DistX_Obj_53 ARS_OD_VabsX_Obj_53 ARS_OD_AabsX_Obj_53 ARS_OD_AabsX_Obj_52 ARS_OD_DistY_Obj_53 ARS_OD_VabsY_Obj_53 ARS_OD_AabsY_Obj_53 ARS_OD_DistXStd_Obj_53 ARS_OD_DistYStd_Obj_53 ARS_OD_VabsXStd_Obj_53 ARS_OD_VabsYStd_Obj_53 ARS_OD_AabsXStd_Obj_53 ARS_OD_Classification_Obj_53 ARS_OD_AabsYStd_Obj_53 ARS_OD_ClassConf_Obj_53 ARS_OD_DistY_Obj_52 ARS_OD_ProbOfExist_Obj_53 ARS_OD_DynConf_Obj_53 ARS_OD_DynProp_Obj_53 ARS_OD_MirrorProb_Obj_53 ARS_OD_Length_Obj_53 ARS_OD_MaintenanceState_Obj_53 ARS_OD_Width_Obj_53 ARS_OD_RCS_Obj_53 ARS_OD_Orientation_Obj_53 ARS_OD_YawRateAbs_Obj_53 ARS_OD_YawRateAbsStd_Obj_53 ARS_OD_RefPoint_Obj_53 ARS_OD_LifeCycle_Obj_53 ARS_OD_OrientationStd_Obj_52 ARS_OD_OrientationStd_Obj_53 ARS_OD_ObstacleProb_Obj_52 ARS_OD_MicroDopplerFlag_52 ARS_OD_ObstacleProb_Obj_53 ARS_OD_VabsY_Obj_52 ARS_OD_MicroDopplerFlag_53 ARS_OD_ID_52 ARS_OD_ID_53 ARS_OD_MsgCounter_Obj_52_53 ARS_OD_CRC16_Checksum_Obj_52_53 ARS_OD_AabsY_Obj_52 ARS_OD_DistXStd_Obj_52 ARS_OD_DistYStd_Obj_52 ARS_OD_VabsXStd_Obj_52 ARS_OD_VabsYStd_Obj_52 ARS_OD_AabsXStd_Obj_52;
SIG_GROUP_ 540 Signal_Group_ARS_OD_54_55 1 : ARS_OD_DistX_Obj_54 ARS_OD_Classification_Obj_54 ARS_OD_AabsYStd_Obj_54 ARS_OD_ClassConf_Obj_54 ARS_OD_ProbOfExist_Obj_54 ARS_OD_DynConf_Obj_54 ARS_OD_VabsX_Obj_54 ARS_OD_DynProp_Obj_54 ARS_OD_MirrorProb_Obj_54 ARS_OD_Length_Obj_54 ARS_OD_MaintenanceState_Obj_54 ARS_OD_Width_Obj_54 ARS_OD_RCS_Obj_54 ARS_OD_Orientation_Obj_54 ARS_OD_YawRateAbs_Obj_54 ARS_OD_YawRateAbsStd_Obj_54 ARS_OD_RefPoint_Obj_54 ARS_OD_LifeCycle_Obj_54 ARS_OD_DistX_Obj_55 ARS_OD_VabsX_Obj_55 ARS_OD_AabsX_Obj_55 ARS_OD_AabsX_Obj_54 ARS_OD_DistY_Obj_55 ARS_OD_VabsY_Obj_55 ARS_OD_AabsY_Obj_55 ARS_OD_DistXStd_Obj_55 ARS_OD_DistYStd_Obj_55 ARS_OD_VabsXStd_Obj_55 ARS_OD_VabsYStd_Obj_55 ARS_OD_AabsXStd_Obj_55 ARS_OD_Classification_Obj_55 ARS_OD_AabsYStd_Obj_55 ARS_OD_ClassConf_Obj_55 ARS_OD_DistY_Obj_54 ARS_OD_ProbOfExist_Obj_55 ARS_OD_DynConf_Obj_55 ARS_OD_DynProp_Obj_55 ARS_OD_MirrorProb_Obj_55 ARS_OD_Length_Obj_55 ARS_OD_MaintenanceState_Obj_55 ARS_OD_Width_Obj_55 ARS_OD_RCS_Obj_55 ARS_OD_Orientation_Obj_55 ARS_OD_YawRateAbs_Obj_55 ARS_OD_YawRateAbsStd_Obj_55 ARS_OD_RefPoint_Obj_55 ARS_OD_LifeCycle_Obj_55 ARS_OD_OrientationStd_Obj_54 ARS_OD_OrientationStd_Obj_55 ARS_OD_ObstacleProb_Obj_54 ARS_OD_MicroDopplerFlag_54 ARS_OD_ObstacleProb_Obj_55 ARS_OD_VabsY_Obj_54 ARS_OD_MicroDopplerFlag_55 ARS_OD_ID_54 ARS_OD_ID_55 ARS_OD_MsgCounter_Obj_54_55 ARS_OD_CRC16_Checksum_Obj_54_55 ARS_OD_AabsY_Obj_54 ARS_OD_DistXStd_Obj_54 ARS_OD_DistYStd_Obj_54 ARS_OD_VabsXStd_Obj_54 ARS_OD_VabsYStd_Obj_54 ARS_OD_AabsXStd_Obj_54;
SIG_GROUP_ 541 Signal_Group_ARS_OD_56_57 1 : ARS_OD_DistX_Obj_56 ARS_OD_Classification_Obj_56 ARS_OD_AabsYStd_Obj_56 ARS_OD_ClassConf_Obj_56 ARS_OD_ProbOfExist_Obj_56 ARS_OD_DynConf_Obj_56 ARS_OD_VabsX_Obj_56 ARS_OD_DynProp_Obj_56 ARS_OD_MirrorProb_Obj_56 ARS_OD_Length_Obj_56 ARS_OD_MaintenanceState_Obj_56 ARS_OD_Width_Obj_56 ARS_OD_RCS_Obj_56 ARS_OD_Orientation_Obj_56 ARS_OD_YawRateAbs_Obj_56 ARS_OD_YawRateAbsStd_Obj_56 ARS_OD_RefPoint_Obj_56 ARS_OD_LifeCycle_Obj_56 ARS_OD_DistX_Obj_57 ARS_OD_VabsX_Obj_57 ARS_OD_AabsX_Obj_57 ARS_OD_AabsX_Obj_56 ARS_OD_DistY_Obj_57 ARS_OD_VabsY_Obj_57 ARS_OD_AabsY_Obj_57 ARS_OD_DistXStd_Obj_57 ARS_OD_DistYStd_Obj_57 ARS_OD_VabsXStd_Obj_57 ARS_OD_VabsYStd_Obj_57 ARS_OD_AabsXStd_Obj_57 ARS_OD_Classification_Obj_57 ARS_OD_AabsYStd_Obj_57 ARS_OD_ClassConf_Obj_57 ARS_OD_DistY_Obj_56 ARS_OD_ProbOfExist_Obj_57 ARS_OD_DynConf_Obj_57 ARS_OD_DynProp_Obj_57 ARS_OD_MirrorProb_Obj_57 ARS_OD_Length_Obj_57 ARS_OD_MaintenanceState_Obj_57 ARS_OD_Width_Obj_57 ARS_OD_RCS_Obj_57 ARS_OD_Orientation_Obj_57 ARS_OD_YawRateAbs_Obj_57 ARS_OD_YawRateAbsStd_Obj_57 ARS_OD_RefPoint_Obj_57 ARS_OD_LifeCycle_Obj_57 ARS_OD_OrientationStd_Obj_56 ARS_OD_OrientationStd_Obj_57 ARS_OD_ObstacleProb_Obj_56 ARS_OD_MicroDopplerFlag_56 ARS_OD_ObstacleProb_Obj_57 ARS_OD_VabsY_Obj_56 ARS_OD_MicroDopplerFlag_57 ARS_OD_ID_56 ARS_OD_ID_57 ARS_OD_MsgCounter_Obj_56_57 ARS_OD_CRC16_Checksum_Obj_56_57 ARS_OD_AabsY_Obj_56 ARS_OD_DistXStd_Obj_56 ARS_OD_DistYStd_Obj_56 ARS_OD_VabsXStd_Obj_56 ARS_OD_VabsYStd_Obj_56 ARS_OD_AabsXStd_Obj_56;
SIG_GROUP_ 542 Signal_Group_ARS_OD_58_59 1 : ARS_OD_DistX_Obj_58 ARS_OD_Classification_Obj_58 ARS_OD_AabsYStd_Obj_58 ARS_OD_ClassConf_Obj_58 ARS_OD_ProbOfExist_Obj_58 ARS_OD_DynConf_Obj_58 ARS_OD_VabsX_Obj_58 ARS_OD_DynProp_Obj_58 ARS_OD_MirrorProb_Obj_58 ARS_OD_Length_Obj_58 ARS_OD_MaintenanceState_Obj_58 ARS_OD_Width_Obj_58 ARS_OD_RCS_Obj_58 ARS_OD_Orientation_Obj_58 ARS_OD_YawRateAbs_Obj_58 ARS_OD_YawRateAbsStd_Obj_58 ARS_OD_RefPoint_Obj_58 ARS_OD_LifeCycle_Obj_58 ARS_OD_DistX_Obj_59 ARS_OD_VabsX_Obj_59 ARS_OD_AabsX_Obj_59 ARS_OD_AabsX_Obj_58 ARS_OD_DistY_Obj_59 ARS_OD_VabsY_Obj_59 ARS_OD_AabsY_Obj_59 ARS_OD_DistXStd_Obj_59 ARS_OD_DistYStd_Obj_59 ARS_OD_VabsXStd_Obj_59 ARS_OD_VabsYStd_Obj_59 ARS_OD_AabsXStd_Obj_59 ARS_OD_Classification_Obj_59 ARS_OD_AabsYStd_Obj_59 ARS_OD_ClassConf_Obj_59 ARS_OD_DistY_Obj_58 ARS_OD_ProbOfExist_Obj_59 ARS_OD_DynConf_Obj_59 ARS_OD_DynProp_Obj_59 ARS_OD_MirrorProb_Obj_59 ARS_OD_Length_Obj_59 ARS_OD_MaintenanceState_Obj_59 ARS_OD_Width_Obj_59 ARS_OD_RCS_Obj_59 ARS_OD_Orientation_Obj_59 ARS_OD_YawRateAbs_Obj_59 ARS_OD_YawRateAbsStd_Obj_59 ARS_OD_RefPoint_Obj_59 ARS_OD_LifeCycle_Obj_59 ARS_OD_OrientationStd_Obj_58 ARS_OD_OrientationStd_Obj_59 ARS_OD_ObstacleProb_Obj_58 ARS_OD_MicroDopplerFlag_58 ARS_OD_ObstacleProb_Obj_59 ARS_OD_VabsY_Obj_58 ARS_OD_MicroDopplerFlag_59 ARS_OD_ID_58 ARS_OD_ID_59 ARS_OD_MsgCounter_Obj_58_59 ARS_OD_CRC16_Checksum_Obj_58_59 ARS_OD_AabsY_Obj_58 ARS_OD_DistXStd_Obj_58 ARS_OD_DistYStd_Obj_58 ARS_OD_VabsXStd_Obj_58 ARS_OD_VabsYStd_Obj_58 ARS_OD_AabsXStd_Obj_58;
SIG_GROUP_ 543 Signal_Group_ARS_ROAD 1 : ARS_RD_ClothoidParam_1 ARS_RD_NofLane_Left ARS_RD_NofLaneProb_Left ARS_RD_Confidence_Right ARS_RD_NofLane_Right ARS_RD_NofLaneProb_Right ARS_RD_ClothoidParam_2 ARS_RD_RoadType ARS_RD_MsgCounter ARS_RD_CRC16_Checksum ARS_RD_ClothoidParam_3 ARS_RD_RoadTypeConf ARS_RD_Xstart_Left ARS_RD_Xstart_Right ARS_RD_Xend_Left ARS_RD_Xend_Right ARS_RD_LatOffset_Left ARS_RD_LatOffset_Right ARS_RD_Confidence_Left;
