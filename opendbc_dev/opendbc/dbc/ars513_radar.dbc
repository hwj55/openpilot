VERSION "created by canmatrix"

NS_ :

BS_:

BU_: FR GW

BO_ 273 ARS_RDI_128_135: 64 FR
 SG_ ARS_RDI_Range_Clu_128 : 7|12@0+ (0.0625,0) [0|255.9375] "m"  GW
 SG_ ARS_RDI_ElevationAng_Clu_129 : 109|7@0+ (0.005,-0.315) [-0.315|0.32] "rad"  GW
 SG_ ARS_RDI_SNR_Clu_129 : 118|7@0+ (0.5,0) [0|63.5] "dB"  GW
 SG_ ARS_RDI_Range_Clu_130 : 127|12@0+ (0.0625,0) [0|255.9375] "m"  GW
 SG_ ARS_RDI_VradRel_Clu_128 : 11|11@0+ (0.1,-120) [-120|84.7] "m/s"  GW
 SG_ ARS_RDI_VradRel_Clu_130 : 131|11@0+ (0.1,-120) [-120|84.7] "m/s"  GW
 SG_ ARS_RDI_RCS_Clu_130 : 136|9@0+ (0.2,-51.2) [-51.2|51] "dBsm"  GW
 SG_ ARS_RDI_AzimuthAng_Clu_130 : 159|10@0+ (0.002,-1.022) [-1.022|1.024] "rad"  GW
 SG_ ARS_RDI_ElevationAng_Clu_130 : 165|7@0+ (0.005,-0.315) [-0.315|0.32] "rad"  GW
 SG_ ARS_RDI_SNR_Clu_130 : 174|7@0+ (0.5,0) [0|63.5] "dB"  GW
 SG_ ARS_RDI_DynProp_Clu_130 : 183|2@0+ (1,0) [0|3] ""  GW
 SG_ ARS_RDI_Quality_Clu_130 : 181|2@0+ (1,0) [0|3] ""  GW
 SG_ ARS_RDI_DynProp_Clu_131 : 179|2@0+ (1,0) [0|3] ""  GW
 SG_ ARS_RDI_Quality_Clu_131 : 177|2@0+ (1,0) [0|3] ""  GW
 SG_ ARS_RDI_Range_Clu_131 : 191|12@0+ (0.0625,0) [0|255.9375] "m"  GW
 SG_ ARS_RDI_VradRel_Clu_131 : 195|11@0+ (0.1,-120) [-120|84.7] "m/s"  GW
 SG_ ARS_RDI_RCS_Clu_131 : 200|9@0+ (0.2,-51.2) [-51.2|51] "dBsm"  GW
 SG_ ARS_RDI_AzimuthAng_Clu_131 : 223|10@0+ (0.002,-1.022) [-1.022|1.024] "rad"  GW
 SG_ ARS_RDI_ElevationAng_Clu_131 : 229|7@0+ (0.005,-0.315) [-0.315|0.32] "rad"  GW
 SG_ ARS_RDI_SNR_Clu_131 : 238|7@0+ (0.5,0) [0|63.5] "dB"  GW
 SG_ ARS_RDI_RCS_Clu_128 : 16|9@0+ (0.2,-51.2) [-51.2|51] "dBsm"  GW
 SG_ ARS_RDI_Range_Clu_132 : 247|12@0+ (0.0625,0) [0|255.9375] "m"  GW
 SG_ ARS_RDI_VradRel_Clu_132 : 251|11@0+ (0.1,-120) [-120|84.7] "m/s"  GW
 SG_ ARS_RDI_RCS_Clu_132 : 256|9@0+ (0.2,-51.2) [-51.2|51] "dBsm"  GW
 SG_ ARS_RDI_AzimuthAng_Clu_132 : 279|10@0+ (0.002,-1.022) [-1.022|1.024] "rad"  GW
 SG_ ARS_RDI_ElevationAng_Clu_132 : 285|7@0+ (0.005,-0.315) [-0.315|0.32] "rad"  GW
 SG_ ARS_RDI_SNR_Clu_132 : 294|7@0+ (0.5,0) [0|63.5] "dB"  GW
 SG_ ARS_RDI_DynProp_Clu_132 : 303|2@0+ (1,0) [0|3] ""  GW
 SG_ ARS_RDI_Quality_Clu_132 : 301|2@0+ (1,0) [0|3] ""  GW
 SG_ ARS_RDI_DynProp_Clu_133 : 299|2@0+ (1,0) [0|3] ""  GW
 SG_ ARS_RDI_Quality_Clu_133 : 297|2@0+ (1,0) [0|3] ""  GW
 SG_ ARS_RDI_Range_Clu_133 : 311|12@0+ (0.0625,0) [0|255.9375] "m"  GW
 SG_ ARS_RDI_VradRel_Clu_133 : 315|11@0+ (0.1,-120) [-120|84.7] "m/s"  GW
 SG_ ARS_RDI_RCS_Clu_133 : 320|9@0+ (0.2,-51.2) [-51.2|51] "dBsm"  GW
 SG_ ARS_RDI_AzimuthAng_Clu_128 : 39|10@0+ (0.002,-1.022) [-1.022|1.024] "rad"  GW
 SG_ ARS_RDI_AzimuthAng_Clu_133 : 343|10@0+ (0.002,-1.022) [-1.022|1.024] "rad"  GW
 SG_ ARS_RDI_ElevationAng_Clu_133 : 349|7@0+ (0.005,-0.315) [-0.315|0.32] "rad"  GW
 SG_ ARS_RDI_SNR_Clu_133 : 358|7@0+ (0.5,0) [0|63.5] "dB"  GW
 SG_ ARS_RDI_Range_Clu_134 : 367|12@0+ (0.0625,0) [0|255.9375] "m"  GW
 SG_ ARS_RDI_VradRel_Clu_134 : 371|11@0+ (0.1,-120) [-120|84.7] "m/s"  GW
 SG_ ARS_RDI_RCS_Clu_134 : 376|9@0+ (0.2,-51.2) [-51.2|51] "dBsm"  GW
 SG_ ARS_RDI_AzimuthAng_Clu_134 : 399|10@0+ (0.002,-1.022) [-1.022|1.024] "rad"  GW
 SG_ ARS_RDI_ElevationAng_Clu_134 : 405|7@0+ (0.005,-0.315) [-0.315|0.32] "rad"  GW
 SG_ ARS_RDI_SNR_Clu_134 : 414|7@0+ (0.5,0) [0|63.5] "dB"  GW
 SG_ ARS_RDI_DynProp_Clu_134 : 423|2@0+ (1,0) [0|3] ""  GW
 SG_ ARS_RDI_Quality_Clu_134 : 421|2@0+ (1,0) [0|3] ""  GW
 SG_ ARS_RDI_DynProp_Clu_135 : 419|2@0+ (1,0) [0|3] ""  GW
 SG_ ARS_RDI_Quality_Clu_135 : 417|2@0+ (1,0) [0|3] ""  GW
 SG_ ARS_RDI_Range_Clu_135 : 431|12@0+ (0.0625,0) [0|255.9375] "m"  GW
 SG_ ARS_RDI_ElevationAng_Clu_128 : 45|7@0+ (0.005,-0.315) [-0.315|0.32] "rad"  GW
 SG_ ARS_RDI_VradRel_Clu_135 : 435|11@0+ (0.1,-120) [-120|84.7] "m/s"  GW
 SG_ ARS_RDI_RCS_Clu_135 : 440|9@0+ (0.2,-51.2) [-51.2|51] "dBsm"  GW
 SG_ ARS_RDI_AzimuthAng_Clu_135 : 463|10@0+ (0.002,-1.022) [-1.022|1.024] "rad"  GW
 SG_ ARS_RDI_ElevationAng_Clu_135 : 469|7@0+ (0.005,-0.315) [-0.315|0.32] "rad"  GW
 SG_ ARS_RDI_SNR_Clu_135 : 478|7@0+ (0.5,0) [0|63.5] "dB"  GW
 SG_ ARS_RDI_MsgCounter_Clu_128_135 : 495|8@0+ (1,0) [0|255] ""  GW
 SG_ ARS_RDI_CRC16_Checksum_Clu_128_1 : 503|16@0+ (1,0) [0|65535] ""  GW
 SG_ ARS_RDI_SNR_Clu_128 : 54|7@0+ (0.5,0) [0|63.5] "dB"  GW
 SG_ ARS_RDI_DynProp_Clu_128 : 63|2@0+ (1,0) [0|3] ""  GW
 SG_ ARS_RDI_Quality_Clu_128 : 61|2@0+ (1,0) [0|3] ""  GW
 SG_ ARS_RDI_DynProp_Clu_129 : 59|2@0+ (1,0) [0|3] ""  GW
 SG_ ARS_RDI_Quality_Clu_129 : 57|2@0+ (1,0) [0|3] ""  GW
 SG_ ARS_RDI_Range_Clu_129 : 71|12@0+ (0.0625,0) [0|255.9375] "m"  GW
 SG_ ARS_RDI_VradRel_Clu_129 : 75|11@0+ (0.1,-120) [-120|84.7] "m/s"  GW
 SG_ ARS_RDI_RCS_Clu_129 : 80|9@0+ (0.2,-51.2) [-51.2|51] "dBsm"  GW
 SG_ ARS_RDI_AzimuthAng_Clu_129 : 103|10@0+ (0.002,-1.022) [-1.022|1.024] "rad"  GW

BO_ 274 ARS_RDI_136_143: 64 FR
 SG_ ARS_RDI_Range_Clu_136 : 7|12@0+ (0.0625,0) [0|255.9375] "m"  GW
 SG_ ARS_RDI_ElevationAng_Clu_137 : 109|7@0+ (0.005,-0.315) [-0.315|0.32] "rad"  GW
 SG_ ARS_RDI_SNR_Clu_137 : 118|7@0+ (0.5,0) [0|63.5] "dB"  GW
 SG_ ARS_RDI_Range_Clu_138 : 127|12@0+ (0.0625,0) [0|255.9375] "m"  GW
 SG_ ARS_RDI_VradRel_Clu_136 : 11|11@0+ (0.1,-120) [-120|84.7] "m/s"  GW
 SG_ ARS_RDI_VradRel_Clu_138 : 131|11@0+ (0.1,-120) [-120|84.7] "m/s"  GW
 SG_ ARS_RDI_RCS_Clu_138 : 136|9@0+ (0.2,-51.2) [-51.2|51] "dBsm"  GW
 SG_ ARS_RDI_AzimuthAng_Clu_138 : 159|10@0+ (0.002,-1.022) [-1.022|1.024] "rad"  GW
 SG_ ARS_RDI_ElevationAng_Clu_138 : 165|7@0+ (0.005,-0.315) [-0.315|0.32] "rad"  GW
 SG_ ARS_RDI_SNR_Clu_138 : 174|7@0+ (0.5,0) [0|63.5] "dB"  GW
 SG_ ARS_RDI_DynProp_Clu_138 : 183|2@0+ (1,0) [0|3] ""  GW
 SG_ ARS_RDI_Quality_Clu_138 : 181|2@0+ (1,0) [0|3] ""  GW
 SG_ ARS_RDI_DynProp_Clu_139 : 179|2@0+ (1,0) [0|3] ""  GW
 SG_ ARS_RDI_Quality_Clu_139 : 177|2@0+ (1,0) [0|3] ""  GW
 SG_ ARS_RDI_Range_Clu_139 : 191|12@0+ (0.0625,0) [0|255.9375] "m"  GW
 SG_ ARS_RDI_VradRel_Clu_139 : 195|11@0+ (0.1,-120) [-120|84.7] "m/s"  GW
 SG_ ARS_RDI_RCS_Clu_139 : 200|9@0+ (0.2,-51.2) [-51.2|51] "dBsm"  GW
 SG_ ARS_RDI_AzimuthAng_Clu_139 : 223|10@0+ (0.002,-1.022) [-1.022|1.024] "rad"  GW
 SG_ ARS_RDI_ElevationAng_Clu_139 : 229|7@0+ (0.005,-0.315) [-0.315|0.32] "rad"  GW
 SG_ ARS_RDI_SNR_Clu_139 : 238|7@0+ (0.5,0) [0|63.5] "dB"  GW
 SG_ ARS_RDI_RCS_Clu_136 : 16|9@0+ (0.2,-51.2) [-51.2|51] "dBsm"  GW
 SG_ ARS_RDI_Range_Clu_140 : 247|12@0+ (0.0625,0) [0|255.9375] "m"  GW
 SG_ ARS_RDI_VradRel_Clu_140 : 251|11@0+ (0.1,-120) [-120|84.7] "m/s"  GW
 SG_ ARS_RDI_RCS_Clu_140 : 256|9@0+ (0.2,-51.2) [-51.2|51] "dBsm"  GW
 SG_ ARS_RDI_AzimuthAng_Clu_140 : 279|10@0+ (0.002,-1.022) [-1.022|1.024] "rad"  GW
 SG_ ARS_RDI_ElevationAng_Clu_140 : 285|7@0+ (0.005,-0.315) [-0.315|0.32] "rad"  GW
 SG_ ARS_RDI_SNR_Clu_140 : 294|7@0+ (0.5,0) [0|63.5] "dB"  GW
 SG_ ARS_RDI_DynProp_Clu_140 : 303|2@0+ (1,0) [0|3] ""  GW
 SG_ ARS_RDI_Quality_Clu_140 : 301|2@0+ (1,0) [0|3] ""  GW
 SG_ ARS_RDI_DynProp_Clu_141 : 299|2@0+ (1,0) [0|3] ""  GW
 SG_ ARS_RDI_Quality_Clu_141 : 297|2@0+ (1,0) [0|3] ""  GW
 SG_ ARS_RDI_Range_Clu_141 : 311|12@0+ (0.0625,0) [0|255.9375] "m"  GW
 SG_ ARS_RDI_VradRel_Clu_141 : 315|11@0+ (0.1,-120) [-120|84.7] "m/s"  GW
 SG_ ARS_RDI_RCS_Clu_141 : 320|9@0+ (0.2,-51.2) [-51.2|51] "dBsm"  GW
 SG_ ARS_RDI_AzimuthAng_Clu_136 : 39|10@0+ (0.002,-1.022) [-1.022|1.024] "rad"  GW
 SG_ ARS_RDI_AzimuthAng_Clu_141 : 343|10@0+ (0.002,-1.022) [-1.022|1.024] "rad"  GW
 SG_ ARS_RDI_ElevationAng_Clu_141 : 349|7@0+ (0.005,-0.315) [-0.315|0.32] "rad"  GW
 SG_ ARS_RDI_SNR_Clu_141 : 358|7@0+ (0.5,0) [0|63.5] "dB"  GW
 SG_ ARS_RDI_Range_Clu_142 : 367|12@0+ (0.0625,0) [0|255.9375] "m"  GW
 SG_ ARS_RDI_VradRel_Clu_142 : 371|11@0+ (0.1,-120) [-120|84.7] "m/s"  GW
 SG_ ARS_RDI_RCS_Clu_142 : 376|9@0+ (0.2,-51.2) [-51.2|51] "dBsm"  GW
 SG_ ARS_RDI_AzimuthAng_Clu_142 : 399|10@0+ (0.002,-1.022) [-1.022|1.024] "rad"  GW
 SG_ ARS_RDI_ElevationAng_Clu_142 : 405|7@0+ (0.005,-0.315) [-0.315|0.32] "rad"  GW
 SG_ ARS_RDI_SNR_Clu_142 : 414|7@0+ (0.5,0) [0|63.5] "dB"  GW
 SG_ ARS_RDI_DynProp_Clu_142 : 423|2@0+ (1,0) [0|3] ""  GW
 SG_ ARS_RDI_Quality_Clu_142 : 421|2@0+ (1,0) [0|3] ""  GW
 SG_ ARS_RDI_DynProp_Clu_143 : 419|2@0+ (1,0) [0|3] ""  GW
 SG_ ARS_RDI_Quality_Clu_143 : 417|2@0+ (1,0) [0|3] ""  GW
 SG_ ARS_RDI_Range_Clu_143 : 431|12@0+ (0.0625,0) [0|255.9375] "m"  GW
 SG_ ARS_RDI_ElevationAng_Clu_136 : 45|7@0+ (0.005,-0.315) [-0.315|0.32] "rad"  GW
 SG_ ARS_RDI_VradRel_Clu_143 : 435|11@0+ (0.1,-120) [-120|84.7] "m/s"  GW
 SG_ ARS_RDI_RCS_Clu_143 : 440|9@0+ (0.2,-51.2) [-51.2|51] "dBsm"  GW
 SG_ ARS_RDI_AzimuthAng_Clu_143 : 463|10@0+ (0.002,-1.022) [-1.022|1.024] "rad"  GW
 SG_ ARS_RDI_ElevationAng_Clu_143 : 469|7@0+ (0.005,-0.315) [-0.315|0.32] "rad"  GW
 SG_ ARS_RDI_SNR_Clu_143 : 478|7@0+ (0.5,0) [0|63.5] "dB"  GW
 SG_ ARS_RDI_MsgCounter_Clu_136_143 : 495|8@0+ (1,0) [0|255] ""  GW
 SG_ ARS_RDI_CRC16_Checksum_Clu_136_1 : 503|16@0+ (1,0) [0|65535] ""  GW
 SG_ ARS_RDI_SNR_Clu_136 : 54|7@0+ (0.5,0) [0|63.5] "dB"  GW
 SG_ ARS_RDI_DynProp_Clu_136 : 63|2@0+ (1,0) [0|3] ""  GW
 SG_ ARS_RDI_Quality_Clu_136 : 61|2@0+ (1,0) [0|3] ""  GW
 SG_ ARS_RDI_DynProp_Clu_137 : 59|2@0+ (1,0) [0|3] ""  GW
 SG_ ARS_RDI_Quality_Clu_137 : 57|2@0+ (1,0) [0|3] ""  GW
 SG_ ARS_RDI_Range_Clu_137 : 71|12@0+ (0.0625,0) [0|255.9375] "m"  GW
 SG_ ARS_RDI_VradRel_Clu_137 : 75|11@0+ (0.1,-120) [-120|84.7] "m/s"  GW
 SG_ ARS_RDI_RCS_Clu_137 : 80|9@0+ (0.2,-51.2) [-51.2|51] "dBsm"  GW
 SG_ ARS_RDI_AzimuthAng_Clu_137 : 103|10@0+ (0.002,-1.022) [-1.022|1.024] "rad"  GW

BO_ 275 ARS_RDI_144_151: 64 FR
 SG_ ARS_RDI_Range_Clu_144 : 7|12@0+ (0.0625,0) [0|255.9375] "m"  GW
 SG_ ARS_RDI_ElevationAng_Clu_145 : 109|7@0+ (0.005,-0.315) [-0.315|0.32] "rad"  GW
 SG_ ARS_RDI_SNR_Clu_145 : 118|7@0+ (0.5,0) [0|63.5] "dB"  GW
 SG_ ARS_RDI_Range_Clu_146 : 127|12@0+ (0.0625,0) [0|255.9375] "m"  GW
 SG_ ARS_RDI_VradRel_Clu_144 : 11|11@0+ (0.1,-120) [-120|84.7] "m/s"  GW
 SG_ ARS_RDI_VradRel_Clu_146 : 131|11@0+ (0.1,-120) [-120|84.7] "m/s"  GW
 SG_ ARS_RDI_RCS_Clu_146 : 136|9@0+ (0.2,-51.2) [-51.2|51] "dBsm"  GW
 SG_ ARS_RDI_AzimuthAng_Clu_146 : 159|10@0+ (0.002,-1.022) [-1.022|1.024] "rad"  GW
 SG_ ARS_RDI_ElevationAng_Clu_146 : 165|7@0+ (0.005,-0.315) [-0.315|0.32] "rad"  GW
 SG_ ARS_RDI_SNR_Clu_146 : 174|7@0+ (0.5,0) [0|63.5] "dB"  GW
 SG_ ARS_RDI_DynProp_Clu_146 : 183|2@0+ (1,0) [0|3] ""  GW
 SG_ ARS_RDI_Quality_Clu_146 : 181|2@0+ (1,0) [0|3] ""  GW
 SG_ ARS_RDI_DynProp_Clu_147 : 179|2@0+ (1,0) [0|3] ""  GW
 SG_ ARS_RDI_Quality_Clu_147 : 177|2@0+ (1,0) [0|3] ""  GW
 SG_ ARS_RDI_Range_Clu_147 : 191|12@0+ (0.0625,0) [0|255.9375] "m"  GW
 SG_ ARS_RDI_VradRel_Clu_147 : 195|11@0+ (0.1,-120) [-120|84.7] "m/s"  GW
 SG_ ARS_RDI_RCS_Clu_147 : 200|9@0+ (0.2,-51.2) [-51.2|51] "dBsm"  GW
 SG_ ARS_RDI_AzimuthAng_Clu_147 : 223|10@0+ (0.002,-1.022) [-1.022|1.024] "rad"  GW
 SG_ ARS_RDI_ElevationAng_Clu_147 : 229|7@0+ (0.005,-0.315) [-0.315|0.32] "rad"  GW
 SG_ ARS_RDI_SNR_Clu_147 : 238|7@0+ (0.5,0) [0|63.5] "dB"  GW
 SG_ ARS_RDI_RCS_Clu_144 : 16|9@0+ (0.2,-51.2) [-51.2|51] "dBsm"  GW
 SG_ ARS_RDI_Range_Clu_148 : 247|12@0+ (0.0625,0) [0|255.9375] "m"  GW
 SG_ ARS_RDI_VradRel_Clu_148 : 251|11@0+ (0.1,-120) [-120|84.7] "m/s"  GW
 SG_ ARS_RDI_RCS_Clu_148 : 256|9@0+ (0.2,-51.2) [-51.2|51] "dBsm"  GW
 SG_ ARS_RDI_AzimuthAng_Clu_148 : 279|10@0+ (0.002,-1.022) [-1.022|1.024] "rad"  GW
 SG_ ARS_RDI_ElevationAng_Clu_148 : 285|7@0+ (0.005,-0.315) [-0.315|0.32] "rad"  GW
 SG_ ARS_RDI_SNR_Clu_148 : 294|7@0+ (0.5,0) [0|63.5] "dB"  GW
 SG_ ARS_RDI_DynProp_Clu_148 : 303|2@0+ (1,0) [0|3] ""  GW
 SG_ ARS_RDI_Quality_Clu_148 : 301|2@0+ (1,0) [0|3] ""  GW
 SG_ ARS_RDI_DynProp_Clu_149 : 299|2@0+ (1,0) [0|3] ""  GW
 SG_ ARS_RDI_Quality_Clu_149 : 297|2@0+ (1,0) [0|3] ""  GW
 SG_ ARS_RDI_Range_Clu_149 : 311|12@0+ (0.0625,0) [0|255.9375] "m"  GW
 SG_ ARS_RDI_VradRel_Clu_149 : 315|11@0+ (0.1,-120) [-120|84.7] "m/s"  GW
 SG_ ARS_RDI_RCS_Clu_149 : 320|9@0+ (0.2,-51.2) [-51.2|51] "dBsm"  GW
 SG_ ARS_RDI_AzimuthAng_Clu_144 : 39|10@0+ (0.002,-1.022) [-1.022|1.024] "rad"  GW
 SG_ ARS_RDI_AzimuthAng_Clu_149 : 343|10@0+ (0.002,-1.022) [-1.022|1.024] "rad"  GW
 SG_ ARS_RDI_ElevationAng_Clu_149 : 349|7@0+ (0.005,-0.315) [-0.315|0.32] "rad"  GW
 SG_ ARS_RDI_SNR_Clu_149 : 358|7@0+ (0.5,0) [0|63.5] "dB"  GW
 SG_ ARS_RDI_Range_Clu_150 : 367|12@0+ (0.0625,0) [0|255.9375] "m"  GW
 SG_ ARS_RDI_VradRel_Clu_150 : 371|11@0+ (0.1,-120) [-120|84.7] "m/s"  GW
 SG_ ARS_RDI_RCS_Clu_150 : 376|9@0+ (0.2,-51.2) [-51.2|51] "dBsm"  GW
 SG_ ARS_RDI_AzimuthAng_Clu_150 : 399|10@0+ (0.002,-1.022) [-1.022|1.024] "rad"  GW
 SG_ ARS_RDI_ElevationAng_Clu_150 : 405|7@0+ (0.005,-0.315) [-0.315|0.32] "rad"  GW
 SG_ ARS_RDI_SNR_Clu_150 : 414|7@0+ (0.5,0) [0|63.5] "dB"  GW
 SG_ ARS_RDI_DynProp_Clu_150 : 423|2@0+ (1,0) [0|3] ""  GW
 SG_ ARS_RDI_Quality_Clu_150 : 421|2@0+ (1,0) [0|3] ""  GW
 SG_ ARS_RDI_DynProp_Clu_151 : 419|2@0+ (1,0) [0|3] ""  GW
 SG_ ARS_RDI_Quality_Clu_151 : 417|2@0+ (1,0) [0|3] ""  GW
 SG_ ARS_RDI_Range_Clu_151 : 431|12@0+ (0.0625,0) [0|255.9375] "m"  GW
 SG_ ARS_RDI_ElevationAng_Clu_144 : 45|7@0+ (0.005,-0.315) [-0.315|0.32] "rad"  GW
 SG_ ARS_RDI_VradRel_Clu_151 : 435|11@0+ (0.1,-120) [-120|84.7] "m/s"  GW
 SG_ ARS_RDI_RCS_Clu_151 : 440|9@0+ (0.2,-51.2) [-51.2|51] "dBsm"  GW
 SG_ ARS_RDI_AzimuthAng_Clu_151 : 463|10@0+ (0.002,-1.022) [-1.022|1.024] "rad"  GW
 SG_ ARS_RDI_ElevationAng_Clu_151 : 469|7@0+ (0.005,-0.315) [-0.315|0.32] "rad"  GW
 SG_ ARS_RDI_SNR_Clu_151 : 478|7@0+ (0.5,0) [0|63.5] "dB"  GW
 SG_ ARS_RDI_MsgCounter_Clu_144_151 : 495|8@0+ (1,0) [0|255] ""  GW
 SG_ ARS_RDI_CRC16_Checksum_Clu_144_1 : 503|16@0+ (1,0) [0|65535] ""  GW
 SG_ ARS_RDI_SNR_Clu_144 : 54|7@0+ (0.5,0) [0|63.5] "dB"  GW
 SG_ ARS_RDI_DynProp_Clu_144 : 63|2@0+ (1,0) [0|3] ""  GW
 SG_ ARS_RDI_Quality_Clu_144 : 61|2@0+ (1,0) [0|3] ""  GW
 SG_ ARS_RDI_DynProp_Clu_145 : 59|2@0+ (1,0) [0|3] ""  GW
 SG_ ARS_RDI_Quality_Clu_145 : 57|2@0+ (1,0) [0|3] ""  GW
 SG_ ARS_RDI_Range_Clu_145 : 71|12@0+ (0.0625,0) [0|255.9375] "m"  GW
 SG_ ARS_RDI_VradRel_Clu_145 : 75|11@0+ (0.1,-120) [-120|84.7] "m/s"  GW
 SG_ ARS_RDI_RCS_Clu_145 : 80|9@0+ (0.2,-51.2) [-51.2|51] "dBsm"  GW
 SG_ ARS_RDI_AzimuthAng_Clu_145 : 103|10@0+ (0.002,-1.022) [-1.022|1.024] "rad"  GW

BO_ 276 ARS_RDI_152_159: 64 FR
 SG_ ARS_RDI_Range_Clu_152 : 7|12@0+ (0.0625,0) [0|255.9375] "m"  GW
 SG_ ARS_RDI_ElevationAng_Clu_153 : 109|7@0+ (0.005,-0.315) [-0.315|0.32] "rad"  GW
 SG_ ARS_RDI_SNR_Clu_153 : 118|7@0+ (0.5,0) [0|63.5] "dB"  GW
 SG_ ARS_RDI_Range_Clu_154 : 127|12@0+ (0.0625,0) [0|255.9375] "m"  GW
 SG_ ARS_RDI_VradRel_Clu_152 : 11|11@0+ (0.1,-120) [-120|84.7] "m/s"  GW
 SG_ ARS_RDI_VradRel_Clu_154 : 131|11@0+ (0.1,-120) [-120|84.7] "m/s"  GW
 SG_ ARS_RDI_RCS_Clu_154 : 136|9@0+ (0.2,-51.2) [-51.2|51] "dBsm"  GW
 SG_ ARS_RDI_AzimuthAng_Clu_154 : 159|10@0+ (0.002,-1.022) [-1.022|1.024] "rad"  GW
 SG_ ARS_RDI_ElevationAng_Clu_154 : 165|7@0+ (0.005,-0.315) [-0.315|0.32] "rad"  GW
 SG_ ARS_RDI_SNR_Clu_154 : 174|7@0+ (0.5,0) [0|63.5] "dB"  GW
 SG_ ARS_RDI_DynProp_Clu_154 : 183|2@0+ (1,0) [0|3] ""  GW
 SG_ ARS_RDI_Quality_Clu_154 : 181|2@0+ (1,0) [0|3] ""  GW
 SG_ ARS_RDI_DynProp_Clu_155 : 179|2@0+ (1,0) [0|3] ""  GW
 SG_ ARS_RDI_Quality_Clu_155 : 177|2@0+ (1,0) [0|3] ""  GW
 SG_ ARS_RDI_Range_Clu_155 : 191|12@0+ (0.0625,0) [0|255.9375] "m"  GW
 SG_ ARS_RDI_VradRel_Clu_155 : 195|11@0+ (0.1,-120) [-120|84.7] "m/s"  GW
 SG_ ARS_RDI_RCS_Clu_155 : 200|9@0+ (0.2,-51.2) [-51.2|51] "dBsm"  GW
 SG_ ARS_RDI_AzimuthAng_Clu_155 : 223|10@0+ (0.002,-1.022) [-1.022|1.024] "rad"  GW
 SG_ ARS_RDI_ElevationAng_Clu_155 : 229|7@0+ (0.005,-0.315) [-0.315|0.32] "rad"  GW
 SG_ ARS_RDI_SNR_Clu_155 : 238|7@0+ (0.5,0) [0|63.5] "dB"  GW
 SG_ ARS_RDI_RCS_Clu_152 : 16|9@0+ (0.2,-51.2) [-51.2|51] "dBsm"  GW
 SG_ ARS_RDI_Range_Clu_156 : 247|12@0+ (0.0625,0) [0|255.9375] "m"  GW
 SG_ ARS_RDI_VradRel_Clu_156 : 251|11@0+ (0.1,-120) [-120|84.7] "m/s"  GW
 SG_ ARS_RDI_RCS_Clu_156 : 256|9@0+ (0.2,-51.2) [-51.2|51] "dBsm"  GW
 SG_ ARS_RDI_AzimuthAng_Clu_156 : 279|10@0+ (0.002,-1.022) [-1.022|1.024] "rad"  GW
 SG_ ARS_RDI_ElevationAng_Clu_156 : 285|7@0+ (0.005,-0.315) [-0.315|0.32] "rad"  GW
 SG_ ARS_RDI_SNR_Clu_156 : 294|7@0+ (0.5,0) [0|63.5] "dB"  GW
 SG_ ARS_RDI_DynProp_Clu_156 : 303|2@0+ (1,0) [0|3] ""  GW
 SG_ ARS_RDI_Quality_Clu_156 : 301|2@0+ (1,0) [0|3] ""  GW
 SG_ ARS_RDI_DynProp_Clu_157 : 299|2@0+ (1,0) [0|3] ""  GW
 SG_ ARS_RDI_Quality_Clu_157 : 297|2@0+ (1,0) [0|3] ""  GW
 SG_ ARS_RDI_Range_Clu_157 : 311|12@0+ (0.0625,0) [0|255.9375] "m"  GW
 SG_ ARS_RDI_VradRel_Clu_157 : 315|11@0+ (0.1,-120) [-120|84.7] "m/s"  GW
 SG_ ARS_RDI_RCS_Clu_157 : 320|9@0+ (0.2,-51.2) [-51.2|51] "dBsm"  GW
 SG_ ARS_RDI_AzimuthAng_Clu_152 : 39|10@0+ (0.002,-1.022) [-1.022|1.024] "rad"  GW
 SG_ ARS_RDI_AzimuthAng_Clu_157 : 343|10@0+ (0.002,-1.022) [-1.022|1.024] "rad"  GW
 SG_ ARS_RDI_ElevationAng_Clu_157 : 349|7@0+ (0.005,-0.315) [-0.315|0.32] "rad"  GW
 SG_ ARS_RDI_SNR_Clu_157 : 358|7@0+ (0.5,0) [0|63.5] "dB"  GW
 SG_ ARS_RDI_Range_Clu_158 : 367|12@0+ (0.0625,0) [0|255.9375] "m"  GW
 SG_ ARS_RDI_VradRel_Clu_158 : 371|11@0+ (0.1,-120) [-120|84.7] "m/s"  GW
 SG_ ARS_RDI_RCS_Clu_158 : 376|9@0+ (0.2,-51.2) [-51.2|51] "dBsm"  GW
 SG_ ARS_RDI_AzimuthAng_Clu_158 : 399|10@0+ (0.002,-1.022) [-1.022|1.024] "rad"  GW
 SG_ ARS_RDI_ElevationAng_Clu_158 : 405|7@0+ (0.005,-0.315) [-0.315|0.32] "rad"  GW
 SG_ ARS_RDI_SNR_Clu_158 : 414|7@0+ (0.5,0) [0|63.5] "dB"  GW
 SG_ ARS_RDI_DynProp_Clu_158 : 423|2@0+ (1,0) [0|3] ""  GW
 SG_ ARS_RDI_Quality_Clu_158 : 421|2@0+ (1,0) [0|3] ""  GW
 SG_ ARS_RDI_DynProp_Clu_159 : 419|2@0+ (1,0) [0|3] ""  GW
 SG_ ARS_RDI_Quality_Clu_159 : 417|2@0+ (1,0) [0|3] ""  GW
 SG_ ARS_RDI_Range_Clu_159 : 431|12@0+ (0.0625,0) [0|255.9375] "m"  GW
 SG_ ARS_RDI_ElevationAng_Clu_152 : 45|7@0+ (0.005,-0.315) [-0.315|0.32] "rad"  GW
 SG_ ARS_RDI_VradRel_Clu_159 : 435|11@0+ (0.1,-120) [-120|84.7] "m/s"  GW
 SG_ ARS_RDI_RCS_Clu_159 : 440|9@0+ (0.2,-51.2) [-51.2|51] "dBsm"  GW
 SG_ ARS_RDI_AzimuthAng_Clu_159 : 463|10@0+ (0.002,-1.022) [-1.022|1.024] "rad"  GW
 SG_ ARS_RDI_ElevationAng_Clu_159 : 469|7@0+ (0.005,-0.315) [-0.315|0.32] "rad"  GW
 SG_ ARS_RDI_SNR_Clu_159 : 478|7@0+ (0.5,0) [0|63.5] "dB"  GW
 SG_ ARS_RDI_MsgCounter_Clu_152_159 : 495|8@0+ (1,0) [0|255] ""  GW
 SG_ ARS_RDI_CRC16_Checksum_Clu_152_1 : 503|16@0+ (1,0) [0|65535] ""  GW
 SG_ ARS_RDI_SNR_Clu_152 : 54|7@0+ (0.5,0) [0|63.5] "dB"  GW
 SG_ ARS_RDI_DynProp_Clu_152 : 63|2@0+ (1,0) [0|3] ""  GW
 SG_ ARS_RDI_Quality_Clu_152 : 61|2@0+ (1,0) [0|3] ""  GW
 SG_ ARS_RDI_DynProp_Clu_153 : 59|2@0+ (1,0) [0|3] ""  GW
 SG_ ARS_RDI_Quality_Clu_153 : 57|2@0+ (1,0) [0|3] ""  GW
 SG_ ARS_RDI_Range_Clu_153 : 71|12@0+ (0.0625,0) [0|255.9375] "m"  GW
 SG_ ARS_RDI_VradRel_Clu_153 : 75|11@0+ (0.1,-120) [-120|84.7] "m/s"  GW
 SG_ ARS_RDI_RCS_Clu_153 : 80|9@0+ (0.2,-51.2) [-51.2|51] "dBsm"  GW
 SG_ ARS_RDI_AzimuthAng_Clu_153 : 103|10@0+ (0.002,-1.022) [-1.022|1.024] "rad"  GW

BO_ 277 ARS_RDI_160_167: 64 FR
 SG_ ARS_RDI_Range_Clu_160 : 7|12@0+ (0.0625,0) [0|255.9375] "m"  GW
 SG_ ARS_RDI_ElevationAng_Clu_161 : 109|7@0+ (0.005,-0.315) [-0.315|0.32] "rad"  GW
 SG_ ARS_RDI_SNR_Clu_161 : 118|7@0+ (0.5,0) [0|63.5] "dB"  GW
 SG_ ARS_RDI_Range_Clu_162 : 127|12@0+ (0.0625,0) [0|255.9375] "m"  GW
 SG_ ARS_RDI_VradRel_Clu_160 : 11|11@0+ (0.1,-120) [-120|84.7] "m/s"  GW
 SG_ ARS_RDI_VradRel_Clu_162 : 131|11@0+ (0.1,-120) [-120|84.7] "m/s"  GW
 SG_ ARS_RDI_RCS_Clu_162 : 136|9@0+ (0.2,-51.2) [-51.2|51] "dBsm"  GW
 SG_ ARS_RDI_AzimuthAng_Clu_162 : 159|10@0+ (0.002,-1.022) [-1.022|1.024] "rad"  GW
 SG_ ARS_RDI_ElevationAng_Clu_162 : 165|7@0+ (0.005,-0.315) [-0.315|0.32] "rad"  GW
 SG_ ARS_RDI_SNR_Clu_162 : 174|7@0+ (0.5,0) [0|63.5] "dB"  GW
 SG_ ARS_RDI_DynProp_Clu_162 : 183|2@0+ (1,0) [0|3] ""  GW
 SG_ ARS_RDI_Quality_Clu_162 : 181|2@0+ (1,0) [0|3] ""  GW
 SG_ ARS_RDI_DynProp_Clu_163 : 179|2@0+ (1,0) [0|3] ""  GW
 SG_ ARS_RDI_Quality_Clu_163 : 177|2@0+ (1,0) [0|3] ""  GW
 SG_ ARS_RDI_Range_Clu_163 : 191|12@0+ (0.0625,0) [0|255.9375] "m"  GW
 SG_ ARS_RDI_VradRel_Clu_163 : 195|11@0+ (0.1,-120) [-120|84.7] "m/s"  GW
 SG_ ARS_RDI_RCS_Clu_163 : 200|9@0+ (0.2,-51.2) [-51.2|51] "dBsm"  GW
 SG_ ARS_RDI_AzimuthAng_Clu_163 : 223|10@0+ (0.002,-1.022) [-1.022|1.024] "rad"  GW
 SG_ ARS_RDI_ElevationAng_Clu_163 : 229|7@0+ (0.005,-0.315) [-0.315|0.32] "rad"  GW
 SG_ ARS_RDI_SNR_Clu_163 : 238|7@0+ (0.5,0) [0|63.5] "dB"  GW
 SG_ ARS_RDI_RCS_Clu_160 : 16|9@0+ (0.2,-51.2) [-51.2|51] "dBsm"  GW
 SG_ ARS_RDI_Range_Clu_164 : 247|12@0+ (0.0625,0) [0|255.9375] "m"  GW
 SG_ ARS_RDI_VradRel_Clu_164 : 251|11@0+ (0.1,-120) [-120|84.7] "m/s"  GW
 SG_ ARS_RDI_RCS_Clu_164 : 256|9@0+ (0.2,-51.2) [-51.2|51] "dBsm"  GW
 SG_ ARS_RDI_AzimuthAng_Clu_164 : 279|10@0+ (0.002,-1.022) [-1.022|1.024] "rad"  GW
 SG_ ARS_RDI_ElevationAng_Clu_164 : 285|7@0+ (0.005,-0.315) [-0.315|0.32] "rad"  GW
 SG_ ARS_RDI_SNR_Clu_164 : 294|7@0+ (0.5,0) [0|63.5] "dB"  GW
 SG_ ARS_RDI_DynProp_Clu_164 : 303|2@0+ (1,0) [0|3] ""  GW
 SG_ ARS_RDI_Quality_Clu_164 : 301|2@0+ (1,0) [0|3] ""  GW
 SG_ ARS_RDI_DynProp_Clu_165 : 299|2@0+ (1,0) [0|3] ""  GW
 SG_ ARS_RDI_Quality_Clu_165 : 297|2@0+ (1,0) [0|3] ""  GW
 SG_ ARS_RDI_Range_Clu_165 : 311|12@0+ (0.0625,0) [0|255.9375] "m"  GW
 SG_ ARS_RDI_VradRel_Clu_165 : 315|11@0+ (0.1,-120) [-120|84.7] "m/s"  GW
 SG_ ARS_RDI_RCS_Clu_165 : 320|9@0+ (0.2,-51.2) [-51.2|51] "dBsm"  GW
 SG_ ARS_RDI_AzimuthAng_Clu_160 : 39|10@0+ (0.002,-1.022) [-1.022|1.024] "rad"  GW
 SG_ ARS_RDI_AzimuthAng_Clu_165 : 343|10@0+ (0.002,-1.022) [-1.022|1.024] "rad"  GW
 SG_ ARS_RDI_ElevationAng_Clu_165 : 349|7@0+ (0.005,-0.315) [-0.315|0.32] "rad"  GW
 SG_ ARS_RDI_SNR_Clu_165 : 358|7@0+ (0.5,0) [0|63.5] "dB"  GW
 SG_ ARS_RDI_Range_Clu_166 : 367|12@0+ (0.0625,0) [0|255.9375] "m"  GW
 SG_ ARS_RDI_VradRel_Clu_166 : 371|11@0+ (0.1,-120) [-120|84.7] "m/s"  GW
 SG_ ARS_RDI_RCS_Clu_166 : 376|9@0+ (0.2,-51.2) [-51.2|51] "dBsm"  GW
 SG_ ARS_RDI_AzimuthAng_Clu_166 : 399|10@0+ (0.002,-1.022) [-1.022|1.024] "rad"  GW
 SG_ ARS_RDI_ElevationAng_Clu_166 : 405|7@0+ (0.005,-0.315) [-0.315|0.32] "rad"  GW
 SG_ ARS_RDI_SNR_Clu_166 : 414|7@0+ (0.5,0) [0|63.5] "dB"  GW
 SG_ ARS_RDI_DynProp_Clu_166 : 423|2@0+ (1,0) [0|3] ""  GW
 SG_ ARS_RDI_Quality_Clu_166 : 421|2@0+ (1,0) [0|3] ""  GW
 SG_ ARS_RDI_DynProp_Clu_167 : 419|2@0+ (1,0) [0|3] ""  GW
 SG_ ARS_RDI_Quality_Clu_167 : 417|2@0+ (1,0) [0|3] ""  GW
 SG_ ARS_RDI_Range_Clu_167 : 431|12@0+ (0.0625,0) [0|255.9375] "m"  GW
 SG_ ARS_RDI_ElevationAng_Clu_160 : 45|7@0+ (0.005,-0.315) [-0.315|0.32] "rad"  GW
 SG_ ARS_RDI_VradRel_Clu_167 : 435|11@0+ (0.1,-120) [-120|84.7] "m/s"  GW
 SG_ ARS_RDI_RCS_Clu_167 : 440|9@0+ (0.2,-51.2) [-51.2|51] "dBsm"  GW
 SG_ ARS_RDI_AzimuthAng_Clu_167 : 463|10@0+ (0.002,-1.022) [-1.022|1.024] "rad"  GW
 SG_ ARS_RDI_ElevationAng_Clu_167 : 469|7@0+ (0.005,-0.315) [-0.315|0.32] "rad"  GW
 SG_ ARS_RDI_SNR_Clu_167 : 478|7@0+ (0.5,0) [0|63.5] "dB"  GW
 SG_ ARS_RDI_MsgCounter_Clu_160_167 : 495|8@0+ (1,0) [0|255] ""  GW
 SG_ ARS_RDI_CRC16_Checksum_Clu_160_1 : 503|16@0+ (1,0) [0|65535] ""  GW
 SG_ ARS_RDI_SNR_Clu_160 : 54|7@0+ (0.5,0) [0|63.5] "dB"  GW
 SG_ ARS_RDI_DynProp_Clu_160 : 63|2@0+ (1,0) [0|3] ""  GW
 SG_ ARS_RDI_Quality_Clu_160 : 61|2@0+ (1,0) [0|3] ""  GW
 SG_ ARS_RDI_DynProp_Clu_161 : 59|2@0+ (1,0) [0|3] ""  GW
 SG_ ARS_RDI_Quality_Clu_161 : 57|2@0+ (1,0) [0|3] ""  GW
 SG_ ARS_RDI_Range_Clu_161 : 71|12@0+ (0.0625,0) [0|255.9375] "m"  GW
 SG_ ARS_RDI_VradRel_Clu_161 : 75|11@0+ (0.1,-120) [-120|84.7] "m/s"  GW
 SG_ ARS_RDI_RCS_Clu_161 : 80|9@0+ (0.2,-51.2) [-51.2|51] "dBsm"  GW
 SG_ ARS_RDI_AzimuthAng_Clu_161 : 103|10@0+ (0.002,-1.022) [-1.022|1.024] "rad"  GW

BO_ 278 ARS_RDI_168_175: 64 FR
 SG_ ARS_RDI_Range_Clu_168 : 7|12@0+ (0.0625,0) [0|255.9375] "m"  GW
 SG_ ARS_RDI_ElevationAng_Clu_169 : 109|7@0+ (0.005,-0.315) [-0.315|0.32] "rad"  GW
 SG_ ARS_RDI_SNR_Clu_169 : 118|7@0+ (0.5,0) [0|63.5] "dB"  GW
 SG_ ARS_RDI_Range_Clu_170 : 127|12@0+ (0.0625,0) [0|255.9375] "m"  GW
 SG_ ARS_RDI_VradRel_Clu_168 : 11|11@0+ (0.1,-120) [-120|84.7] "m/s"  GW
 SG_ ARS_RDI_VradRel_Clu_170 : 131|11@0+ (0.1,-120) [-120|84.7] "m/s"  GW
 SG_ ARS_RDI_RCS_Clu_170 : 136|9@0+ (0.2,-51.2) [-51.2|51] "dBsm"  GW
 SG_ ARS_RDI_AzimuthAng_Clu_170 : 159|10@0+ (0.002,-1.022) [-1.022|1.024] "rad"  GW
 SG_ ARS_RDI_ElevationAng_Clu_170 : 165|7@0+ (0.005,-0.315) [-0.315|0.32] "rad"  GW
 SG_ ARS_RDI_SNR_Clu_170 : 174|7@0+ (0.5,0) [0|63.5] "dB"  GW
 SG_ ARS_RDI_DynProp_Clu_170 : 183|2@0+ (1,0) [0|3] ""  GW
 SG_ ARS_RDI_Quality_Clu_170 : 181|2@0+ (1,0) [0|3] ""  GW
 SG_ ARS_RDI_DynProp_Clu_171 : 179|2@0+ (1,0) [0|3] ""  GW
 SG_ ARS_RDI_Quality_Clu_171 : 177|2@0+ (1,0) [0|3] ""  GW
 SG_ ARS_RDI_Range_Clu_171 : 191|12@0+ (0.0625,0) [0|255.9375] "m"  GW
 SG_ ARS_RDI_VradRel_Clu_171 : 195|11@0+ (0.1,-120) [-120|84.7] "m/s"  GW
 SG_ ARS_RDI_RCS_Clu_171 : 200|9@0+ (0.2,-51.2) [-51.2|51] "dBsm"  GW
 SG_ ARS_RDI_AzimuthAng_Clu_171 : 223|10@0+ (0.002,-1.022) [-1.022|1.024] "rad"  GW
 SG_ ARS_RDI_ElevationAng_Clu_171 : 229|7@0+ (0.005,-0.315) [-0.315|0.32] "rad"  GW
 SG_ ARS_RDI_SNR_Clu_171 : 238|7@0+ (0.5,0) [0|63.5] "dB"  GW
 SG_ ARS_RDI_RCS_Clu_168 : 16|9@0+ (0.2,-51.2) [-51.2|51] "dBsm"  GW
 SG_ ARS_RDI_Range_Clu_172 : 247|12@0+ (0.0625,0) [0|255.9375] "m"  GW
 SG_ ARS_RDI_VradRel_Clu_172 : 251|11@0+ (0.1,-120) [-120|84.7] "m/s"  GW
 SG_ ARS_RDI_RCS_Clu_172 : 256|9@0+ (0.2,-51.2) [-51.2|51] "dBsm"  GW
 SG_ ARS_RDI_AzimuthAng_Clu_172 : 279|10@0+ (0.002,-1.022) [-1.022|1.024] "rad"  GW
 SG_ ARS_RDI_ElevationAng_Clu_172 : 285|7@0+ (0.005,-0.315) [-0.315|0.32] "rad"  GW
 SG_ ARS_RDI_SNR_Clu_172 : 294|7@0+ (0.5,0) [0|63.5] "dB"  GW
 SG_ ARS_RDI_DynProp_Clu_172 : 303|2@0+ (1,0) [0|3] ""  GW
 SG_ ARS_RDI_Quality_Clu_172 : 301|2@0+ (1,0) [0|3] ""  GW
 SG_ ARS_RDI_DynProp_Clu_173 : 299|2@0+ (1,0) [0|3] ""  GW
 SG_ ARS_RDI_Quality_Clu_173 : 297|2@0+ (1,0) [0|3] ""  GW
 SG_ ARS_RDI_Range_Clu_173 : 311|12@0+ (0.0625,0) [0|255.9375] "m"  GW
 SG_ ARS_RDI_VradRel_Clu_173 : 315|11@0+ (0.1,-120) [-120|84.7] "m/s"  GW
 SG_ ARS_RDI_RCS_Clu_173 : 320|9@0+ (0.2,-51.2) [-51.2|51] "dBsm"  GW
 SG_ ARS_RDI_AzimuthAng_Clu_168 : 39|10@0+ (0.002,-1.022) [-1.022|1.024] "rad"  GW
 SG_ ARS_RDI_AzimuthAng_Clu_173 : 343|10@0+ (0.002,-1.022) [-1.022|1.024] "rad"  GW
 SG_ ARS_RDI_ElevationAng_Clu_173 : 349|7@0+ (0.005,-0.315) [-0.315|0.32] "rad"  GW
 SG_ ARS_RDI_SNR_Clu_173 : 358|7@0+ (0.5,0) [0|63.5] "dB"  GW
 SG_ ARS_RDI_Range_Clu_174 : 367|12@0+ (0.0625,0) [0|255.9375] "m"  GW
 SG_ ARS_RDI_VradRel_Clu_174 : 371|11@0+ (0.1,-120) [-120|84.7] "m/s"  GW
 SG_ ARS_RDI_RCS_Clu_174 : 376|9@0+ (0.2,-51.2) [-51.2|51] "dBsm"  GW
 SG_ ARS_RDI_AzimuthAng_Clu_174 : 399|10@0+ (0.002,-1.022) [-1.022|1.024] "rad"  GW
 SG_ ARS_RDI_ElevationAng_Clu_174 : 405|7@0+ (0.005,-0.315) [-0.315|0.32] "rad"  GW
 SG_ ARS_RDI_SNR_Clu_174 : 414|7@0+ (0.5,0) [0|63.5] "dB"  GW
 SG_ ARS_RDI_DynProp_Clu_174 : 423|2@0+ (1,0) [0|3] ""  GW
 SG_ ARS_RDI_Quality_Clu_174 : 421|2@0+ (1,0) [0|3] ""  GW
 SG_ ARS_RDI_DynProp_Clu_175 : 419|2@0+ (1,0) [0|3] ""  GW
 SG_ ARS_RDI_Quality_Clu_175 : 417|2@0+ (1,0) [0|3] ""  GW
 SG_ ARS_RDI_Range_Clu_175 : 431|12@0+ (0.0625,0) [0|255.9375] "m"  GW
 SG_ ARS_RDI_ElevationAng_Clu_168 : 45|7@0+ (0.005,-0.315) [-0.315|0.32] "rad"  GW
 SG_ ARS_RDI_VradRel_Clu_175 : 435|11@0+ (0.1,-120) [-120|84.7] "m/s"  GW
 SG_ ARS_RDI_RCS_Clu_175 : 440|9@0+ (0.2,-51.2) [-51.2|51] "dBsm"  GW
 SG_ ARS_RDI_AzimuthAng_Clu_175 : 463|10@0+ (0.002,-1.022) [-1.022|1.024] "rad"  GW
 SG_ ARS_RDI_ElevationAng_Clu_175 : 469|7@0+ (0.005,-0.315) [-0.315|0.32] "rad"  GW
 SG_ ARS_RDI_SNR_Clu_175 : 478|7@0+ (0.5,0) [0|63.5] "dB"  GW
 SG_ ARS_RDI_MsgCounter_Clu_168_175 : 495|8@0+ (1,0) [0|255] ""  GW
 SG_ ARS_RDI_CRC16_Checksum_Clu_168_1 : 503|16@0+ (1,0) [0|65535] ""  GW
 SG_ ARS_RDI_SNR_Clu_168 : 54|7@0+ (0.5,0) [0|63.5] "dB"  GW
 SG_ ARS_RDI_DynProp_Clu_168 : 63|2@0+ (1,0) [0|3] ""  GW
 SG_ ARS_RDI_Quality_Clu_168 : 61|2@0+ (1,0) [0|3] ""  GW
 SG_ ARS_RDI_DynProp_Clu_169 : 59|2@0+ (1,0) [0|3] ""  GW
 SG_ ARS_RDI_Quality_Clu_169 : 57|2@0+ (1,0) [0|3] ""  GW
 SG_ ARS_RDI_Range_Clu_169 : 71|12@0+ (0.0625,0) [0|255.9375] "m"  GW
 SG_ ARS_RDI_VradRel_Clu_169 : 75|11@0+ (0.1,-120) [-120|84.7] "m/s"  GW
 SG_ ARS_RDI_RCS_Clu_169 : 80|9@0+ (0.2,-51.2) [-51.2|51] "dBsm"  GW
 SG_ ARS_RDI_AzimuthAng_Clu_169 : 103|10@0+ (0.002,-1.022) [-1.022|1.024] "rad"  GW

BO_ 279 ARS_RDI_176_183: 64 FR
 SG_ ARS_RDI_Range_Clu_176 : 7|12@0+ (0.0625,0) [0|255.9375] "m"  GW
 SG_ ARS_RDI_ElevationAng_Clu_177 : 109|7@0+ (0.005,-0.315) [-0.315|0.32] "rad"  GW
 SG_ ARS_RDI_SNR_Clu_177 : 118|7@0+ (0.5,0) [0|63.5] "dB"  GW
 SG_ ARS_RDI_Range_Clu_178 : 127|12@0+ (0.0625,0) [0|255.9375] "m"  GW
 SG_ ARS_RDI_VradRel_Clu_176 : 11|11@0+ (0.1,-120) [-120|84.7] "m/s"  GW
 SG_ ARS_RDI_VradRel_Clu_178 : 131|11@0+ (0.1,-120) [-120|84.7] "m/s"  GW
 SG_ ARS_RDI_RCS_Clu_178 : 136|9@0+ (0.2,-51.2) [-51.2|51] "dBsm"  GW
 SG_ ARS_RDI_AzimuthAng_Clu_178 : 159|10@0+ (0.002,-1.022) [-1.022|1.024] "rad"  GW
 SG_ ARS_RDI_ElevationAng_Clu_178 : 165|7@0+ (0.005,-0.315) [-0.315|0.32] "rad"  GW
 SG_ ARS_RDI_SNR_Clu_178 : 174|7@0+ (0.5,0) [0|63.5] "dB"  GW
 SG_ ARS_RDI_DynProp_Clu_178 : 183|2@0+ (1,0) [0|3] ""  GW
 SG_ ARS_RDI_Quality_Clu_178 : 181|2@0+ (1,0) [0|3] ""  GW
 SG_ ARS_RDI_DynProp_Clu_179 : 179|2@0+ (1,0) [0|3] ""  GW
 SG_ ARS_RDI_Quality_Clu_179 : 177|2@0+ (1,0) [0|3] ""  GW
 SG_ ARS_RDI_Range_Clu_179 : 191|12@0+ (0.0625,0) [0|255.9375] "m"  GW
 SG_ ARS_RDI_VradRel_Clu_179 : 195|11@0+ (0.1,-120) [-120|84.7] "m/s"  GW
 SG_ ARS_RDI_RCS_Clu_179 : 200|9@0+ (0.2,-51.2) [-51.2|51] "dBsm"  GW
 SG_ ARS_RDI_AzimuthAng_Clu_179 : 223|10@0+ (0.002,-1.022) [-1.022|1.024] "rad"  GW
 SG_ ARS_RDI_ElevationAng_Clu_179 : 229|7@0+ (0.005,-0.315) [-0.315|0.32] "rad"  GW
 SG_ ARS_RDI_SNR_Clu_179 : 238|7@0+ (0.5,0) [0|63.5] "dB"  GW
 SG_ ARS_RDI_RCS_Clu_176 : 16|9@0+ (0.2,-51.2) [-51.2|51] "dBsm"  GW
 SG_ ARS_RDI_Range_Clu_180 : 247|12@0+ (0.0625,0) [0|255.9375] "m"  GW
 SG_ ARS_RDI_VradRel_Clu_180 : 251|11@0+ (0.1,-120) [-120|84.7] "m/s"  GW
 SG_ ARS_RDI_RCS_Clu_180 : 256|9@0+ (0.2,-51.2) [-51.2|51] "dBsm"  GW
 SG_ ARS_RDI_AzimuthAng_Clu_180 : 279|10@0+ (0.002,-1.022) [-1.022|1.024] "rad"  GW
 SG_ ARS_RDI_ElevationAng_Clu_180 : 285|7@0+ (0.005,-0.315) [-0.315|0.32] "rad"  GW
 SG_ ARS_RDI_SNR_Clu_180 : 294|7@0+ (0.5,0) [0|63.5] "dB"  GW
 SG_ ARS_RDI_DynProp_Clu_180 : 303|2@0+ (1,0) [0|3] ""  GW
 SG_ ARS_RDI_Quality_Clu_180 : 301|2@0+ (1,0) [0|3] ""  GW
 SG_ ARS_RDI_DynProp_Clu_181 : 299|2@0+ (1,0) [0|3] ""  GW
 SG_ ARS_RDI_Quality_Clu_181 : 297|2@0+ (1,0) [0|3] ""  GW
 SG_ ARS_RDI_Range_Clu_181 : 311|12@0+ (0.0625,0) [0|255.9375] "m"  GW
 SG_ ARS_RDI_VradRel_Clu_181 : 315|11@0+ (0.1,-120) [-120|84.7] "m/s"  GW
 SG_ ARS_RDI_RCS_Clu_181 : 320|9@0+ (0.2,-51.2) [-51.2|51] "dBsm"  GW
 SG_ ARS_RDI_AzimuthAng_Clu_176 : 39|10@0+ (0.002,-1.022) [-1.022|1.024] "rad"  GW
 SG_ ARS_RDI_AzimuthAng_Clu_181 : 343|10@0+ (0.002,-1.022) [-1.022|1.024] "rad"  GW
 SG_ ARS_RDI_ElevationAng_Clu_181 : 349|7@0+ (0.005,-0.315) [-0.315|0.32] "rad"  GW
 SG_ ARS_RDI_SNR_Clu_181 : 358|7@0+ (0.5,0) [0|63.5] "dB"  GW
 SG_ ARS_RDI_Range_Clu_182 : 367|12@0+ (0.0625,0) [0|255.9375] "m"  GW
 SG_ ARS_RDI_VradRel_Clu_182 : 371|11@0+ (0.1,-120) [-120|84.7] "m/s"  GW
 SG_ ARS_RDI_RCS_Clu_182 : 376|9@0+ (0.2,-51.2) [-51.2|51] "dBsm"  GW
 SG_ ARS_RDI_AzimuthAng_Clu_182 : 399|10@0+ (0.002,-1.022) [-1.022|1.024] "rad"  GW
 SG_ ARS_RDI_ElevationAng_Clu_182 : 405|7@0+ (0.005,-0.315) [-0.315|0.32] "rad"  GW
 SG_ ARS_RDI_SNR_Clu_182 : 414|7@0+ (0.5,0) [0|63.5] "dB"  GW
 SG_ ARS_RDI_DynProp_Clu_182 : 423|2@0+ (1,0) [0|3] ""  GW
 SG_ ARS_RDI_Quality_Clu_182 : 421|2@0+ (1,0) [0|3] ""  GW
 SG_ ARS_RDI_DynProp_Clu_183 : 419|2@0+ (1,0) [0|3] ""  GW
 SG_ ARS_RDI_Quality_Clu_183 : 417|2@0+ (1,0) [0|3] ""  GW
 SG_ ARS_RDI_Range_Clu_183 : 431|12@0+ (0.0625,0) [0|255.9375] "m"  GW
 SG_ ARS_RDI_ElevationAng_Clu_176 : 45|7@0+ (0.005,-0.315) [-0.315|0.32] "rad"  GW
 SG_ ARS_RDI_VradRel_Clu_183 : 435|11@0+ (0.1,-120) [-120|84.7] "m/s"  GW
 SG_ ARS_RDI_RCS_Clu_183 : 440|9@0+ (0.2,-51.2) [-51.2|51] "dBsm"  GW
 SG_ ARS_RDI_AzimuthAng_Clu_183 : 463|10@0+ (0.002,-1.022) [-1.022|1.024] "rad"  GW
 SG_ ARS_RDI_ElevationAng_Clu_183 : 469|7@0+ (0.005,-0.315) [-0.315|0.32] "rad"  GW
 SG_ ARS_RDI_SNR_Clu_183 : 478|7@0+ (0.5,0) [0|63.5] "dB"  GW
 SG_ ARS_RDI_MsgCounter_Clu_176_183 : 495|8@0+ (1,0) [0|255] ""  GW
 SG_ ARS_RDI_CRC16_Checksum_Clu_176_1 : 503|16@0+ (1,0) [0|65535] ""  GW
 SG_ ARS_RDI_SNR_Clu_176 : 54|7@0+ (0.5,0) [0|63.5] "dB"  GW
 SG_ ARS_RDI_DynProp_Clu_176 : 63|2@0+ (1,0) [0|3] ""  GW
 SG_ ARS_RDI_Quality_Clu_176 : 61|2@0+ (1,0) [0|3] ""  GW
 SG_ ARS_RDI_DynProp_Clu_177 : 59|2@0+ (1,0) [0|3] ""  GW
 SG_ ARS_RDI_Quality_Clu_177 : 57|2@0+ (1,0) [0|3] ""  GW
 SG_ ARS_RDI_Range_Clu_177 : 71|12@0+ (0.0625,0) [0|255.9375] "m"  GW
 SG_ ARS_RDI_VradRel_Clu_177 : 75|11@0+ (0.1,-120) [-120|84.7] "m/s"  GW
 SG_ ARS_RDI_RCS_Clu_177 : 80|9@0+ (0.2,-51.2) [-51.2|51] "dBsm"  GW
 SG_ ARS_RDI_AzimuthAng_Clu_177 : 103|10@0+ (0.002,-1.022) [-1.022|1.024] "rad"  GW

BO_ 280 ARS_RDI_184_191: 64 FR
 SG_ ARS_RDI_Range_Clu_184 : 7|12@0+ (0.0625,0) [0|255.9375] "m"  GW
 SG_ ARS_RDI_ElevationAng_Clu_185 : 109|7@0+ (0.005,-0.315) [-0.315|0.32] "rad"  GW
 SG_ ARS_RDI_SNR_Clu_185 : 118|7@0+ (0.5,0) [0|63.5] "dB"  GW
 SG_ ARS_RDI_Range_Clu_186 : 127|12@0+ (0.0625,0) [0|255.9375] "m"  GW
 SG_ ARS_RDI_VradRel_Clu_184 : 11|11@0+ (0.1,-120) [-120|84.7] "m/s"  GW
 SG_ ARS_RDI_VradRel_Clu_186 : 131|11@0+ (0.1,-120) [-120|84.7] "m/s"  GW
 SG_ ARS_RDI_RCS_Clu_186 : 136|9@0+ (0.2,-51.2) [-51.2|51] "dBsm"  GW
 SG_ ARS_RDI_AzimuthAng_Clu_186 : 159|10@0+ (0.002,-1.022) [-1.022|1.024] "rad"  GW
 SG_ ARS_RDI_ElevationAng_Clu_186 : 165|7@0+ (0.005,-0.315) [-0.315|0.32] "rad"  GW
 SG_ ARS_RDI_SNR_Clu_186 : 174|7@0+ (0.5,0) [0|63.5] "dB"  GW
 SG_ ARS_RDI_DynProp_Clu_186 : 183|2@0+ (1,0) [0|3] ""  GW
 SG_ ARS_RDI_Quality_Clu_186 : 181|2@0+ (1,0) [0|3] ""  GW
 SG_ ARS_RDI_DynProp_Clu_187 : 179|2@0+ (1,0) [0|3] ""  GW
 SG_ ARS_RDI_Quality_Clu_187 : 177|2@0+ (1,0) [0|3] ""  GW
 SG_ ARS_RDI_Range_Clu_187 : 191|12@0+ (0.0625,0) [0|255.9375] "m"  GW
 SG_ ARS_RDI_VradRel_Clu_187 : 195|11@0+ (0.1,-120) [-120|84.7] "m/s"  GW
 SG_ ARS_RDI_RCS_Clu_187 : 200|9@0+ (0.2,-51.2) [-51.2|51] "dBsm"  GW
 SG_ ARS_RDI_AzimuthAng_Clu_187 : 223|10@0+ (0.002,-1.022) [-1.022|1.024] "rad"  GW
 SG_ ARS_RDI_ElevationAng_Clu_187 : 229|7@0+ (0.005,-0.315) [-0.315|0.32] "rad"  GW
 SG_ ARS_RDI_SNR_Clu_187 : 238|7@0+ (0.5,0) [0|63.5] "dB"  GW
 SG_ ARS_RDI_RCS_Clu_184 : 16|9@0+ (0.2,-51.2) [-51.2|51] "dBsm"  GW
 SG_ ARS_RDI_Range_Clu_188 : 247|12@0+ (0.0625,0) [0|255.9375] "m"  GW
 SG_ ARS_RDI_VradRel_Clu_188 : 251|11@0+ (0.1,-120) [-120|84.7] "m/s"  GW
 SG_ ARS_RDI_RCS_Clu_188 : 256|9@0+ (0.2,-51.2) [-51.2|51] "dBsm"  GW
 SG_ ARS_RDI_AzimuthAng_Clu_188 : 279|10@0+ (0.002,-1.022) [-1.022|1.024] "rad"  GW
 SG_ ARS_RDI_ElevationAng_Clu_188 : 285|7@0+ (0.005,-0.315) [-0.315|0.32] "rad"  GW
 SG_ ARS_RDI_SNR_Clu_188 : 294|7@0+ (0.5,0) [0|63.5] "dB"  GW
 SG_ ARS_RDI_DynProp_Clu_188 : 303|2@0+ (1,0) [0|3] ""  GW
 SG_ ARS_RDI_Quality_Clu_188 : 301|2@0+ (1,0) [0|3] ""  GW
 SG_ ARS_RDI_DynProp_Clu_189 : 299|2@0+ (1,0) [0|3] ""  GW
 SG_ ARS_RDI_Quality_Clu_189 : 297|2@0+ (1,0) [0|3] ""  GW
 SG_ ARS_RDI_Range_Clu_189 : 311|12@0+ (0.0625,0) [0|255.9375] "m"  GW
 SG_ ARS_RDI_VradRel_Clu_189 : 315|11@0+ (0.1,-120) [-120|84.7] "m/s"  GW
 SG_ ARS_RDI_RCS_Clu_189 : 320|9@0+ (0.2,-51.2) [-51.2|51] "dBsm"  GW
 SG_ ARS_RDI_AzimuthAng_Clu_184 : 39|10@0+ (0.002,-1.022) [-1.022|1.024] "rad"  GW
 SG_ ARS_RDI_AzimuthAng_Clu_189 : 343|10@0+ (0.002,-1.022) [-1.022|1.024] "rad"  GW
 SG_ ARS_RDI_ElevationAng_Clu_189 : 349|7@0+ (0.005,-0.315) [-0.315|0.32] "rad"  GW
 SG_ ARS_RDI_SNR_Clu_189 : 358|7@0+ (0.5,0) [0|63.5] "dB"  GW
 SG_ ARS_RDI_Range_Clu_190 : 367|12@0+ (0.0625,0) [0|255.9375] "m"  GW
 SG_ ARS_RDI_VradRel_Clu_190 : 371|11@0+ (0.1,-120) [-120|84.7] "m/s"  GW
 SG_ ARS_RDI_RCS_Clu_190 : 376|9@0+ (0.2,-51.2) [-51.2|51] "dBsm"  GW
 SG_ ARS_RDI_AzimuthAng_Clu_190 : 399|10@0+ (0.002,-1.022) [-1.022|1.024] "rad"  GW
 SG_ ARS_RDI_ElevationAng_Clu_190 : 405|7@0+ (0.005,-0.315) [-0.315|0.32] "rad"  GW
 SG_ ARS_RDI_SNR_Clu_190 : 414|7@0+ (0.5,0) [0|63.5] "dB"  GW
 SG_ ARS_RDI_DynProp_Clu_190 : 423|2@0+ (1,0) [0|3] ""  GW
 SG_ ARS_RDI_Quality_Clu_190 : 421|2@0+ (1,0) [0|3] ""  GW
 SG_ ARS_RDI_DynProp_Clu_191 : 419|2@0+ (1,0) [0|3] ""  GW
 SG_ ARS_RDI_Quality_Clu_191 : 417|2@0+ (1,0) [0|3] ""  GW
 SG_ ARS_RDI_Range_Clu_191 : 431|12@0+ (0.0625,0) [0|255.9375] "m"  GW
 SG_ ARS_RDI_ElevationAng_Clu_184 : 45|7@0+ (0.005,-0.315) [-0.315|0.32] "rad"  GW
 SG_ ARS_RDI_VradRel_Clu_191 : 435|11@0+ (0.1,-120) [-120|84.7] "m/s"  GW
 SG_ ARS_RDI_RCS_Clu_191 : 440|9@0+ (0.2,-51.2) [-51.2|51] "dBsm"  GW
 SG_ ARS_RDI_AzimuthAng_Clu_191 : 463|10@0+ (0.002,-1.022) [-1.022|1.024] "rad"  GW
 SG_ ARS_RDI_ElevationAng_Clu_191 : 469|7@0+ (0.005,-0.315) [-0.315|0.32] "rad"  GW
 SG_ ARS_RDI_SNR_Clu_191 : 478|7@0+ (0.5,0) [0|63.5] "dB"  GW
 SG_ ARS_RDI_MsgCounter_Clu_184_191 : 495|8@0+ (1,0) [0|255] ""  GW
 SG_ ARS_RDI_CRC16_Checksum_Clu_184_1 : 503|16@0+ (1,0) [0|65535] ""  GW
 SG_ ARS_RDI_SNR_Clu_184 : 54|7@0+ (0.5,0) [0|63.5] "dB"  GW
 SG_ ARS_RDI_DynProp_Clu_184 : 63|2@0+ (1,0) [0|3] ""  GW
 SG_ ARS_RDI_Quality_Clu_184 : 61|2@0+ (1,0) [0|3] ""  GW
 SG_ ARS_RDI_DynProp_Clu_185 : 59|2@0+ (1,0) [0|3] ""  GW
 SG_ ARS_RDI_Quality_Clu_185 : 57|2@0+ (1,0) [0|3] ""  GW
 SG_ ARS_RDI_Range_Clu_185 : 71|12@0+ (0.0625,0) [0|255.9375] "m"  GW
 SG_ ARS_RDI_VradRel_Clu_185 : 75|11@0+ (0.1,-120) [-120|84.7] "m/s"  GW
 SG_ ARS_RDI_RCS_Clu_185 : 80|9@0+ (0.2,-51.2) [-51.2|51] "dBsm"  GW
 SG_ ARS_RDI_AzimuthAng_Clu_185 : 103|10@0+ (0.002,-1.022) [-1.022|1.024] "rad"  GW

BO_ 281 ARS_RDI_192_199: 64 FR
 SG_ ARS_RDI_Range_Clu_192 : 7|12@0+ (0.0625,0) [0|255.9375] "m"  GW
 SG_ ARS_RDI_ElevationAng_Clu_193 : 109|7@0+ (0.005,-0.315) [-0.315|0.32] "rad"  GW
 SG_ ARS_RDI_SNR_Clu_193 : 118|7@0+ (0.5,0) [0|63.5] "dB"  GW
 SG_ ARS_RDI_Range_Clu_194 : 127|12@0+ (0.0625,0) [0|255.9375] "m"  GW
 SG_ ARS_RDI_VradRel_Clu_192 : 11|11@0+ (0.1,-120) [-120|84.7] "m/s"  GW
 SG_ ARS_RDI_VradRel_Clu_194 : 131|11@0+ (0.1,-120) [-120|84.7] "m/s"  GW
 SG_ ARS_RDI_RCS_Clu_194 : 136|9@0+ (0.2,-51.2) [-51.2|51] "dBsm"  GW
 SG_ ARS_RDI_AzimuthAng_Clu_194 : 159|10@0+ (0.002,-1.022) [-1.022|1.024] "rad"  GW
 SG_ ARS_RDI_ElevationAng_Clu_194 : 165|7@0+ (0.005,-0.315) [-0.315|0.32] "rad"  GW
 SG_ ARS_RDI_SNR_Clu_194 : 174|7@0+ (0.5,0) [0|63.5] "dB"  GW
 SG_ ARS_RDI_DynProp_Clu_194 : 183|2@0+ (1,0) [0|3] ""  GW
 SG_ ARS_RDI_Quality_Clu_194 : 181|2@0+ (1,0) [0|3] ""  GW
 SG_ ARS_RDI_DynProp_Clu_195 : 179|2@0+ (1,0) [0|3] ""  GW
 SG_ ARS_RDI_Quality_Clu_195 : 177|2@0+ (1,0) [0|3] ""  GW
 SG_ ARS_RDI_Range_Clu_195 : 191|12@0+ (0.0625,0) [0|255.9375] "m"  GW
 SG_ ARS_RDI_VradRel_Clu_195 : 195|11@0+ (0.1,-120) [-120|84.7] "m/s"  GW
 SG_ ARS_RDI_RCS_Clu_195 : 200|9@0+ (0.2,-51.2) [-51.2|51] "dBsm"  GW
 SG_ ARS_RDI_AzimuthAng_Clu_195 : 223|10@0+ (0.002,-1.022) [-1.022|1.024] "rad"  GW
 SG_ ARS_RDI_ElevationAng_Clu_195 : 229|7@0+ (0.005,-0.315) [-0.315|0.32] "rad"  GW
 SG_ ARS_RDI_SNR_Clu_195 : 238|7@0+ (0.5,0) [0|63.5] "dB"  GW
 SG_ ARS_RDI_RCS_Clu_192 : 16|9@0+ (0.2,-51.2) [-51.2|51] "dBsm"  GW
 SG_ ARS_RDI_Range_Clu_196 : 247|12@0+ (0.0625,0) [0|255.9375] "m"  GW
 SG_ ARS_RDI_VradRel_Clu_196 : 251|11@0+ (0.1,-120) [-120|84.7] "m/s"  GW
 SG_ ARS_RDI_RCS_Clu_196 : 256|9@0+ (0.2,-51.2) [-51.2|51] "dBsm"  GW
 SG_ ARS_RDI_AzimuthAng_Clu_196 : 279|10@0+ (0.002,-1.022) [-1.022|1.024] "rad"  GW
 SG_ ARS_RDI_ElevationAng_Clu_196 : 285|7@0+ (0.005,-0.315) [-0.315|0.32] "rad"  GW
 SG_ ARS_RDI_SNR_Clu_196 : 294|7@0+ (0.5,0) [0|63.5] "dB"  GW
 SG_ ARS_RDI_DynProp_Clu_196 : 303|2@0+ (1,0) [0|3] ""  GW
 SG_ ARS_RDI_Quality_Clu_196 : 301|2@0+ (1,0) [0|3] ""  GW
 SG_ ARS_RDI_DynProp_Clu_197 : 299|2@0+ (1,0) [0|3] ""  GW
 SG_ ARS_RDI_Quality_Clu_197 : 297|2@0+ (1,0) [0|3] ""  GW
 SG_ ARS_RDI_Range_Clu_197 : 311|12@0+ (0.0625,0) [0|255.9375] "m"  GW
 SG_ ARS_RDI_VradRel_Clu_197 : 315|11@0+ (0.1,-120) [-120|84.7] "m/s"  GW
 SG_ ARS_RDI_RCS_Clu_197 : 320|9@0+ (0.2,-51.2) [-51.2|51] "dBsm"  GW
 SG_ ARS_RDI_AzimuthAng_Clu_192 : 39|10@0+ (0.002,-1.022) [-1.022|1.024] "rad"  GW
 SG_ ARS_RDI_AzimuthAng_Clu_197 : 343|10@0+ (0.002,-1.022) [-1.022|1.024] "rad"  GW
 SG_ ARS_RDI_ElevationAng_Clu_197 : 349|7@0+ (0.005,-0.315) [-0.315|0.32] "rad"  GW
 SG_ ARS_RDI_SNR_Clu_197 : 358|7@0+ (0.5,0) [0|63.5] "dB"  GW
 SG_ ARS_RDI_Range_Clu_198 : 367|12@0+ (0.0625,0) [0|255.9375] "m"  GW
 SG_ ARS_RDI_VradRel_Clu_198 : 371|11@0+ (0.1,-120) [-120|84.7] "m/s"  GW
 SG_ ARS_RDI_RCS_Clu_198 : 376|9@0+ (0.2,-51.2) [-51.2|51] "dBsm"  GW
 SG_ ARS_RDI_AzimuthAng_Clu_198 : 399|10@0+ (0.002,-1.022) [-1.022|1.024] "rad"  GW
 SG_ ARS_RDI_ElevationAng_Clu_198 : 405|7@0+ (0.005,-0.315) [-0.315|0.32] "rad"  GW
 SG_ ARS_RDI_SNR_Clu_198 : 414|7@0+ (0.5,0) [0|63.5] "dB"  GW
 SG_ ARS_RDI_DynProp_Clu_198 : 423|2@0+ (1,0) [0|3] ""  GW
 SG_ ARS_RDI_Quality_Clu_198 : 421|2@0+ (1,0) [0|3] ""  GW
 SG_ ARS_RDI_DynProp_Clu_199 : 419|2@0+ (1,0) [0|3] ""  GW
 SG_ ARS_RDI_Quality_Clu_199 : 417|2@0+ (1,0) [0|3] ""  GW
 SG_ ARS_RDI_Range_Clu_199 : 431|12@0+ (0.0625,0) [0|255.9375] "m"  GW
 SG_ ARS_RDI_ElevationAng_Clu_192 : 45|7@0+ (0.005,-0.315) [-0.315|0.32] "rad"  GW
 SG_ ARS_RDI_VradRel_Clu_199 : 435|11@0+ (0.1,-120) [-120|84.7] "m/s"  GW
 SG_ ARS_RDI_RCS_Clu_199 : 440|9@0+ (0.2,-51.2) [-51.2|51] "dBsm"  GW
 SG_ ARS_RDI_AzimuthAng_Clu_199 : 463|10@0+ (0.002,-1.022) [-1.022|1.024] "rad"  GW
 SG_ ARS_RDI_ElevationAng_Clu_199 : 469|7@0+ (0.005,-0.315) [-0.315|0.32] "rad"  GW
 SG_ ARS_RDI_SNR_Clu_199 : 478|7@0+ (0.5,0) [0|63.5] "dB"  GW
 SG_ ARS_RDI_MsgCounter_Clu_192_199 : 495|8@0+ (1,0) [0|255] ""  GW
 SG_ ARS_RDI_CRC16_Checksum_Clu_192_1 : 503|16@0+ (1,0) [0|65535] ""  GW
 SG_ ARS_RDI_SNR_Clu_192 : 54|7@0+ (0.5,0) [0|63.5] "dB"  GW
 SG_ ARS_RDI_DynProp_Clu_192 : 63|2@0+ (1,0) [0|3] ""  GW
 SG_ ARS_RDI_Quality_Clu_192 : 61|2@0+ (1,0) [0|3] ""  GW
 SG_ ARS_RDI_DynProp_Clu_193 : 59|2@0+ (1,0) [0|3] ""  GW
 SG_ ARS_RDI_Quality_Clu_193 : 57|2@0+ (1,0) [0|3] ""  GW
 SG_ ARS_RDI_Range_Clu_193 : 71|12@0+ (0.0625,0) [0|255.9375] "m"  GW
 SG_ ARS_RDI_VradRel_Clu_193 : 75|11@0+ (0.1,-120) [-120|84.7] "m/s"  GW
 SG_ ARS_RDI_RCS_Clu_193 : 80|9@0+ (0.2,-51.2) [-51.2|51] "dBsm"  GW
 SG_ ARS_RDI_AzimuthAng_Clu_193 : 103|10@0+ (0.002,-1.022) [-1.022|1.024] "rad"  GW

BO_ 282 ARS_RDI_ExtensionList_0: 64 FR
 SG_ ARS_RDI_Obj_ID_Clu_000 : 7|6@0+ (1,0) [0|63] ""  GW
 SG_ ARS_RDI_Obj_ID_Clu_001 : 1|6@0+ (1,0) [0|63] ""  GW
 SG_ ARS_RDI_Obj_ID_Clu_017 : 97|6@0+ (1,0) [0|63] ""  GW
 SG_ ARS_RDI_Obj_ID_Clu_018 : 107|6@0+ (1,0) [0|63] ""  GW
 SG_ ARS_RDI_Obj_ID_Clu_019 : 117|6@0+ (1,0) [0|63] ""  GW
 SG_ ARS_RDI_Obj_ID_Clu_020 : 127|6@0+ (1,0) [0|63] ""  GW
 SG_ ARS_RDI_Obj_ID_Clu_021 : 121|6@0+ (1,0) [0|63] ""  GW
 SG_ ARS_RDI_Obj_ID_Clu_002 : 11|6@0+ (1,0) [0|63] ""  GW
 SG_ ARS_RDI_Obj_ID_Clu_022 : 131|6@0+ (1,0) [0|63] ""  GW
 SG_ ARS_RDI_Obj_ID_Clu_023 : 141|6@0+ (1,0) [0|63] ""  GW
 SG_ ARS_RDI_Obj_ID_Clu_024 : 151|6@0+ (1,0) [0|63] ""  GW
 SG_ ARS_RDI_Obj_ID_Clu_025 : 145|6@0+ (1,0) [0|63] ""  GW
 SG_ ARS_RDI_Obj_ID_Clu_026 : 155|6@0+ (1,0) [0|63] ""  GW
 SG_ ARS_RDI_Obj_ID_Clu_027 : 165|6@0+ (1,0) [0|63] ""  GW
 SG_ ARS_RDI_Obj_ID_Clu_028 : 175|6@0+ (1,0) [0|63] ""  GW
 SG_ ARS_RDI_Obj_ID_Clu_029 : 169|6@0+ (1,0) [0|63] ""  GW
 SG_ ARS_RDI_Obj_ID_Clu_030 : 179|6@0+ (1,0) [0|63] ""  GW
 SG_ ARS_RDI_Obj_ID_Clu_031 : 189|6@0+ (1,0) [0|63] ""  GW
 SG_ ARS_RDI_Obj_ID_Clu_003 : 21|6@0+ (1,0) [0|63] ""  GW
 SG_ ARS_RDI_Obj_ID_Clu_032 : 199|6@0+ (1,0) [0|63] ""  GW
 SG_ ARS_RDI_Obj_ID_Clu_033 : 193|6@0+ (1,0) [0|63] ""  GW
 SG_ ARS_RDI_Obj_ID_Clu_034 : 203|6@0+ (1,0) [0|63] ""  GW
 SG_ ARS_RDI_Obj_ID_Clu_035 : 213|6@0+ (1,0) [0|63] ""  GW
 SG_ ARS_RDI_Obj_ID_Clu_036 : 223|6@0+ (1,0) [0|63] ""  GW
 SG_ ARS_RDI_Obj_ID_Clu_037 : 217|6@0+ (1,0) [0|63] ""  GW
 SG_ ARS_RDI_Obj_ID_Clu_038 : 227|6@0+ (1,0) [0|63] ""  GW
 SG_ ARS_RDI_Obj_ID_Clu_039 : 237|6@0+ (1,0) [0|63] ""  GW
 SG_ ARS_RDI_Obj_ID_Clu_040 : 247|6@0+ (1,0) [0|63] ""  GW
 SG_ ARS_RDI_Obj_ID_Clu_041 : 241|6@0+ (1,0) [0|63] ""  GW
 SG_ ARS_RDI_Obj_ID_Clu_004 : 31|6@0+ (1,0) [0|63] ""  GW
 SG_ ARS_RDI_Obj_ID_Clu_042 : 251|6@0+ (1,0) [0|63] ""  GW
 SG_ ARS_RDI_Obj_ID_Clu_043 : 261|6@0+ (1,0) [0|63] ""  GW
 SG_ ARS_RDI_Obj_ID_Clu_044 : 271|6@0+ (1,0) [0|63] ""  GW
 SG_ ARS_RDI_Obj_ID_Clu_045 : 265|6@0+ (1,0) [0|63] ""  GW
 SG_ ARS_RDI_Obj_ID_Clu_046 : 275|6@0+ (1,0) [0|63] ""  GW
 SG_ ARS_RDI_Obj_ID_Clu_047 : 285|6@0+ (1,0) [0|63] ""  GW
 SG_ ARS_RDI_Obj_ID_Clu_048 : 295|6@0+ (1,0) [0|63] ""  GW
 SG_ ARS_RDI_Obj_ID_Clu_049 : 289|6@0+ (1,0) [0|63] ""  GW
 SG_ ARS_RDI_Obj_ID_Clu_050 : 299|6@0+ (1,0) [0|63] ""  GW
 SG_ ARS_RDI_Obj_ID_Clu_051 : 309|6@0+ (1,0) [0|63] ""  GW
 SG_ ARS_RDI_Obj_ID_Clu_005 : 25|6@0+ (1,0) [0|63] ""  GW
 SG_ ARS_RDI_Obj_ID_Clu_052 : 319|6@0+ (1,0) [0|63] ""  GW
 SG_ ARS_RDI_Obj_ID_Clu_053 : 313|6@0+ (1,0) [0|63] ""  GW
 SG_ ARS_RDI_Obj_ID_Clu_054 : 323|6@0+ (1,0) [0|63] ""  GW
 SG_ ARS_RDI_Obj_ID_Clu_055 : 333|6@0+ (1,0) [0|63] ""  GW
 SG_ ARS_RDI_Obj_ID_Clu_056 : 343|6@0+ (1,0) [0|63] ""  GW
 SG_ ARS_RDI_Obj_ID_Clu_057 : 337|6@0+ (1,0) [0|63] ""  GW
 SG_ ARS_RDI_Obj_ID_Clu_058 : 347|6@0+ (1,0) [0|63] ""  GW
 SG_ ARS_RDI_Obj_ID_Clu_059 : 357|6@0+ (1,0) [0|63] ""  GW
 SG_ ARS_RDI_Obj_ID_Clu_060 : 367|6@0+ (1,0) [0|63] ""  GW
 SG_ ARS_RDI_Obj_ID_Clu_061 : 361|6@0+ (1,0) [0|63] ""  GW
 SG_ ARS_RDI_Obj_ID_Clu_006 : 35|6@0+ (1,0) [0|63] ""  GW
 SG_ ARS_RDI_Obj_ID_Clu_062 : 371|6@0+ (1,0) [0|63] ""  GW
 SG_ ARS_RDI_Obj_ID_Clu_063 : 381|6@0+ (1,0) [0|63] ""  GW
 SG_ ARS_RDI_Obj_ID_Clu_064 : 391|6@0+ (1,0) [0|63] ""  GW
 SG_ ARS_RDI_Obj_ID_Clu_065 : 385|6@0+ (1,0) [0|63] ""  GW
 SG_ ARS_RDI_Obj_ID_Clu_066 : 395|6@0+ (1,0) [0|63] ""  GW
 SG_ ARS_RDI_Obj_ID_Clu_067 : 405|6@0+ (1,0) [0|63] ""  GW
 SG_ ARS_RDI_Obj_ID_Clu_068 : 415|6@0+ (1,0) [0|63] ""  GW
 SG_ ARS_RDI_Obj_ID_Clu_069 : 409|6@0+ (1,0) [0|63] ""  GW
 SG_ ARS_RDI_Obj_ID_Clu_070 : 419|6@0+ (1,0) [0|63] ""  GW
 SG_ ARS_RDI_Obj_ID_Clu_071 : 429|6@0+ (1,0) [0|63] ""  GW
 SG_ ARS_RDI_Obj_ID_Clu_007 : 45|6@0+ (1,0) [0|63] ""  GW
 SG_ ARS_RDI_Obj_ID_Clu_072 : 439|6@0+ (1,0) [0|63] ""  GW
 SG_ ARS_RDI_Obj_ID_Clu_073 : 433|6@0+ (1,0) [0|63] ""  GW
 SG_ ARS_RDI_Obj_ID_Clu_074 : 443|6@0+ (1,0) [0|63] ""  GW
 SG_ ARS_RDI_Obj_ID_Clu_075 : 453|6@0+ (1,0) [0|63] ""  GW
 SG_ ARS_RDI_Obj_ID_Clu_076 : 463|6@0+ (1,0) [0|63] ""  GW
 SG_ ARS_RDI_Obj_ID_Clu_077 : 457|6@0+ (1,0) [0|63] ""  GW
 SG_ ARS_RDI_Obj_ID_Clu_078 : 467|6@0+ (1,0) [0|63] ""  GW
 SG_ ARS_RDI_Obj_ID_Clu_079 : 477|6@0+ (1,0) [0|63] ""  GW
 SG_ ARS_RDI_MsgCounter_ExtList_0 : 495|8@0+ (1,0) [0|255] ""  GW
 SG_ ARS_RDI_Obj_ID_Clu_008 : 55|6@0+ (1,0) [0|63] ""  GW
 SG_ ARS_RDI_CRC16_Checksum_ExtList_0 : 503|16@0+ (1,0) [0|65535] ""  GW
 SG_ ARS_RDI_Obj_ID_Clu_009 : 49|6@0+ (1,0) [0|63] ""  GW
 SG_ ARS_RDI_Obj_ID_Clu_010 : 59|6@0+ (1,0) [0|63] ""  GW
 SG_ ARS_RDI_Obj_ID_Clu_011 : 69|6@0+ (1,0) [0|63] ""  GW
 SG_ ARS_RDI_Obj_ID_Clu_012 : 79|6@0+ (1,0) [0|63] ""  GW
 SG_ ARS_RDI_Obj_ID_Clu_013 : 73|6@0+ (1,0) [0|63] ""  GW
 SG_ ARS_RDI_Obj_ID_Clu_014 : 83|6@0+ (1,0) [0|63] ""  GW
 SG_ ARS_RDI_Obj_ID_Clu_015 : 93|6@0+ (1,0) [0|63] ""  GW
 SG_ ARS_RDI_Obj_ID_Clu_016 : 103|6@0+ (1,0) [0|63] ""  GW

BO_ 283 ARS_RDI_ExtensionList_1: 64 FR
 SG_ ARS_RDI_Obj_ID_Clu_080 : 7|6@0+ (1,0) [0|63] ""  GW
 SG_ ARS_RDI_Obj_ID_Clu_081 : 1|6@0+ (1,0) [0|63] ""  GW
 SG_ ARS_RDI_Obj_ID_Clu_097 : 97|6@0+ (1,0) [0|63] ""  GW
 SG_ ARS_RDI_Obj_ID_Clu_098 : 107|6@0+ (1,0) [0|63] ""  GW
 SG_ ARS_RDI_Obj_ID_Clu_099 : 117|6@0+ (1,0) [0|63] ""  GW
 SG_ ARS_RDI_Obj_ID_Clu_100 : 127|6@0+ (1,0) [0|63] ""  GW
 SG_ ARS_RDI_Obj_ID_Clu_101 : 121|6@0+ (1,0) [0|63] ""  GW
 SG_ ARS_RDI_Obj_ID_Clu_082 : 11|6@0+ (1,0) [0|63] ""  GW
 SG_ ARS_RDI_Obj_ID_Clu_102 : 131|6@0+ (1,0) [0|63] ""  GW
 SG_ ARS_RDI_Obj_ID_Clu_103 : 141|6@0+ (1,0) [0|63] ""  GW
 SG_ ARS_RDI_Obj_ID_Clu_104 : 151|6@0+ (1,0) [0|63] ""  GW
 SG_ ARS_RDI_Obj_ID_Clu_105 : 145|6@0+ (1,0) [0|63] ""  GW
 SG_ ARS_RDI_Obj_ID_Clu_106 : 155|6@0+ (1,0) [0|63] ""  GW
 SG_ ARS_RDI_Obj_ID_Clu_107 : 165|6@0+ (1,0) [0|63] ""  GW
 SG_ ARS_RDI_Obj_ID_Clu_108 : 175|6@0+ (1,0) [0|63] ""  GW
 SG_ ARS_RDI_Obj_ID_Clu_109 : 169|6@0+ (1,0) [0|63] ""  GW
 SG_ ARS_RDI_Obj_ID_Clu_110 : 179|6@0+ (1,0) [0|63] ""  GW
 SG_ ARS_RDI_Obj_ID_Clu_111 : 189|6@0+ (1,0) [0|63] ""  GW
 SG_ ARS_RDI_Obj_ID_Clu_083 : 21|6@0+ (1,0) [0|63] ""  GW
 SG_ ARS_RDI_Obj_ID_Clu_112 : 199|6@0+ (1,0) [0|63] ""  GW
 SG_ ARS_RDI_Obj_ID_Clu_113 : 193|6@0+ (1,0) [0|63] ""  GW
 SG_ ARS_RDI_Obj_ID_Clu_114 : 203|6@0+ (1,0) [0|63] ""  GW
 SG_ ARS_RDI_Obj_ID_Clu_115 : 213|6@0+ (1,0) [0|63] ""  GW
 SG_ ARS_RDI_Obj_ID_Clu_116 : 223|6@0+ (1,0) [0|63] ""  GW
 SG_ ARS_RDI_Obj_ID_Clu_117 : 217|6@0+ (1,0) [0|63] ""  GW
 SG_ ARS_RDI_Obj_ID_Clu_118 : 227|6@0+ (1,0) [0|63] ""  GW
 SG_ ARS_RDI_Obj_ID_Clu_119 : 237|6@0+ (1,0) [0|63] ""  GW
 SG_ ARS_RDI_Obj_ID_Clu_120 : 247|6@0+ (1,0) [0|63] ""  GW
 SG_ ARS_RDI_Obj_ID_Clu_121 : 241|6@0+ (1,0) [0|63] ""  GW
 SG_ ARS_RDI_Obj_ID_Clu_084 : 31|6@0+ (1,0) [0|63] ""  GW
 SG_ ARS_RDI_Obj_ID_Clu_122 : 251|6@0+ (1,0) [0|63] ""  GW
 SG_ ARS_RDI_Obj_ID_Clu_123 : 261|6@0+ (1,0) [0|63] ""  GW
 SG_ ARS_RDI_Obj_ID_Clu_124 : 271|6@0+ (1,0) [0|63] ""  GW
 SG_ ARS_RDI_Obj_ID_Clu_125 : 265|6@0+ (1,0) [0|63] ""  GW
 SG_ ARS_RDI_Obj_ID_Clu_126 : 275|6@0+ (1,0) [0|63] ""  GW
 SG_ ARS_RDI_Obj_ID_Clu_127 : 285|6@0+ (1,0) [0|63] ""  GW
 SG_ ARS_RDI_Obj_ID_Clu_128 : 295|6@0+ (1,0) [0|63] ""  GW
 SG_ ARS_RDI_Obj_ID_Clu_129 : 289|6@0+ (1,0) [0|63] ""  GW
 SG_ ARS_RDI_Obj_ID_Clu_130 : 299|6@0+ (1,0) [0|63] ""  GW
 SG_ ARS_RDI_Obj_ID_Clu_131 : 309|6@0+ (1,0) [0|63] ""  GW
 SG_ ARS_RDI_Obj_ID_Clu_085 : 25|6@0+ (1,0) [0|63] ""  GW
 SG_ ARS_RDI_Obj_ID_Clu_132 : 319|6@0+ (1,0) [0|63] ""  GW
 SG_ ARS_RDI_Obj_ID_Clu_133 : 313|6@0+ (1,0) [0|63] ""  GW
 SG_ ARS_RDI_Obj_ID_Clu_134 : 323|6@0+ (1,0) [0|63] ""  GW
 SG_ ARS_RDI_Obj_ID_Clu_135 : 333|6@0+ (1,0) [0|63] ""  GW
 SG_ ARS_RDI_Obj_ID_Clu_136 : 343|6@0+ (1,0) [0|63] ""  GW
 SG_ ARS_RDI_Obj_ID_Clu_137 : 337|6@0+ (1,0) [0|63] ""  GW
 SG_ ARS_RDI_Obj_ID_Clu_138 : 347|6@0+ (1,0) [0|63] ""  GW
 SG_ ARS_RDI_Obj_ID_Clu_139 : 357|6@0+ (1,0) [0|63] ""  GW
 SG_ ARS_RDI_Obj_ID_Clu_140 : 367|6@0+ (1,0) [0|63] ""  GW
 SG_ ARS_RDI_Obj_ID_Clu_141 : 361|6@0+ (1,0) [0|63] ""  GW
 SG_ ARS_RDI_Obj_ID_Clu_086 : 35|6@0+ (1,0) [0|63] ""  GW
 SG_ ARS_RDI_Obj_ID_Clu_142 : 371|6@0+ (1,0) [0|63] ""  GW
 SG_ ARS_RDI_Obj_ID_Clu_143 : 381|6@0+ (1,0) [0|63] ""  GW
 SG_ ARS_RDI_Obj_ID_Clu_144 : 391|6@0+ (1,0) [0|63] ""  GW
 SG_ ARS_RDI_Obj_ID_Clu_145 : 385|6@0+ (1,0) [0|63] ""  GW
 SG_ ARS_RDI_Obj_ID_Clu_146 : 395|6@0+ (1,0) [0|63] ""  GW
 SG_ ARS_RDI_Obj_ID_Clu_147 : 405|6@0+ (1,0) [0|63] ""  GW
 SG_ ARS_RDI_Obj_ID_Clu_148 : 415|6@0+ (1,0) [0|63] ""  GW
 SG_ ARS_RDI_Obj_ID_Clu_149 : 409|6@0+ (1,0) [0|63] ""  GW
 SG_ ARS_RDI_Obj_ID_Clu_150 : 419|6@0+ (1,0) [0|63] ""  GW
 SG_ ARS_RDI_Obj_ID_Clu_151 : 429|6@0+ (1,0) [0|63] ""  GW
 SG_ ARS_RDI_Obj_ID_Clu_087 : 45|6@0+ (1,0) [0|63] ""  GW
 SG_ ARS_RDI_Obj_ID_Clu_152 : 439|6@0+ (1,0) [0|63] ""  GW
 SG_ ARS_RDI_Obj_ID_Clu_153 : 433|6@0+ (1,0) [0|63] ""  GW
 SG_ ARS_RDI_Obj_ID_Clu_154 : 443|6@0+ (1,0) [0|63] ""  GW
 SG_ ARS_RDI_Obj_ID_Clu_155 : 453|6@0+ (1,0) [0|63] ""  GW
 SG_ ARS_RDI_Obj_ID_Clu_156 : 463|6@0+ (1,0) [0|63] ""  GW
 SG_ ARS_RDI_Obj_ID_Clu_157 : 457|6@0+ (1,0) [0|63] ""  GW
 SG_ ARS_RDI_Obj_ID_Clu_158 : 467|6@0+ (1,0) [0|63] ""  GW
 SG_ ARS_RDI_Obj_ID_Clu_159 : 477|6@0+ (1,0) [0|63] ""  GW
 SG_ ARS_RDI_MsgCounter_ExtList_1 : 495|8@0+ (1,0) [0|255] ""  GW
 SG_ ARS_RDI_Obj_ID_Clu_088 : 55|6@0+ (1,0) [0|63] ""  GW
 SG_ ARS_RDI_CRC16_Checksum_ExtList_1 : 503|16@0+ (1,0) [0|65535] ""  GW
 SG_ ARS_RDI_Obj_ID_Clu_089 : 49|6@0+ (1,0) [0|63] ""  GW
 SG_ ARS_RDI_Obj_ID_Clu_090 : 59|6@0+ (1,0) [0|63] ""  GW
 SG_ ARS_RDI_Obj_ID_Clu_091 : 69|6@0+ (1,0) [0|63] ""  GW
 SG_ ARS_RDI_Obj_ID_Clu_092 : 79|6@0+ (1,0) [0|63] ""  GW
 SG_ ARS_RDI_Obj_ID_Clu_093 : 73|6@0+ (1,0) [0|63] ""  GW
 SG_ ARS_RDI_Obj_ID_Clu_094 : 83|6@0+ (1,0) [0|63] ""  GW
 SG_ ARS_RDI_Obj_ID_Clu_095 : 93|6@0+ (1,0) [0|63] ""  GW
 SG_ ARS_RDI_Obj_ID_Clu_096 : 103|6@0+ (1,0) [0|63] ""  GW

BO_ 284 ARS_RDI_ExtensionList_2: 64 FR
 SG_ ARS_RDI_Obj_ID_Clu_160 : 7|6@0+ (1,0) [0|63] ""  GW
 SG_ ARS_RDI_Obj_ID_Clu_161 : 1|6@0+ (1,0) [0|63] ""  GW
 SG_ ARS_RDI_Obj_ID_Clu_177 : 97|6@0+ (1,0) [0|63] ""  GW
 SG_ ARS_RDI_Obj_ID_Clu_178 : 107|6@0+ (1,0) [0|63] ""  GW
 SG_ ARS_RDI_Obj_ID_Clu_179 : 117|6@0+ (1,0) [0|63] ""  GW
 SG_ ARS_RDI_Obj_ID_Clu_180 : 127|6@0+ (1,0) [0|63] ""  GW
 SG_ ARS_RDI_Obj_ID_Clu_181 : 121|6@0+ (1,0) [0|63] ""  GW
 SG_ ARS_RDI_Obj_ID_Clu_162 : 11|6@0+ (1,0) [0|63] ""  GW
 SG_ ARS_RDI_Obj_ID_Clu_182 : 131|6@0+ (1,0) [0|63] ""  GW
 SG_ ARS_RDI_Obj_ID_Clu_183 : 141|6@0+ (1,0) [0|63] ""  GW
 SG_ ARS_RDI_Obj_ID_Clu_184 : 151|6@0+ (1,0) [0|63] ""  GW
 SG_ ARS_RDI_Obj_ID_Clu_185 : 145|6@0+ (1,0) [0|63] ""  GW
 SG_ ARS_RDI_Obj_ID_Clu_186 : 155|6@0+ (1,0) [0|63] ""  GW
 SG_ ARS_RDI_Obj_ID_Clu_187 : 165|6@0+ (1,0) [0|63] ""  GW
 SG_ ARS_RDI_Obj_ID_Clu_188 : 175|6@0+ (1,0) [0|63] ""  GW
 SG_ ARS_RDI_Obj_ID_Clu_189 : 169|6@0+ (1,0) [0|63] ""  GW
 SG_ ARS_RDI_Obj_ID_Clu_190 : 179|6@0+ (1,0) [0|63] ""  GW
 SG_ ARS_RDI_Obj_ID_Clu_191 : 189|6@0+ (1,0) [0|63] ""  GW
 SG_ ARS_RDI_Obj_ID_Clu_163 : 21|6@0+ (1,0) [0|63] ""  GW
 SG_ ARS_RDI_Obj_ID_Clu_192 : 199|6@0+ (1,0) [0|63] ""  GW
 SG_ ARS_RDI_Obj_ID_Clu_193 : 193|6@0+ (1,0) [0|63] ""  GW
 SG_ ARS_RDI_Obj_ID_Clu_194 : 203|6@0+ (1,0) [0|63] ""  GW
 SG_ ARS_RDI_Obj_ID_Clu_195 : 213|6@0+ (1,0) [0|63] ""  GW
 SG_ ARS_RDI_Obj_ID_Clu_196 : 223|6@0+ (1,0) [0|63] ""  GW
 SG_ ARS_RDI_Obj_ID_Clu_197 : 217|6@0+ (1,0) [0|63] ""  GW
 SG_ ARS_RDI_Obj_ID_Clu_198 : 227|6@0+ (1,0) [0|63] ""  GW
 SG_ ARS_RDI_Obj_ID_Clu_199 : 237|6@0+ (1,0) [0|63] ""  GW
 SG_ ARS_RDI_Obj_ID_Clu_164 : 31|6@0+ (1,0) [0|63] ""  GW
 SG_ ARS_RDI_Obj_ID_Clu_165 : 25|6@0+ (1,0) [0|63] ""  GW
 SG_ ARS_RDI_Obj_ID_Clu_166 : 35|6@0+ (1,0) [0|63] ""  GW
 SG_ ARS_RDI_Obj_ID_Clu_167 : 45|6@0+ (1,0) [0|63] ""  GW
 SG_ ARS_RDI_MsgCounter_ExtList_2 : 495|8@0+ (1,0) [0|255] ""  GW
 SG_ ARS_RDI_Obj_ID_Clu_168 : 55|6@0+ (1,0) [0|63] ""  GW
 SG_ ARS_RDI_CRC16_Checksum_ExtList_2 : 503|16@0+ (1,0) [0|65535] ""  GW
 SG_ ARS_RDI_Obj_ID_Clu_169 : 49|6@0+ (1,0) [0|63] ""  GW
 SG_ ARS_RDI_Obj_ID_Clu_170 : 59|6@0+ (1,0) [0|63] ""  GW
 SG_ ARS_RDI_Obj_ID_Clu_171 : 69|6@0+ (1,0) [0|63] ""  GW
 SG_ ARS_RDI_Obj_ID_Clu_172 : 79|6@0+ (1,0) [0|63] ""  GW
 SG_ ARS_RDI_Obj_ID_Clu_173 : 73|6@0+ (1,0) [0|63] ""  GW
 SG_ ARS_RDI_Obj_ID_Clu_174 : 83|6@0+ (1,0) [0|63] ""  GW
 SG_ ARS_RDI_Obj_ID_Clu_175 : 93|6@0+ (1,0) [0|63] ""  GW
 SG_ ARS_RDI_Obj_ID_Clu_176 : 103|6@0+ (1,0) [0|63] ""  GW

BO_ 285 ARS_RDI_200_207: 64 FR
 SG_ ARS_RDI_Range_Clu_200 : 7|12@0+ (0.0625,0) [0|255.9375] "m"  GW
 SG_ ARS_RDI_ElevationAng_Clu_201 : 109|7@0+ (0.005,-0.315) [-0.315|0.32] "rad"  GW
 SG_ ARS_RDI_SNR_Clu_201 : 118|7@0+ (0.5,0) [0|63.5] "dB"  GW
 SG_ ARS_RDI_Range_Clu_202 : 127|12@0+ (0.0625,0) [0|255.9375] "m"  GW
 SG_ ARS_RDI_VradRel_Clu_200 : 11|11@0+ (0.1,-120) [-120|84.7] "m/s"  GW
 SG_ ARS_RDI_VradRel_Clu_202 : 131|11@0+ (0.1,-120) [-120|84.7] "m/s"  GW
 SG_ ARS_RDI_RCS_Clu_202 : 136|9@0+ (0.2,-51.2) [-51.2|51] "dBsm"  GW
 SG_ ARS_RDI_AzimuthAng_Clu_202 : 159|10@0+ (0.002,-1.022) [-1.022|1.024] "rad"  GW
 SG_ ARS_RDI_ElevationAng_Clu_202 : 165|7@0+ (0.005,-0.315) [-0.315|0.32] "rad"  GW
 SG_ ARS_RDI_SNR_Clu_202 : 174|7@0+ (0.5,0) [0|63.5] "dB"  GW
 SG_ ARS_RDI_DynProp_Clu_202 : 183|2@0+ (1,0) [0|3] ""  GW
 SG_ ARS_RDI_Quality_Clu_202 : 181|2@0+ (1,0) [0|3] ""  GW
 SG_ ARS_RDI_DynProp_Clu_203 : 179|2@0+ (1,0) [0|3] ""  GW
 SG_ ARS_RDI_Quality_Clu_203 : 177|2@0+ (1,0) [0|3] ""  GW
 SG_ ARS_RDI_Range_Clu_203 : 191|12@0+ (0.0625,0) [0|255.9375] "m"  GW
 SG_ ARS_RDI_VradRel_Clu_203 : 195|11@0+ (0.1,-120) [-120|84.7] "m/s"  GW
 SG_ ARS_RDI_RCS_Clu_203 : 200|9@0+ (0.2,-51.2) [-51.2|51] "dBsm"  GW
 SG_ ARS_RDI_AzimuthAng_Clu_203 : 223|10@0+ (0.002,-1.022) [-1.022|1.024] "rad"  GW
 SG_ ARS_RDI_ElevationAng_Clu_203 : 229|7@0+ (0.005,-0.315) [-0.315|0.32] "rad"  GW
 SG_ ARS_RDI_SNR_Clu_203 : 238|7@0+ (0.5,0) [0|63.5] "dB"  GW
 SG_ ARS_RDI_RCS_Clu_200 : 16|9@0+ (0.2,-51.2) [-51.2|51] "dBsm"  GW
 SG_ ARS_RDI_Range_Clu_204 : 247|12@0+ (0.0625,0) [0|255.9375] "m"  GW
 SG_ ARS_RDI_VradRel_Clu_204 : 251|11@0+ (0.1,-120) [-120|84.7] "m/s"  GW
 SG_ ARS_RDI_RCS_Clu_204 : 256|9@0+ (0.2,-51.2) [-51.2|51] "dBsm"  GW
 SG_ ARS_RDI_AzimuthAng_Clu_204 : 279|10@0+ (0.002,-1.022) [-1.022|1.024] "rad"  GW
 SG_ ARS_RDI_ElevationAng_Clu_204 : 285|7@0+ (0.005,-0.315) [-0.315|0.32] "rad"  GW
 SG_ ARS_RDI_SNR_Clu_204 : 294|7@0+ (0.5,0) [0|63.5] "dB"  GW
 SG_ ARS_RDI_DynProp_Clu_204 : 303|2@0+ (1,0) [0|3] ""  GW
 SG_ ARS_RDI_Quality_Clu_204 : 301|2@0+ (1,0) [0|3] ""  GW
 SG_ ARS_RDI_DynProp_Clu_205 : 299|2@0+ (1,0) [0|3] ""  GW
 SG_ ARS_RDI_Quality_Clu_205 : 297|2@0+ (1,0) [0|3] ""  GW
 SG_ ARS_RDI_Range_Clu_205 : 311|12@0+ (0.0625,0) [0|255.9375] "m"  GW
 SG_ ARS_RDI_VradRel_Clu_205 : 315|11@0+ (0.1,-120) [-120|84.7] "m/s"  GW
 SG_ ARS_RDI_RCS_Clu_205 : 320|9@0+ (0.2,-51.2) [-51.2|51] "dBsm"  GW
 SG_ ARS_RDI_AzimuthAng_Clu_200 : 39|10@0+ (0.002,-1.022) [-1.022|1.024] "rad"  GW
 SG_ ARS_RDI_AzimuthAng_Clu_205 : 343|10@0+ (0.002,-1.022) [-1.022|1.024] "rad"  GW
 SG_ ARS_RDI_ElevationAng_Clu_205 : 349|7@0+ (0.005,-0.315) [-0.315|0.32] "rad"  GW
 SG_ ARS_RDI_SNR_Clu_205 : 358|7@0+ (0.5,0) [0|63.5] "dB"  GW
 SG_ ARS_RDI_Range_Clu_206 : 367|12@0+ (0.0625,0) [0|255.9375] "m"  GW
 SG_ ARS_RDI_VradRel_Clu_206 : 371|11@0+ (0.1,-120) [-120|84.7] "m/s"  GW
 SG_ ARS_RDI_RCS_Clu_206 : 376|9@0+ (0.2,-51.2) [-51.2|51] "dBsm"  GW
 SG_ ARS_RDI_AzimuthAng_Clu_206 : 399|10@0+ (0.002,-1.022) [-1.022|1.024] "rad"  GW
 SG_ ARS_RDI_ElevationAng_Clu_206 : 405|7@0+ (0.005,-0.315) [-0.315|0.32] "rad"  GW
 SG_ ARS_RDI_SNR_Clu_206 : 414|7@0+ (0.5,0) [0|63.5] "dB"  GW
 SG_ ARS_RDI_DynProp_Clu_206 : 423|2@0+ (1,0) [0|3] ""  GW
 SG_ ARS_RDI_Quality_Clu_206 : 421|2@0+ (1,0) [0|3] ""  GW
 SG_ ARS_RDI_DynProp_Clu_207 : 419|2@0+ (1,0) [0|3] ""  GW
 SG_ ARS_RDI_Quality_Clu_207 : 417|2@0+ (1,0) [0|3] ""  GW
 SG_ ARS_RDI_Range_Clu_207 : 431|12@0+ (0.0625,0) [0|255.9375] "m"  GW
 SG_ ARS_RDI_ElevationAng_Clu_200 : 45|7@0+ (0.005,-0.315) [-0.315|0.32] "rad"  GW
 SG_ ARS_RDI_VradRel_Clu_207 : 435|11@0+ (0.1,-120) [-120|84.7] "m/s"  GW
 SG_ ARS_RDI_RCS_Clu_207 : 440|9@0+ (0.2,-51.2) [-51.2|51] "dBsm"  GW
 SG_ ARS_RDI_AzimuthAng_Clu_207 : 463|10@0+ (0.002,-1.022) [-1.022|1.024] "rad"  GW
 SG_ ARS_RDI_ElevationAng_Clu_207 : 469|7@0+ (0.005,-0.315) [-0.315|0.32] "rad"  GW
 SG_ ARS_RDI_SNR_Clu_207 : 478|7@0+ (0.5,0) [0|63.5] "dB"  GW
 SG_ ARS_RDI_MsgCounter_Clu_200_207 : 495|8@0+ (1,0) [0|255] ""  GW
 SG_ ARS_RDI_CRC16_Checksum_Clu_200_2 : 503|16@0+ (1,0) [0|65535] ""  GW
 SG_ ARS_RDI_SNR_Clu_200 : 54|7@0+ (0.5,0) [0|63.5] "dB"  GW
 SG_ ARS_RDI_DynProp_Clu_200 : 63|2@0+ (1,0) [0|3] ""  GW
 SG_ ARS_RDI_Quality_Clu_200 : 61|2@0+ (1,0) [0|3] ""  GW
 SG_ ARS_RDI_DynProp_Clu_201 : 59|2@0+ (1,0) [0|3] ""  GW
 SG_ ARS_RDI_Quality_Clu_201 : 57|2@0+ (1,0) [0|3] ""  GW
 SG_ ARS_RDI_Range_Clu_201 : 71|12@0+ (0.0625,0) [0|255.9375] "m"  GW
 SG_ ARS_RDI_VradRel_Clu_201 : 75|11@0+ (0.1,-120) [-120|84.7] "m/s"  GW
 SG_ ARS_RDI_RCS_Clu_201 : 80|9@0+ (0.2,-51.2) [-51.2|51] "dBsm"  GW
 SG_ ARS_RDI_AzimuthAng_Clu_201 : 103|10@0+ (0.002,-1.022) [-1.022|1.024] "rad"  GW

BO_ 286 ARS_RDI_208_215: 64 FR
 SG_ ARS_RDI_Range_Clu_208 : 7|12@0+ (0.0625,0) [0|255.9375] "m"  GW
 SG_ ARS_RDI_ElevationAng_Clu_209 : 109|7@0+ (0.005,-0.315) [-0.315|0.32] "rad"  GW
 SG_ ARS_RDI_SNR_Clu_209 : 118|7@0+ (0.5,0) [0|63.5] "dB"  GW
 SG_ ARS_RDI_Range_Clu_210 : 127|12@0+ (0.0625,0) [0|255.9375] "m"  GW
 SG_ ARS_RDI_VradRel_Clu_208 : 11|11@0+ (0.1,-120) [-120|84.7] "m/s"  GW
 SG_ ARS_RDI_VradRel_Clu_210 : 131|11@0+ (0.1,-120) [-120|84.7] "m/s"  GW
 SG_ ARS_RDI_RCS_Clu_210 : 136|9@0+ (0.2,-51.2) [-51.2|51] "dBsm"  GW
 SG_ ARS_RDI_AzimuthAng_Clu_210 : 159|10@0+ (0.002,-1.022) [-1.022|1.024] "rad"  GW
 SG_ ARS_RDI_ElevationAng_Clu_210 : 165|7@0+ (0.005,-0.315) [-0.315|0.32] "rad"  GW
 SG_ ARS_RDI_SNR_Clu_210 : 174|7@0+ (0.5,0) [0|63.5] "dB"  GW
 SG_ ARS_RDI_DynProp_Clu_210 : 183|2@0+ (1,0) [0|3] ""  GW
 SG_ ARS_RDI_Quality_Clu_210 : 181|2@0+ (1,0) [0|3] ""  GW
 SG_ ARS_RDI_DynProp_Clu_211 : 179|2@0+ (1,0) [0|3] ""  GW
 SG_ ARS_RDI_Quality_Clu_211 : 177|2@0+ (1,0) [0|3] ""  GW
 SG_ ARS_RDI_Range_Clu_211 : 191|12@0+ (0.0625,0) [0|255.9375] "m"  GW
 SG_ ARS_RDI_VradRel_Clu_211 : 195|11@0+ (0.1,-120) [-120|84.7] "m/s"  GW
 SG_ ARS_RDI_RCS_Clu_211 : 200|9@0+ (0.2,-51.2) [-51.2|51] "dBsm"  GW
 SG_ ARS_RDI_AzimuthAng_Clu_211 : 223|10@0+ (0.002,-1.022) [-1.022|1.024] "rad"  GW
 SG_ ARS_RDI_ElevationAng_Clu_211 : 229|7@0+ (0.005,-0.315) [-0.315|0.32] "rad"  GW
 SG_ ARS_RDI_SNR_Clu_211 : 238|7@0+ (0.5,0) [0|63.5] "dB"  GW
 SG_ ARS_RDI_RCS_Clu_208 : 16|9@0+ (0.2,-51.2) [-51.2|51] "dBsm"  GW
 SG_ ARS_RDI_Range_Clu_212 : 247|12@0+ (0.0625,0) [0|255.9375] "m"  GW
 SG_ ARS_RDI_VradRel_Clu_212 : 251|11@0+ (0.1,-120) [-120|84.7] "m/s"  GW
 SG_ ARS_RDI_RCS_Clu_212 : 256|9@0+ (0.2,-51.2) [-51.2|51] "dBsm"  GW
 SG_ ARS_RDI_AzimuthAng_Clu_212 : 279|10@0+ (0.002,-1.022) [-1.022|1.024] "rad"  GW
 SG_ ARS_RDI_ElevationAng_Clu_212 : 285|7@0+ (0.005,-0.315) [-0.315|0.32] "rad"  GW
 SG_ ARS_RDI_SNR_Clu_212 : 294|7@0+ (0.5,0) [0|63.5] "dB"  GW
 SG_ ARS_RDI_DynProp_Clu_212 : 303|2@0+ (1,0) [0|3] ""  GW
 SG_ ARS_RDI_Quality_Clu_212 : 301|2@0+ (1,0) [0|3] ""  GW
 SG_ ARS_RDI_DynProp_Clu_213 : 299|2@0+ (1,0) [0|3] ""  GW
 SG_ ARS_RDI_Quality_Clu_213 : 297|2@0+ (1,0) [0|3] ""  GW
 SG_ ARS_RDI_Range_Clu_213 : 311|12@0+ (0.0625,0) [0|255.9375] "m"  GW
 SG_ ARS_RDI_VradRel_Clu_213 : 315|11@0+ (0.1,-120) [-120|84.7] "m/s"  GW
 SG_ ARS_RDI_RCS_Clu_213 : 320|9@0+ (0.2,-51.2) [-51.2|51] "dBsm"  GW
 SG_ ARS_RDI_AzimuthAng_Clu_208 : 39|10@0+ (0.002,-1.022) [-1.022|1.024] "rad"  GW
 SG_ ARS_RDI_AzimuthAng_Clu_213 : 343|10@0+ (0.002,-1.022) [-1.022|1.024] "rad"  GW
 SG_ ARS_RDI_ElevationAng_Clu_213 : 349|7@0+ (0.005,-0.315) [-0.315|0.32] "rad"  GW
 SG_ ARS_RDI_SNR_Clu_213 : 358|7@0+ (0.5,0) [0|63.5] "dB"  GW
 SG_ ARS_RDI_Range_Clu_214 : 367|12@0+ (0.0625,0) [0|255.9375] "m"  GW
 SG_ ARS_RDI_VradRel_Clu_214 : 371|11@0+ (0.1,-120) [-120|84.7] "m/s"  GW
 SG_ ARS_RDI_RCS_Clu_214 : 376|9@0+ (0.2,-51.2) [-51.2|51] "dBsm"  GW
 SG_ ARS_RDI_AzimuthAng_Clu_214 : 399|10@0+ (0.002,-1.022) [-1.022|1.024] "rad"  GW
 SG_ ARS_RDI_ElevationAng_Clu_214 : 405|7@0+ (0.005,-0.315) [-0.315|0.32] "rad"  GW
 SG_ ARS_RDI_SNR_Clu_214 : 414|7@0+ (0.5,0) [0|63.5] "dB"  GW
 SG_ ARS_RDI_DynProp_Clu_214 : 423|2@0+ (1,0) [0|3] ""  GW
 SG_ ARS_RDI_Quality_Clu_214 : 421|2@0+ (1,0) [0|3] ""  GW
 SG_ ARS_RDI_DynProp_Clu_215 : 419|2@0+ (1,0) [0|3] ""  GW
 SG_ ARS_RDI_Quality_Clu_215 : 417|2@0+ (1,0) [0|3] ""  GW
 SG_ ARS_RDI_Range_Clu_215 : 431|12@0+ (0.0625,0) [0|255.9375] "m"  GW
 SG_ ARS_RDI_ElevationAng_Clu_208 : 45|7@0+ (0.005,-0.315) [-0.315|0.32] "rad"  GW
 SG_ ARS_RDI_VradRel_Clu_215 : 435|11@0+ (0.1,-120) [-120|84.7] "m/s"  GW
 SG_ ARS_RDI_RCS_Clu_215 : 440|9@0+ (0.2,-51.2) [-51.2|51] "dBsm"  GW
 SG_ ARS_RDI_AzimuthAng_Clu_215 : 463|10@0+ (0.002,-1.022) [-1.022|1.024] "rad"  GW
 SG_ ARS_RDI_ElevationAng_Clu_215 : 469|7@0+ (0.005,-0.315) [-0.315|0.32] "rad"  GW
 SG_ ARS_RDI_SNR_Clu_215 : 478|7@0+ (0.5,0) [0|63.5] "dB"  GW
 SG_ ARS_RDI_MsgCounter_Clu_208_215 : 495|8@0+ (1,0) [0|255] ""  GW
 SG_ ARS_RDI_CRC16_Checksum_Clu_208_2 : 503|16@0+ (1,0) [0|65535] ""  GW
 SG_ ARS_RDI_SNR_Clu_208 : 54|7@0+ (0.5,0) [0|63.5] "dB"  GW
 SG_ ARS_RDI_DynProp_Clu_208 : 63|2@0+ (1,0) [0|3] ""  GW
 SG_ ARS_RDI_Quality_Clu_208 : 61|2@0+ (1,0) [0|3] ""  GW
 SG_ ARS_RDI_DynProp_Clu_209 : 59|2@0+ (1,0) [0|3] ""  GW
 SG_ ARS_RDI_Quality_Clu_209 : 57|2@0+ (1,0) [0|3] ""  GW
 SG_ ARS_RDI_Range_Clu_209 : 71|12@0+ (0.0625,0) [0|255.9375] "m"  GW
 SG_ ARS_RDI_VradRel_Clu_209 : 75|11@0+ (0.1,-120) [-120|84.7] "m/s"  GW
 SG_ ARS_RDI_RCS_Clu_209 : 80|9@0+ (0.2,-51.2) [-51.2|51] "dBsm"  GW
 SG_ ARS_RDI_AzimuthAng_Clu_209 : 103|10@0+ (0.002,-1.022) [-1.022|1.024] "rad"  GW

BO_ 287 ARS_RDI_216_223: 64 FR
 SG_ ARS_RDI_Range_Clu_216 : 7|12@0+ (0.0625,0) [0|255.9375] "m"  GW
 SG_ ARS_RDI_ElevationAng_Clu_217 : 109|7@0+ (0.005,-0.315) [-0.315|0.32] "rad"  GW
 SG_ ARS_RDI_SNR_Clu_217 : 118|7@0+ (0.5,0) [0|63.5] "dB"  GW
 SG_ ARS_RDI_Range_Clu_218 : 127|12@0+ (0.0625,0) [0|255.9375] "m"  GW
 SG_ ARS_RDI_VradRel_Clu_216 : 11|11@0+ (0.1,-120) [-120|84.7] "m/s"  GW
 SG_ ARS_RDI_VradRel_Clu_218 : 131|11@0+ (0.1,-120) [-120|84.7] "m/s"  GW
 SG_ ARS_RDI_RCS_Clu_218 : 136|9@0+ (0.2,-51.2) [-51.2|51] "dBsm"  GW
 SG_ ARS_RDI_AzimuthAng_Clu_218 : 159|10@0+ (0.002,-1.022) [-1.022|1.024] "rad"  GW
 SG_ ARS_RDI_ElevationAng_Clu_218 : 165|7@0+ (0.005,-0.315) [-0.315|0.32] "rad"  GW
 SG_ ARS_RDI_SNR_Clu_218 : 174|7@0+ (0.5,0) [0|63.5] "dB"  GW
 SG_ ARS_RDI_DynProp_Clu_218 : 183|2@0+ (1,0) [0|3] ""  GW
 SG_ ARS_RDI_Quality_Clu_218 : 181|2@0+ (1,0) [0|3] ""  GW
 SG_ ARS_RDI_DynProp_Clu_219 : 179|2@0+ (1,0) [0|3] ""  GW
 SG_ ARS_RDI_Quality_Clu_219 : 177|2@0+ (1,0) [0|3] ""  GW
 SG_ ARS_RDI_Range_Clu_219 : 191|12@0+ (0.0625,0) [0|255.9375] "m"  GW
 SG_ ARS_RDI_VradRel_Clu_219 : 195|11@0+ (0.1,-120) [-120|84.7] "m/s"  GW
 SG_ ARS_RDI_RCS_Clu_219 : 200|9@0+ (0.2,-51.2) [-51.2|51] "dBsm"  GW
 SG_ ARS_RDI_AzimuthAng_Clu_219 : 223|10@0+ (0.002,-1.022) [-1.022|1.024] "rad"  GW
 SG_ ARS_RDI_ElevationAng_Clu_219 : 229|7@0+ (0.005,-0.315) [-0.315|0.32] "rad"  GW
 SG_ ARS_RDI_SNR_Clu_219 : 238|7@0+ (0.5,0) [0|63.5] "dB"  GW
 SG_ ARS_RDI_RCS_Clu_216 : 16|9@0+ (0.2,-51.2) [-51.2|51] "dBsm"  GW
 SG_ ARS_RDI_Range_Clu_220 : 247|12@0+ (0.0625,0) [0|255.9375] "m"  GW
 SG_ ARS_RDI_VradRel_Clu_220 : 251|11@0+ (0.1,-120) [-120|84.7] "m/s"  GW
 SG_ ARS_RDI_RCS_Clu_220 : 256|9@0+ (0.2,-51.2) [-51.2|51] "dBsm"  GW
 SG_ ARS_RDI_AzimuthAng_Clu_220 : 279|10@0+ (0.002,-1.022) [-1.022|1.024] "rad"  GW
 SG_ ARS_RDI_ElevationAng_Clu_220 : 285|7@0+ (0.005,-0.315) [-0.315|0.32] "rad"  GW
 SG_ ARS_RDI_SNR_Clu_220 : 294|7@0+ (0.5,0) [0|63.5] "dB"  GW
 SG_ ARS_RDI_DynProp_Clu_220 : 303|2@0+ (1,0) [0|3] ""  GW
 SG_ ARS_RDI_Quality_Clu_220 : 301|2@0+ (1,0) [0|3] ""  GW
 SG_ ARS_RDI_DynProp_Clu_221 : 299|2@0+ (1,0) [0|3] ""  GW
 SG_ ARS_RDI_Quality_Clu_221 : 297|2@0+ (1,0) [0|3] ""  GW
 SG_ ARS_RDI_Range_Clu_221 : 311|12@0+ (0.0625,0) [0|255.9375] "m"  GW
 SG_ ARS_RDI_VradRel_Clu_221 : 315|11@0+ (0.1,-120) [-120|84.7] "m/s"  GW
 SG_ ARS_RDI_RCS_Clu_221 : 320|9@0+ (0.2,-51.2) [-51.2|51] "dBsm"  GW
 SG_ ARS_RDI_AzimuthAng_Clu_216 : 39|10@0+ (0.002,-1.022) [-1.022|1.024] "rad"  GW
 SG_ ARS_RDI_AzimuthAng_Clu_221 : 343|10@0+ (0.002,-1.022) [-1.022|1.024] "rad"  GW
 SG_ ARS_RDI_ElevationAng_Clu_221 : 349|7@0+ (0.005,-0.315) [-0.315|0.32] "rad"  GW
 SG_ ARS_RDI_SNR_Clu_221 : 358|7@0+ (0.5,0) [0|63.5] "dB"  GW
 SG_ ARS_RDI_Range_Clu_222 : 367|12@0+ (0.0625,0) [0|255.9375] "m"  GW
 SG_ ARS_RDI_VradRel_Clu_222 : 371|11@0+ (0.1,-120) [-120|84.7] "m/s"  GW
 SG_ ARS_RDI_RCS_Clu_222 : 376|9@0+ (0.2,-51.2) [-51.2|51] "dBsm"  GW
 SG_ ARS_RDI_AzimuthAng_Clu_222 : 399|10@0+ (0.002,-1.022) [-1.022|1.024] "rad"  GW
 SG_ ARS_RDI_ElevationAng_Clu_222 : 405|7@0+ (0.005,-0.315) [-0.315|0.32] "rad"  GW
 SG_ ARS_RDI_SNR_Clu_222 : 414|7@0+ (0.5,0) [0|63.5] "dB"  GW
 SG_ ARS_RDI_DynProp_Clu_222 : 423|2@0+ (1,0) [0|3] ""  GW
 SG_ ARS_RDI_Quality_Clu_222 : 421|2@0+ (1,0) [0|3] ""  GW
 SG_ ARS_RDI_DynProp_Clu_223 : 419|2@0+ (1,0) [0|3] ""  GW
 SG_ ARS_RDI_Quality_Clu_223 : 417|2@0+ (1,0) [0|3] ""  GW
 SG_ ARS_RDI_Range_Clu_223 : 431|12@0+ (0.0625,0) [0|255.9375] "m"  GW
 SG_ ARS_RDI_ElevationAng_Clu_216 : 45|7@0+ (0.005,-0.315) [-0.315|0.32] "rad"  GW
 SG_ ARS_RDI_VradRel_Clu_223 : 435|11@0+ (0.1,-120) [-120|84.7] "m/s"  GW
 SG_ ARS_RDI_RCS_Clu_223 : 440|9@0+ (0.2,-51.2) [-51.2|51] "dBsm"  GW
 SG_ ARS_RDI_AzimuthAng_Clu_223 : 463|10@0+ (0.002,-1.022) [-1.022|1.024] "rad"  GW
 SG_ ARS_RDI_ElevationAng_Clu_223 : 469|7@0+ (0.005,-0.315) [-0.315|0.32] "rad"  GW
 SG_ ARS_RDI_SNR_Clu_223 : 478|7@0+ (0.5,0) [0|63.5] "dB"  GW
 SG_ ARS_RDI_MsgCounter_Clu_216_223 : 495|8@0+ (1,0) [0|255] ""  GW
 SG_ ARS_RDI_CRC16_Checksum_Clu_216_2 : 503|16@0+ (1,0) [0|65535] ""  GW
 SG_ ARS_RDI_SNR_Clu_216 : 54|7@0+ (0.5,0) [0|63.5] "dB"  GW
 SG_ ARS_RDI_DynProp_Clu_216 : 63|2@0+ (1,0) [0|3] ""  GW
 SG_ ARS_RDI_Quality_Clu_216 : 61|2@0+ (1,0) [0|3] ""  GW
 SG_ ARS_RDI_DynProp_Clu_217 : 59|2@0+ (1,0) [0|3] ""  GW
 SG_ ARS_RDI_Quality_Clu_217 : 57|2@0+ (1,0) [0|3] ""  GW
 SG_ ARS_RDI_Range_Clu_217 : 71|12@0+ (0.0625,0) [0|255.9375] "m"  GW
 SG_ ARS_RDI_VradRel_Clu_217 : 75|11@0+ (0.1,-120) [-120|84.7] "m/s"  GW
 SG_ ARS_RDI_RCS_Clu_217 : 80|9@0+ (0.2,-51.2) [-51.2|51] "dBsm"  GW
 SG_ ARS_RDI_AzimuthAng_Clu_217 : 103|10@0+ (0.002,-1.022) [-1.022|1.024] "rad"  GW

CM_ SG_ 282 ARS_RDI_Obj_ID_Clu_000 "Object ID that cluster_000 has been associated to in current cycle
000??????????????ID";
BA_DEF_ BO_  "DiagRequest" ENUM  "no","yes";
BA_DEF_ BO_  "DiagResponse" ENUM  "no","yes";
BA_DEF_ BO_  "GenMsgCycleTime" INT 0 0;
BA_DEF_ BO_  "GenMsgSendType" ENUM  "Cyclic","NotUsed","Event","NotUsed","NotUsed","NotUsed","NotUsed","IfActive","NoMsgSendType","NotUsed";
BA_DEF_ BO_  "VFrameFormat" ENUM  "StandardCAN","ExtendedCAN","RESERVED","RESERVED","RESERVED","RESERVED","RESERVED","RESERVED","RESERVED","RESERVED","RESERVED","RESERVED","RESERVED","RESERVED","StandardCAN_FD","ExtendedCAN_FD";
BA_DEF_ SG_  "GenSigSendType" ENUM  "Cyclic","OnWrite","OnWriteWithRepetition","OnChange","OnChangeWithRepetition","IfActive","IfActiveWithRepetition","NoSigSendType","NotUsed","NotUsed","NotUsed","NotUsed","NotUsed";
BA_DEF_ SG_  "GenSigStartValue" INT 0 0;
BA_DEF_ SG_  "SystemSignalLongSymbol" STRING ;
BA_DEF_DEF_  "DiagRequest" "no";
BA_DEF_DEF_  "DiagResponse" "no";
BA_DEF_DEF_  "GenMsgCycleTime" 0;
BA_DEF_DEF_  "GenMsgSendType" "Cyclic";
BA_DEF_DEF_  "VFrameFormat" "ExtendedCAN_FD";
BA_DEF_DEF_  "GenSigSendType" "Cyclic";
BA_DEF_DEF_  "GenSigStartValue" 0;
BA_DEF_DEF_  "SystemSignalLongSymbol" "";
BA_ "GenMsgSendType" BO_ 273 2;
BA_ "VFrameFormat" BO_ 273 14;
BA_ "GenMsgSendType" BO_ 274 2;
BA_ "VFrameFormat" BO_ 274 14;
BA_ "GenMsgSendType" BO_ 275 2;
BA_ "VFrameFormat" BO_ 275 14;
BA_ "GenMsgSendType" BO_ 276 2;
BA_ "VFrameFormat" BO_ 276 14;
BA_ "GenMsgSendType" BO_ 277 2;
BA_ "VFrameFormat" BO_ 277 14;
BA_ "GenMsgSendType" BO_ 278 2;
BA_ "VFrameFormat" BO_ 278 14;
BA_ "GenMsgSendType" BO_ 279 2;
BA_ "VFrameFormat" BO_ 279 14;
BA_ "GenMsgSendType" BO_ 280 2;
BA_ "VFrameFormat" BO_ 280 14;
BA_ "GenMsgSendType" BO_ 281 2;
BA_ "VFrameFormat" BO_ 281 14;
BA_ "GenMsgSendType" BO_ 282 2;
BA_ "VFrameFormat" BO_ 282 14;
BA_ "GenMsgSendType" BO_ 283 2;
BA_ "VFrameFormat" BO_ 283 14;
BA_ "GenMsgSendType" BO_ 284 2;
BA_ "VFrameFormat" BO_ 284 14;
BA_ "GenMsgSendType" BO_ 285 2;
BA_ "VFrameFormat" BO_ 285 14;
BA_ "GenMsgSendType" BO_ 286 2;
BA_ "VFrameFormat" BO_ 286 14;
BA_ "GenMsgSendType" BO_ 287 2;
BA_ "VFrameFormat" BO_ 287 14;
BA_ "GenSigStartValue" SG_ 273 ARS_RDI_ElevationAng_Clu_129 63;
BA_ "GenSigStartValue" SG_ 273 ARS_RDI_VradRel_Clu_128 1200;
BA_ "GenSigStartValue" SG_ 273 ARS_RDI_VradRel_Clu_130 1200;
BA_ "GenSigStartValue" SG_ 273 ARS_RDI_RCS_Clu_130 256;
BA_ "GenSigStartValue" SG_ 273 ARS_RDI_AzimuthAng_Clu_130 511;
BA_ "GenSigStartValue" SG_ 273 ARS_RDI_ElevationAng_Clu_130 63;
BA_ "GenSigStartValue" SG_ 273 ARS_RDI_VradRel_Clu_131 1200;
BA_ "GenSigStartValue" SG_ 273 ARS_RDI_RCS_Clu_131 256;
BA_ "GenSigStartValue" SG_ 273 ARS_RDI_AzimuthAng_Clu_131 511;
BA_ "GenSigStartValue" SG_ 273 ARS_RDI_ElevationAng_Clu_131 63;
BA_ "GenSigStartValue" SG_ 273 ARS_RDI_RCS_Clu_128 256;
BA_ "GenSigStartValue" SG_ 273 ARS_RDI_VradRel_Clu_132 1200;
BA_ "GenSigStartValue" SG_ 273 ARS_RDI_RCS_Clu_132 256;
BA_ "GenSigStartValue" SG_ 273 ARS_RDI_AzimuthAng_Clu_132 511;
BA_ "GenSigStartValue" SG_ 273 ARS_RDI_ElevationAng_Clu_132 63;
BA_ "GenSigStartValue" SG_ 273 ARS_RDI_VradRel_Clu_133 1200;
BA_ "GenSigStartValue" SG_ 273 ARS_RDI_RCS_Clu_133 256;
BA_ "GenSigStartValue" SG_ 273 ARS_RDI_AzimuthAng_Clu_128 511;
BA_ "GenSigStartValue" SG_ 273 ARS_RDI_AzimuthAng_Clu_133 511;
BA_ "GenSigStartValue" SG_ 273 ARS_RDI_ElevationAng_Clu_133 63;
BA_ "GenSigStartValue" SG_ 273 ARS_RDI_VradRel_Clu_134 1200;
BA_ "GenSigStartValue" SG_ 273 ARS_RDI_RCS_Clu_134 256;
BA_ "GenSigStartValue" SG_ 273 ARS_RDI_AzimuthAng_Clu_134 511;
BA_ "GenSigStartValue" SG_ 273 ARS_RDI_ElevationAng_Clu_134 63;
BA_ "GenSigStartValue" SG_ 273 ARS_RDI_ElevationAng_Clu_128 63;
BA_ "GenSigStartValue" SG_ 273 ARS_RDI_VradRel_Clu_135 1200;
BA_ "GenSigStartValue" SG_ 273 ARS_RDI_RCS_Clu_135 256;
BA_ "GenSigStartValue" SG_ 273 ARS_RDI_AzimuthAng_Clu_135 511;
BA_ "GenSigStartValue" SG_ 273 ARS_RDI_ElevationAng_Clu_135 63;
BA_ "SystemSignalLongSymbol" SG_ 273 ARS_RDI_CRC16_Checksum_Clu_128_1 "ARS_RDI_CRC16_Checksum_Clu_128_135";
BA_ "GenSigStartValue" SG_ 273 ARS_RDI_VradRel_Clu_129 1200;
BA_ "GenSigStartValue" SG_ 273 ARS_RDI_RCS_Clu_129 256;
BA_ "GenSigStartValue" SG_ 273 ARS_RDI_AzimuthAng_Clu_129 511;
BA_ "GenSigStartValue" SG_ 274 ARS_RDI_ElevationAng_Clu_137 63;
BA_ "GenSigStartValue" SG_ 274 ARS_RDI_VradRel_Clu_136 1200;
BA_ "GenSigStartValue" SG_ 274 ARS_RDI_VradRel_Clu_138 1200;
BA_ "GenSigStartValue" SG_ 274 ARS_RDI_RCS_Clu_138 256;
BA_ "GenSigStartValue" SG_ 274 ARS_RDI_AzimuthAng_Clu_138 511;
BA_ "GenSigStartValue" SG_ 274 ARS_RDI_ElevationAng_Clu_138 63;
BA_ "GenSigStartValue" SG_ 274 ARS_RDI_VradRel_Clu_139 1200;
BA_ "GenSigStartValue" SG_ 274 ARS_RDI_RCS_Clu_139 256;
BA_ "GenSigStartValue" SG_ 274 ARS_RDI_AzimuthAng_Clu_139 511;
BA_ "GenSigStartValue" SG_ 274 ARS_RDI_ElevationAng_Clu_139 63;
BA_ "GenSigStartValue" SG_ 274 ARS_RDI_RCS_Clu_136 256;
BA_ "GenSigStartValue" SG_ 274 ARS_RDI_VradRel_Clu_140 1200;
BA_ "GenSigStartValue" SG_ 274 ARS_RDI_RCS_Clu_140 256;
BA_ "GenSigStartValue" SG_ 274 ARS_RDI_AzimuthAng_Clu_140 511;
BA_ "GenSigStartValue" SG_ 274 ARS_RDI_ElevationAng_Clu_140 63;
BA_ "GenSigStartValue" SG_ 274 ARS_RDI_VradRel_Clu_141 1200;
BA_ "GenSigStartValue" SG_ 274 ARS_RDI_RCS_Clu_141 256;
BA_ "GenSigStartValue" SG_ 274 ARS_RDI_AzimuthAng_Clu_136 511;
BA_ "GenSigStartValue" SG_ 274 ARS_RDI_AzimuthAng_Clu_141 511;
BA_ "GenSigStartValue" SG_ 274 ARS_RDI_ElevationAng_Clu_141 63;
BA_ "GenSigStartValue" SG_ 274 ARS_RDI_VradRel_Clu_142 1200;
BA_ "GenSigStartValue" SG_ 274 ARS_RDI_RCS_Clu_142 256;
BA_ "GenSigStartValue" SG_ 274 ARS_RDI_AzimuthAng_Clu_142 511;
BA_ "GenSigStartValue" SG_ 274 ARS_RDI_ElevationAng_Clu_142 63;
BA_ "GenSigStartValue" SG_ 274 ARS_RDI_ElevationAng_Clu_136 63;
BA_ "GenSigStartValue" SG_ 274 ARS_RDI_VradRel_Clu_143 1200;
BA_ "GenSigStartValue" SG_ 274 ARS_RDI_RCS_Clu_143 256;
BA_ "GenSigStartValue" SG_ 274 ARS_RDI_AzimuthAng_Clu_143 511;
BA_ "GenSigStartValue" SG_ 274 ARS_RDI_ElevationAng_Clu_143 63;
BA_ "SystemSignalLongSymbol" SG_ 274 ARS_RDI_CRC16_Checksum_Clu_136_1 "ARS_RDI_CRC16_Checksum_Clu_136_143";
BA_ "GenSigStartValue" SG_ 274 ARS_RDI_VradRel_Clu_137 1200;
BA_ "GenSigStartValue" SG_ 274 ARS_RDI_RCS_Clu_137 256;
BA_ "GenSigStartValue" SG_ 274 ARS_RDI_AzimuthAng_Clu_137 511;
BA_ "GenSigStartValue" SG_ 275 ARS_RDI_ElevationAng_Clu_145 63;
BA_ "GenSigStartValue" SG_ 275 ARS_RDI_VradRel_Clu_144 1200;
BA_ "GenSigStartValue" SG_ 275 ARS_RDI_VradRel_Clu_146 1200;
BA_ "GenSigStartValue" SG_ 275 ARS_RDI_RCS_Clu_146 256;
BA_ "GenSigStartValue" SG_ 275 ARS_RDI_AzimuthAng_Clu_146 511;
BA_ "GenSigStartValue" SG_ 275 ARS_RDI_ElevationAng_Clu_146 63;
BA_ "GenSigStartValue" SG_ 275 ARS_RDI_VradRel_Clu_147 1200;
BA_ "GenSigStartValue" SG_ 275 ARS_RDI_RCS_Clu_147 256;
BA_ "GenSigStartValue" SG_ 275 ARS_RDI_AzimuthAng_Clu_147 511;
BA_ "GenSigStartValue" SG_ 275 ARS_RDI_ElevationAng_Clu_147 63;
BA_ "GenSigStartValue" SG_ 275 ARS_RDI_RCS_Clu_144 256;
BA_ "GenSigStartValue" SG_ 275 ARS_RDI_VradRel_Clu_148 1200;
BA_ "GenSigStartValue" SG_ 275 ARS_RDI_RCS_Clu_148 256;
BA_ "GenSigStartValue" SG_ 275 ARS_RDI_AzimuthAng_Clu_148 511;
BA_ "GenSigStartValue" SG_ 275 ARS_RDI_ElevationAng_Clu_148 63;
BA_ "GenSigStartValue" SG_ 275 ARS_RDI_VradRel_Clu_149 1200;
BA_ "GenSigStartValue" SG_ 275 ARS_RDI_RCS_Clu_149 256;
BA_ "GenSigStartValue" SG_ 275 ARS_RDI_AzimuthAng_Clu_144 511;
BA_ "GenSigStartValue" SG_ 275 ARS_RDI_AzimuthAng_Clu_149 511;
BA_ "GenSigStartValue" SG_ 275 ARS_RDI_ElevationAng_Clu_149 63;
BA_ "GenSigStartValue" SG_ 275 ARS_RDI_VradRel_Clu_150 1200;
BA_ "GenSigStartValue" SG_ 275 ARS_RDI_RCS_Clu_150 256;
BA_ "GenSigStartValue" SG_ 275 ARS_RDI_AzimuthAng_Clu_150 511;
BA_ "GenSigStartValue" SG_ 275 ARS_RDI_ElevationAng_Clu_150 63;
BA_ "GenSigStartValue" SG_ 275 ARS_RDI_ElevationAng_Clu_144 63;
BA_ "GenSigStartValue" SG_ 275 ARS_RDI_VradRel_Clu_151 1200;
BA_ "GenSigStartValue" SG_ 275 ARS_RDI_RCS_Clu_151 256;
BA_ "GenSigStartValue" SG_ 275 ARS_RDI_AzimuthAng_Clu_151 511;
BA_ "GenSigStartValue" SG_ 275 ARS_RDI_ElevationAng_Clu_151 63;
BA_ "SystemSignalLongSymbol" SG_ 275 ARS_RDI_CRC16_Checksum_Clu_144_1 "ARS_RDI_CRC16_Checksum_Clu_144_151";
BA_ "GenSigStartValue" SG_ 275 ARS_RDI_VradRel_Clu_145 1200;
BA_ "GenSigStartValue" SG_ 275 ARS_RDI_RCS_Clu_145 256;
BA_ "GenSigStartValue" SG_ 275 ARS_RDI_AzimuthAng_Clu_145 511;
BA_ "GenSigStartValue" SG_ 276 ARS_RDI_ElevationAng_Clu_153 63;
BA_ "GenSigStartValue" SG_ 276 ARS_RDI_VradRel_Clu_152 1200;
BA_ "GenSigStartValue" SG_ 276 ARS_RDI_VradRel_Clu_154 1200;
BA_ "GenSigStartValue" SG_ 276 ARS_RDI_RCS_Clu_154 256;
BA_ "GenSigStartValue" SG_ 276 ARS_RDI_AzimuthAng_Clu_154 511;
BA_ "GenSigStartValue" SG_ 276 ARS_RDI_ElevationAng_Clu_154 63;
BA_ "GenSigStartValue" SG_ 276 ARS_RDI_VradRel_Clu_155 1200;
BA_ "GenSigStartValue" SG_ 276 ARS_RDI_RCS_Clu_155 256;
BA_ "GenSigStartValue" SG_ 276 ARS_RDI_AzimuthAng_Clu_155 511;
BA_ "GenSigStartValue" SG_ 276 ARS_RDI_ElevationAng_Clu_155 63;
BA_ "GenSigStartValue" SG_ 276 ARS_RDI_RCS_Clu_152 256;
BA_ "GenSigStartValue" SG_ 276 ARS_RDI_VradRel_Clu_156 1200;
BA_ "GenSigStartValue" SG_ 276 ARS_RDI_RCS_Clu_156 256;
BA_ "GenSigStartValue" SG_ 276 ARS_RDI_AzimuthAng_Clu_156 511;
BA_ "GenSigStartValue" SG_ 276 ARS_RDI_ElevationAng_Clu_156 63;
BA_ "GenSigStartValue" SG_ 276 ARS_RDI_VradRel_Clu_157 1200;
BA_ "GenSigStartValue" SG_ 276 ARS_RDI_RCS_Clu_157 256;
BA_ "GenSigStartValue" SG_ 276 ARS_RDI_AzimuthAng_Clu_152 511;
BA_ "GenSigStartValue" SG_ 276 ARS_RDI_AzimuthAng_Clu_157 511;
BA_ "GenSigStartValue" SG_ 276 ARS_RDI_ElevationAng_Clu_157 63;
BA_ "GenSigStartValue" SG_ 276 ARS_RDI_VradRel_Clu_158 1200;
BA_ "GenSigStartValue" SG_ 276 ARS_RDI_RCS_Clu_158 256;
BA_ "GenSigStartValue" SG_ 276 ARS_RDI_AzimuthAng_Clu_158 511;
BA_ "GenSigStartValue" SG_ 276 ARS_RDI_ElevationAng_Clu_158 63;
BA_ "GenSigStartValue" SG_ 276 ARS_RDI_ElevationAng_Clu_152 63;
BA_ "GenSigStartValue" SG_ 276 ARS_RDI_VradRel_Clu_159 1200;
BA_ "GenSigStartValue" SG_ 276 ARS_RDI_RCS_Clu_159 256;
BA_ "GenSigStartValue" SG_ 276 ARS_RDI_AzimuthAng_Clu_159 511;
BA_ "GenSigStartValue" SG_ 276 ARS_RDI_ElevationAng_Clu_159 63;
BA_ "SystemSignalLongSymbol" SG_ 276 ARS_RDI_CRC16_Checksum_Clu_152_1 "ARS_RDI_CRC16_Checksum_Clu_152_159";
BA_ "GenSigStartValue" SG_ 276 ARS_RDI_VradRel_Clu_153 1200;
BA_ "GenSigStartValue" SG_ 276 ARS_RDI_RCS_Clu_153 256;
BA_ "GenSigStartValue" SG_ 276 ARS_RDI_AzimuthAng_Clu_153 511;
BA_ "GenSigStartValue" SG_ 277 ARS_RDI_ElevationAng_Clu_161 63;
BA_ "GenSigStartValue" SG_ 277 ARS_RDI_VradRel_Clu_160 1200;
BA_ "GenSigStartValue" SG_ 277 ARS_RDI_VradRel_Clu_162 1200;
BA_ "GenSigStartValue" SG_ 277 ARS_RDI_RCS_Clu_162 256;
BA_ "GenSigStartValue" SG_ 277 ARS_RDI_AzimuthAng_Clu_162 511;
BA_ "GenSigStartValue" SG_ 277 ARS_RDI_ElevationAng_Clu_162 63;
BA_ "GenSigStartValue" SG_ 277 ARS_RDI_VradRel_Clu_163 1200;
BA_ "GenSigStartValue" SG_ 277 ARS_RDI_RCS_Clu_163 256;
BA_ "GenSigStartValue" SG_ 277 ARS_RDI_AzimuthAng_Clu_163 511;
BA_ "GenSigStartValue" SG_ 277 ARS_RDI_ElevationAng_Clu_163 63;
BA_ "GenSigStartValue" SG_ 277 ARS_RDI_RCS_Clu_160 256;
BA_ "GenSigStartValue" SG_ 277 ARS_RDI_VradRel_Clu_164 1200;
BA_ "GenSigStartValue" SG_ 277 ARS_RDI_RCS_Clu_164 256;
BA_ "GenSigStartValue" SG_ 277 ARS_RDI_AzimuthAng_Clu_164 511;
BA_ "GenSigStartValue" SG_ 277 ARS_RDI_ElevationAng_Clu_164 63;
BA_ "GenSigStartValue" SG_ 277 ARS_RDI_VradRel_Clu_165 1200;
BA_ "GenSigStartValue" SG_ 277 ARS_RDI_RCS_Clu_165 256;
BA_ "GenSigStartValue" SG_ 277 ARS_RDI_AzimuthAng_Clu_160 511;
BA_ "GenSigStartValue" SG_ 277 ARS_RDI_AzimuthAng_Clu_165 511;
BA_ "GenSigStartValue" SG_ 277 ARS_RDI_ElevationAng_Clu_165 63;
BA_ "GenSigStartValue" SG_ 277 ARS_RDI_VradRel_Clu_166 1200;
BA_ "GenSigStartValue" SG_ 277 ARS_RDI_RCS_Clu_166 256;
BA_ "GenSigStartValue" SG_ 277 ARS_RDI_AzimuthAng_Clu_166 511;
BA_ "GenSigStartValue" SG_ 277 ARS_RDI_ElevationAng_Clu_166 63;
BA_ "GenSigStartValue" SG_ 277 ARS_RDI_ElevationAng_Clu_160 63;
BA_ "GenSigStartValue" SG_ 277 ARS_RDI_VradRel_Clu_167 1200;
BA_ "GenSigStartValue" SG_ 277 ARS_RDI_RCS_Clu_167 256;
BA_ "GenSigStartValue" SG_ 277 ARS_RDI_AzimuthAng_Clu_167 511;
BA_ "GenSigStartValue" SG_ 277 ARS_RDI_ElevationAng_Clu_167 63;
BA_ "SystemSignalLongSymbol" SG_ 277 ARS_RDI_CRC16_Checksum_Clu_160_1 "ARS_RDI_CRC16_Checksum_Clu_160_167";
BA_ "GenSigStartValue" SG_ 277 ARS_RDI_VradRel_Clu_161 1200;
BA_ "GenSigStartValue" SG_ 277 ARS_RDI_RCS_Clu_161 256;
BA_ "GenSigStartValue" SG_ 277 ARS_RDI_AzimuthAng_Clu_161 511;
BA_ "GenSigStartValue" SG_ 278 ARS_RDI_ElevationAng_Clu_169 63;
BA_ "GenSigStartValue" SG_ 278 ARS_RDI_VradRel_Clu_168 1200;
BA_ "GenSigStartValue" SG_ 278 ARS_RDI_VradRel_Clu_170 1200;
BA_ "GenSigStartValue" SG_ 278 ARS_RDI_RCS_Clu_170 256;
BA_ "GenSigStartValue" SG_ 278 ARS_RDI_AzimuthAng_Clu_170 511;
BA_ "GenSigStartValue" SG_ 278 ARS_RDI_ElevationAng_Clu_170 63;
BA_ "GenSigStartValue" SG_ 278 ARS_RDI_VradRel_Clu_171 1200;
BA_ "GenSigStartValue" SG_ 278 ARS_RDI_RCS_Clu_171 256;
BA_ "GenSigStartValue" SG_ 278 ARS_RDI_AzimuthAng_Clu_171 511;
BA_ "GenSigStartValue" SG_ 278 ARS_RDI_ElevationAng_Clu_171 63;
BA_ "GenSigStartValue" SG_ 278 ARS_RDI_RCS_Clu_168 256;
BA_ "GenSigStartValue" SG_ 278 ARS_RDI_VradRel_Clu_172 1200;
BA_ "GenSigStartValue" SG_ 278 ARS_RDI_RCS_Clu_172 256;
BA_ "GenSigStartValue" SG_ 278 ARS_RDI_AzimuthAng_Clu_172 511;
BA_ "GenSigStartValue" SG_ 278 ARS_RDI_ElevationAng_Clu_172 63;
BA_ "GenSigStartValue" SG_ 278 ARS_RDI_VradRel_Clu_173 1200;
BA_ "GenSigStartValue" SG_ 278 ARS_RDI_RCS_Clu_173 256;
BA_ "GenSigStartValue" SG_ 278 ARS_RDI_AzimuthAng_Clu_168 511;
BA_ "GenSigStartValue" SG_ 278 ARS_RDI_AzimuthAng_Clu_173 511;
BA_ "GenSigStartValue" SG_ 278 ARS_RDI_ElevationAng_Clu_173 63;
BA_ "GenSigStartValue" SG_ 278 ARS_RDI_VradRel_Clu_174 1200;
BA_ "GenSigStartValue" SG_ 278 ARS_RDI_RCS_Clu_174 256;
BA_ "GenSigStartValue" SG_ 278 ARS_RDI_AzimuthAng_Clu_174 511;
BA_ "GenSigStartValue" SG_ 278 ARS_RDI_ElevationAng_Clu_174 63;
BA_ "GenSigStartValue" SG_ 278 ARS_RDI_ElevationAng_Clu_168 63;
BA_ "GenSigStartValue" SG_ 278 ARS_RDI_VradRel_Clu_175 1200;
BA_ "GenSigStartValue" SG_ 278 ARS_RDI_RCS_Clu_175 256;
BA_ "GenSigStartValue" SG_ 278 ARS_RDI_AzimuthAng_Clu_175 511;
BA_ "GenSigStartValue" SG_ 278 ARS_RDI_ElevationAng_Clu_175 63;
BA_ "SystemSignalLongSymbol" SG_ 278 ARS_RDI_CRC16_Checksum_Clu_168_1 "ARS_RDI_CRC16_Checksum_Clu_168_175";
BA_ "GenSigStartValue" SG_ 278 ARS_RDI_VradRel_Clu_169 1200;
BA_ "GenSigStartValue" SG_ 278 ARS_RDI_RCS_Clu_169 256;
BA_ "GenSigStartValue" SG_ 278 ARS_RDI_AzimuthAng_Clu_169 511;
BA_ "GenSigStartValue" SG_ 279 ARS_RDI_ElevationAng_Clu_177 63;
BA_ "GenSigStartValue" SG_ 279 ARS_RDI_VradRel_Clu_176 1200;
BA_ "GenSigStartValue" SG_ 279 ARS_RDI_VradRel_Clu_178 1200;
BA_ "GenSigStartValue" SG_ 279 ARS_RDI_RCS_Clu_178 256;
BA_ "GenSigStartValue" SG_ 279 ARS_RDI_AzimuthAng_Clu_178 511;
BA_ "GenSigStartValue" SG_ 279 ARS_RDI_ElevationAng_Clu_178 63;
BA_ "GenSigStartValue" SG_ 279 ARS_RDI_VradRel_Clu_179 1200;
BA_ "GenSigStartValue" SG_ 279 ARS_RDI_RCS_Clu_179 256;
BA_ "GenSigStartValue" SG_ 279 ARS_RDI_AzimuthAng_Clu_179 511;
BA_ "GenSigStartValue" SG_ 279 ARS_RDI_ElevationAng_Clu_179 63;
BA_ "GenSigStartValue" SG_ 279 ARS_RDI_RCS_Clu_176 256;
BA_ "GenSigStartValue" SG_ 279 ARS_RDI_VradRel_Clu_180 1200;
BA_ "GenSigStartValue" SG_ 279 ARS_RDI_RCS_Clu_180 256;
BA_ "GenSigStartValue" SG_ 279 ARS_RDI_AzimuthAng_Clu_180 511;
BA_ "GenSigStartValue" SG_ 279 ARS_RDI_ElevationAng_Clu_180 63;
BA_ "GenSigStartValue" SG_ 279 ARS_RDI_VradRel_Clu_181 1200;
BA_ "GenSigStartValue" SG_ 279 ARS_RDI_RCS_Clu_181 256;
BA_ "GenSigStartValue" SG_ 279 ARS_RDI_AzimuthAng_Clu_176 511;
BA_ "GenSigStartValue" SG_ 279 ARS_RDI_AzimuthAng_Clu_181 511;
BA_ "GenSigStartValue" SG_ 279 ARS_RDI_ElevationAng_Clu_181 63;
BA_ "GenSigStartValue" SG_ 279 ARS_RDI_VradRel_Clu_182 1200;
BA_ "GenSigStartValue" SG_ 279 ARS_RDI_RCS_Clu_182 256;
BA_ "GenSigStartValue" SG_ 279 ARS_RDI_AzimuthAng_Clu_182 511;
BA_ "GenSigStartValue" SG_ 279 ARS_RDI_ElevationAng_Clu_182 63;
BA_ "GenSigStartValue" SG_ 279 ARS_RDI_ElevationAng_Clu_176 63;
BA_ "GenSigStartValue" SG_ 279 ARS_RDI_VradRel_Clu_183 1200;
BA_ "GenSigStartValue" SG_ 279 ARS_RDI_RCS_Clu_183 256;
BA_ "GenSigStartValue" SG_ 279 ARS_RDI_AzimuthAng_Clu_183 511;
BA_ "GenSigStartValue" SG_ 279 ARS_RDI_ElevationAng_Clu_183 63;
BA_ "SystemSignalLongSymbol" SG_ 279 ARS_RDI_CRC16_Checksum_Clu_176_1 "ARS_RDI_CRC16_Checksum_Clu_176_183";
BA_ "GenSigStartValue" SG_ 279 ARS_RDI_VradRel_Clu_177 1200;
BA_ "GenSigStartValue" SG_ 279 ARS_RDI_RCS_Clu_177 256;
BA_ "GenSigStartValue" SG_ 279 ARS_RDI_AzimuthAng_Clu_177 511;
BA_ "GenSigStartValue" SG_ 280 ARS_RDI_ElevationAng_Clu_185 63;
BA_ "GenSigStartValue" SG_ 280 ARS_RDI_VradRel_Clu_184 1200;
BA_ "GenSigStartValue" SG_ 280 ARS_RDI_VradRel_Clu_186 1200;
BA_ "GenSigStartValue" SG_ 280 ARS_RDI_RCS_Clu_186 256;
BA_ "GenSigStartValue" SG_ 280 ARS_RDI_AzimuthAng_Clu_186 511;
BA_ "GenSigStartValue" SG_ 280 ARS_RDI_ElevationAng_Clu_186 63;
BA_ "GenSigStartValue" SG_ 280 ARS_RDI_VradRel_Clu_187 1200;
BA_ "GenSigStartValue" SG_ 280 ARS_RDI_RCS_Clu_187 256;
BA_ "GenSigStartValue" SG_ 280 ARS_RDI_AzimuthAng_Clu_187 511;
BA_ "GenSigStartValue" SG_ 280 ARS_RDI_ElevationAng_Clu_187 63;
BA_ "GenSigStartValue" SG_ 280 ARS_RDI_RCS_Clu_184 256;
BA_ "GenSigStartValue" SG_ 280 ARS_RDI_VradRel_Clu_188 1200;
BA_ "GenSigStartValue" SG_ 280 ARS_RDI_RCS_Clu_188 256;
BA_ "GenSigStartValue" SG_ 280 ARS_RDI_AzimuthAng_Clu_188 511;
BA_ "GenSigStartValue" SG_ 280 ARS_RDI_ElevationAng_Clu_188 63;
BA_ "GenSigStartValue" SG_ 280 ARS_RDI_VradRel_Clu_189 1200;
BA_ "GenSigStartValue" SG_ 280 ARS_RDI_RCS_Clu_189 256;
BA_ "GenSigStartValue" SG_ 280 ARS_RDI_AzimuthAng_Clu_184 511;
BA_ "GenSigStartValue" SG_ 280 ARS_RDI_AzimuthAng_Clu_189 511;
BA_ "GenSigStartValue" SG_ 280 ARS_RDI_ElevationAng_Clu_189 63;
BA_ "GenSigStartValue" SG_ 280 ARS_RDI_VradRel_Clu_190 1200;
BA_ "GenSigStartValue" SG_ 280 ARS_RDI_RCS_Clu_190 256;
BA_ "GenSigStartValue" SG_ 280 ARS_RDI_AzimuthAng_Clu_190 511;
BA_ "GenSigStartValue" SG_ 280 ARS_RDI_ElevationAng_Clu_190 63;
BA_ "GenSigStartValue" SG_ 280 ARS_RDI_ElevationAng_Clu_184 63;
BA_ "GenSigStartValue" SG_ 280 ARS_RDI_VradRel_Clu_191 1200;
BA_ "GenSigStartValue" SG_ 280 ARS_RDI_RCS_Clu_191 256;
BA_ "GenSigStartValue" SG_ 280 ARS_RDI_AzimuthAng_Clu_191 511;
BA_ "GenSigStartValue" SG_ 280 ARS_RDI_ElevationAng_Clu_191 63;
BA_ "SystemSignalLongSymbol" SG_ 280 ARS_RDI_CRC16_Checksum_Clu_184_1 "ARS_RDI_CRC16_Checksum_Clu_184_191";
BA_ "GenSigStartValue" SG_ 280 ARS_RDI_VradRel_Clu_185 1200;
BA_ "GenSigStartValue" SG_ 280 ARS_RDI_RCS_Clu_185 256;
BA_ "GenSigStartValue" SG_ 280 ARS_RDI_AzimuthAng_Clu_185 511;
BA_ "GenSigStartValue" SG_ 281 ARS_RDI_ElevationAng_Clu_193 63;
BA_ "GenSigStartValue" SG_ 281 ARS_RDI_VradRel_Clu_192 1200;
BA_ "GenSigStartValue" SG_ 281 ARS_RDI_VradRel_Clu_194 1200;
BA_ "GenSigStartValue" SG_ 281 ARS_RDI_RCS_Clu_194 256;
BA_ "GenSigStartValue" SG_ 281 ARS_RDI_AzimuthAng_Clu_194 511;
BA_ "GenSigStartValue" SG_ 281 ARS_RDI_ElevationAng_Clu_194 63;
BA_ "GenSigStartValue" SG_ 281 ARS_RDI_VradRel_Clu_195 1200;
BA_ "GenSigStartValue" SG_ 281 ARS_RDI_RCS_Clu_195 256;
BA_ "GenSigStartValue" SG_ 281 ARS_RDI_AzimuthAng_Clu_195 511;
BA_ "GenSigStartValue" SG_ 281 ARS_RDI_ElevationAng_Clu_195 63;
BA_ "GenSigStartValue" SG_ 281 ARS_RDI_RCS_Clu_192 256;
BA_ "GenSigStartValue" SG_ 281 ARS_RDI_VradRel_Clu_196 1200;
BA_ "GenSigStartValue" SG_ 281 ARS_RDI_RCS_Clu_196 256;
BA_ "GenSigStartValue" SG_ 281 ARS_RDI_AzimuthAng_Clu_196 511;
BA_ "GenSigStartValue" SG_ 281 ARS_RDI_ElevationAng_Clu_196 63;
BA_ "GenSigStartValue" SG_ 281 ARS_RDI_VradRel_Clu_197 1200;
BA_ "GenSigStartValue" SG_ 281 ARS_RDI_RCS_Clu_197 256;
BA_ "GenSigStartValue" SG_ 281 ARS_RDI_AzimuthAng_Clu_192 511;
BA_ "GenSigStartValue" SG_ 281 ARS_RDI_AzimuthAng_Clu_197 511;
BA_ "GenSigStartValue" SG_ 281 ARS_RDI_ElevationAng_Clu_197 63;
BA_ "GenSigStartValue" SG_ 281 ARS_RDI_VradRel_Clu_198 1200;
BA_ "GenSigStartValue" SG_ 281 ARS_RDI_RCS_Clu_198 256;
BA_ "GenSigStartValue" SG_ 281 ARS_RDI_AzimuthAng_Clu_198 511;
BA_ "GenSigStartValue" SG_ 281 ARS_RDI_ElevationAng_Clu_198 63;
BA_ "GenSigStartValue" SG_ 281 ARS_RDI_ElevationAng_Clu_192 63;
BA_ "GenSigStartValue" SG_ 281 ARS_RDI_VradRel_Clu_199 1200;
BA_ "GenSigStartValue" SG_ 281 ARS_RDI_RCS_Clu_199 256;
BA_ "GenSigStartValue" SG_ 281 ARS_RDI_AzimuthAng_Clu_199 511;
BA_ "GenSigStartValue" SG_ 281 ARS_RDI_ElevationAng_Clu_199 63;
BA_ "SystemSignalLongSymbol" SG_ 281 ARS_RDI_CRC16_Checksum_Clu_192_1 "ARS_RDI_CRC16_Checksum_Clu_192_199";
BA_ "GenSigStartValue" SG_ 281 ARS_RDI_VradRel_Clu_193 1200;
BA_ "GenSigStartValue" SG_ 281 ARS_RDI_RCS_Clu_193 256;
BA_ "GenSigStartValue" SG_ 281 ARS_RDI_AzimuthAng_Clu_193 511;
BA_ "GenSigStartValue" SG_ 282 ARS_RDI_Obj_ID_Clu_000 63;
BA_ "GenSigStartValue" SG_ 282 ARS_RDI_Obj_ID_Clu_001 63;
BA_ "GenSigStartValue" SG_ 282 ARS_RDI_Obj_ID_Clu_017 63;
BA_ "GenSigStartValue" SG_ 282 ARS_RDI_Obj_ID_Clu_018 63;
BA_ "GenSigStartValue" SG_ 282 ARS_RDI_Obj_ID_Clu_019 63;
BA_ "GenSigStartValue" SG_ 282 ARS_RDI_Obj_ID_Clu_020 63;
BA_ "GenSigStartValue" SG_ 282 ARS_RDI_Obj_ID_Clu_021 63;
BA_ "GenSigStartValue" SG_ 282 ARS_RDI_Obj_ID_Clu_002 63;
BA_ "GenSigStartValue" SG_ 282 ARS_RDI_Obj_ID_Clu_022 63;
BA_ "GenSigStartValue" SG_ 282 ARS_RDI_Obj_ID_Clu_023 63;
BA_ "GenSigStartValue" SG_ 282 ARS_RDI_Obj_ID_Clu_024 63;
BA_ "GenSigStartValue" SG_ 282 ARS_RDI_Obj_ID_Clu_025 63;
BA_ "GenSigStartValue" SG_ 282 ARS_RDI_Obj_ID_Clu_026 63;
BA_ "GenSigStartValue" SG_ 282 ARS_RDI_Obj_ID_Clu_027 63;
BA_ "GenSigStartValue" SG_ 282 ARS_RDI_Obj_ID_Clu_028 63;
BA_ "GenSigStartValue" SG_ 282 ARS_RDI_Obj_ID_Clu_029 63;
BA_ "GenSigStartValue" SG_ 282 ARS_RDI_Obj_ID_Clu_030 63;
BA_ "GenSigStartValue" SG_ 282 ARS_RDI_Obj_ID_Clu_031 63;
BA_ "GenSigStartValue" SG_ 282 ARS_RDI_Obj_ID_Clu_003 63;
BA_ "GenSigStartValue" SG_ 282 ARS_RDI_Obj_ID_Clu_032 63;
BA_ "GenSigStartValue" SG_ 282 ARS_RDI_Obj_ID_Clu_033 63;
BA_ "GenSigStartValue" SG_ 282 ARS_RDI_Obj_ID_Clu_034 63;
BA_ "GenSigStartValue" SG_ 282 ARS_RDI_Obj_ID_Clu_035 63;
BA_ "GenSigStartValue" SG_ 282 ARS_RDI_Obj_ID_Clu_036 63;
BA_ "GenSigStartValue" SG_ 282 ARS_RDI_Obj_ID_Clu_037 63;
BA_ "GenSigStartValue" SG_ 282 ARS_RDI_Obj_ID_Clu_038 63;
BA_ "GenSigStartValue" SG_ 282 ARS_RDI_Obj_ID_Clu_039 63;
BA_ "GenSigStartValue" SG_ 282 ARS_RDI_Obj_ID_Clu_040 63;
BA_ "GenSigStartValue" SG_ 282 ARS_RDI_Obj_ID_Clu_041 63;
BA_ "GenSigStartValue" SG_ 282 ARS_RDI_Obj_ID_Clu_004 63;
BA_ "GenSigStartValue" SG_ 282 ARS_RDI_Obj_ID_Clu_042 63;
BA_ "GenSigStartValue" SG_ 282 ARS_RDI_Obj_ID_Clu_043 63;
BA_ "GenSigStartValue" SG_ 282 ARS_RDI_Obj_ID_Clu_044 63;
BA_ "GenSigStartValue" SG_ 282 ARS_RDI_Obj_ID_Clu_045 63;
BA_ "GenSigStartValue" SG_ 282 ARS_RDI_Obj_ID_Clu_046 63;
BA_ "GenSigStartValue" SG_ 282 ARS_RDI_Obj_ID_Clu_047 63;
BA_ "GenSigStartValue" SG_ 282 ARS_RDI_Obj_ID_Clu_048 63;
BA_ "GenSigStartValue" SG_ 282 ARS_RDI_Obj_ID_Clu_049 63;
BA_ "GenSigStartValue" SG_ 282 ARS_RDI_Obj_ID_Clu_050 63;
BA_ "GenSigStartValue" SG_ 282 ARS_RDI_Obj_ID_Clu_051 63;
BA_ "GenSigStartValue" SG_ 282 ARS_RDI_Obj_ID_Clu_005 63;
BA_ "GenSigStartValue" SG_ 282 ARS_RDI_Obj_ID_Clu_052 63;
BA_ "GenSigStartValue" SG_ 282 ARS_RDI_Obj_ID_Clu_053 63;
BA_ "GenSigStartValue" SG_ 282 ARS_RDI_Obj_ID_Clu_054 63;
BA_ "GenSigStartValue" SG_ 282 ARS_RDI_Obj_ID_Clu_055 63;
BA_ "GenSigStartValue" SG_ 282 ARS_RDI_Obj_ID_Clu_056 63;
BA_ "GenSigStartValue" SG_ 282 ARS_RDI_Obj_ID_Clu_057 63;
BA_ "GenSigStartValue" SG_ 282 ARS_RDI_Obj_ID_Clu_058 63;
BA_ "GenSigStartValue" SG_ 282 ARS_RDI_Obj_ID_Clu_059 63;
BA_ "GenSigStartValue" SG_ 282 ARS_RDI_Obj_ID_Clu_060 63;
BA_ "GenSigStartValue" SG_ 282 ARS_RDI_Obj_ID_Clu_061 63;
BA_ "GenSigStartValue" SG_ 282 ARS_RDI_Obj_ID_Clu_006 63;
BA_ "GenSigStartValue" SG_ 282 ARS_RDI_Obj_ID_Clu_062 63;
BA_ "GenSigStartValue" SG_ 282 ARS_RDI_Obj_ID_Clu_063 63;
BA_ "GenSigStartValue" SG_ 282 ARS_RDI_Obj_ID_Clu_064 63;
BA_ "GenSigStartValue" SG_ 282 ARS_RDI_Obj_ID_Clu_065 63;
BA_ "GenSigStartValue" SG_ 282 ARS_RDI_Obj_ID_Clu_066 63;
BA_ "GenSigStartValue" SG_ 282 ARS_RDI_Obj_ID_Clu_067 63;
BA_ "GenSigStartValue" SG_ 282 ARS_RDI_Obj_ID_Clu_068 63;
BA_ "GenSigStartValue" SG_ 282 ARS_RDI_Obj_ID_Clu_069 63;
BA_ "GenSigStartValue" SG_ 282 ARS_RDI_Obj_ID_Clu_070 63;
BA_ "GenSigStartValue" SG_ 282 ARS_RDI_Obj_ID_Clu_071 63;
BA_ "GenSigStartValue" SG_ 282 ARS_RDI_Obj_ID_Clu_007 63;
BA_ "GenSigStartValue" SG_ 282 ARS_RDI_Obj_ID_Clu_072 63;
BA_ "GenSigStartValue" SG_ 282 ARS_RDI_Obj_ID_Clu_073 63;
BA_ "GenSigStartValue" SG_ 282 ARS_RDI_Obj_ID_Clu_074 63;
BA_ "GenSigStartValue" SG_ 282 ARS_RDI_Obj_ID_Clu_075 63;
BA_ "GenSigStartValue" SG_ 282 ARS_RDI_Obj_ID_Clu_076 63;
BA_ "GenSigStartValue" SG_ 282 ARS_RDI_Obj_ID_Clu_077 63;
BA_ "GenSigStartValue" SG_ 282 ARS_RDI_Obj_ID_Clu_078 63;
BA_ "GenSigStartValue" SG_ 282 ARS_RDI_Obj_ID_Clu_079 63;
BA_ "GenSigStartValue" SG_ 282 ARS_RDI_Obj_ID_Clu_008 63;
BA_ "GenSigStartValue" SG_ 282 ARS_RDI_Obj_ID_Clu_009 63;
BA_ "GenSigStartValue" SG_ 282 ARS_RDI_Obj_ID_Clu_010 63;
BA_ "GenSigStartValue" SG_ 282 ARS_RDI_Obj_ID_Clu_011 63;
BA_ "GenSigStartValue" SG_ 282 ARS_RDI_Obj_ID_Clu_012 63;
BA_ "GenSigStartValue" SG_ 282 ARS_RDI_Obj_ID_Clu_013 63;
BA_ "GenSigStartValue" SG_ 282 ARS_RDI_Obj_ID_Clu_014 63;
BA_ "GenSigStartValue" SG_ 282 ARS_RDI_Obj_ID_Clu_015 63;
BA_ "GenSigStartValue" SG_ 282 ARS_RDI_Obj_ID_Clu_016 63;
BA_ "GenSigStartValue" SG_ 283 ARS_RDI_Obj_ID_Clu_080 63;
BA_ "GenSigStartValue" SG_ 283 ARS_RDI_Obj_ID_Clu_081 63;
BA_ "GenSigStartValue" SG_ 283 ARS_RDI_Obj_ID_Clu_097 63;
BA_ "GenSigStartValue" SG_ 283 ARS_RDI_Obj_ID_Clu_098 63;
BA_ "GenSigStartValue" SG_ 283 ARS_RDI_Obj_ID_Clu_099 63;
BA_ "GenSigStartValue" SG_ 283 ARS_RDI_Obj_ID_Clu_100 63;
BA_ "GenSigStartValue" SG_ 283 ARS_RDI_Obj_ID_Clu_101 63;
BA_ "GenSigStartValue" SG_ 283 ARS_RDI_Obj_ID_Clu_082 63;
BA_ "GenSigStartValue" SG_ 283 ARS_RDI_Obj_ID_Clu_102 63;
BA_ "GenSigStartValue" SG_ 283 ARS_RDI_Obj_ID_Clu_103 63;
BA_ "GenSigStartValue" SG_ 283 ARS_RDI_Obj_ID_Clu_104 63;
BA_ "GenSigStartValue" SG_ 283 ARS_RDI_Obj_ID_Clu_105 63;
BA_ "GenSigStartValue" SG_ 283 ARS_RDI_Obj_ID_Clu_106 63;
BA_ "GenSigStartValue" SG_ 283 ARS_RDI_Obj_ID_Clu_107 63;
BA_ "GenSigStartValue" SG_ 283 ARS_RDI_Obj_ID_Clu_108 63;
BA_ "GenSigStartValue" SG_ 283 ARS_RDI_Obj_ID_Clu_109 63;
BA_ "GenSigStartValue" SG_ 283 ARS_RDI_Obj_ID_Clu_110 63;
BA_ "GenSigStartValue" SG_ 283 ARS_RDI_Obj_ID_Clu_111 63;
BA_ "GenSigStartValue" SG_ 283 ARS_RDI_Obj_ID_Clu_083 63;
BA_ "GenSigStartValue" SG_ 283 ARS_RDI_Obj_ID_Clu_112 63;
BA_ "GenSigStartValue" SG_ 283 ARS_RDI_Obj_ID_Clu_113 63;
BA_ "GenSigStartValue" SG_ 283 ARS_RDI_Obj_ID_Clu_114 63;
BA_ "GenSigStartValue" SG_ 283 ARS_RDI_Obj_ID_Clu_115 63;
BA_ "GenSigStartValue" SG_ 283 ARS_RDI_Obj_ID_Clu_116 63;
BA_ "GenSigStartValue" SG_ 283 ARS_RDI_Obj_ID_Clu_117 63;
BA_ "GenSigStartValue" SG_ 283 ARS_RDI_Obj_ID_Clu_118 63;
BA_ "GenSigStartValue" SG_ 283 ARS_RDI_Obj_ID_Clu_119 63;
BA_ "GenSigStartValue" SG_ 283 ARS_RDI_Obj_ID_Clu_120 63;
BA_ "GenSigStartValue" SG_ 283 ARS_RDI_Obj_ID_Clu_121 63;
BA_ "GenSigStartValue" SG_ 283 ARS_RDI_Obj_ID_Clu_084 63;
BA_ "GenSigStartValue" SG_ 283 ARS_RDI_Obj_ID_Clu_122 63;
BA_ "GenSigStartValue" SG_ 283 ARS_RDI_Obj_ID_Clu_123 63;
BA_ "GenSigStartValue" SG_ 283 ARS_RDI_Obj_ID_Clu_124 63;
BA_ "GenSigStartValue" SG_ 283 ARS_RDI_Obj_ID_Clu_125 63;
BA_ "GenSigStartValue" SG_ 283 ARS_RDI_Obj_ID_Clu_126 63;
BA_ "GenSigStartValue" SG_ 283 ARS_RDI_Obj_ID_Clu_127 63;
BA_ "GenSigStartValue" SG_ 283 ARS_RDI_Obj_ID_Clu_128 63;
BA_ "GenSigStartValue" SG_ 283 ARS_RDI_Obj_ID_Clu_129 63;
BA_ "GenSigStartValue" SG_ 283 ARS_RDI_Obj_ID_Clu_130 63;
BA_ "GenSigStartValue" SG_ 283 ARS_RDI_Obj_ID_Clu_131 63;
BA_ "GenSigStartValue" SG_ 283 ARS_RDI_Obj_ID_Clu_085 63;
BA_ "GenSigStartValue" SG_ 283 ARS_RDI_Obj_ID_Clu_132 63;
BA_ "GenSigStartValue" SG_ 283 ARS_RDI_Obj_ID_Clu_133 63;
BA_ "GenSigStartValue" SG_ 283 ARS_RDI_Obj_ID_Clu_134 63;
BA_ "GenSigStartValue" SG_ 283 ARS_RDI_Obj_ID_Clu_135 63;
BA_ "GenSigStartValue" SG_ 283 ARS_RDI_Obj_ID_Clu_136 63;
BA_ "GenSigStartValue" SG_ 283 ARS_RDI_Obj_ID_Clu_137 63;
BA_ "GenSigStartValue" SG_ 283 ARS_RDI_Obj_ID_Clu_138 63;
BA_ "GenSigStartValue" SG_ 283 ARS_RDI_Obj_ID_Clu_139 63;
BA_ "GenSigStartValue" SG_ 283 ARS_RDI_Obj_ID_Clu_140 63;
BA_ "GenSigStartValue" SG_ 283 ARS_RDI_Obj_ID_Clu_141 63;
BA_ "GenSigStartValue" SG_ 283 ARS_RDI_Obj_ID_Clu_086 63;
BA_ "GenSigStartValue" SG_ 283 ARS_RDI_Obj_ID_Clu_142 63;
BA_ "GenSigStartValue" SG_ 283 ARS_RDI_Obj_ID_Clu_143 63;
BA_ "GenSigStartValue" SG_ 283 ARS_RDI_Obj_ID_Clu_144 63;
BA_ "GenSigStartValue" SG_ 283 ARS_RDI_Obj_ID_Clu_145 63;
BA_ "GenSigStartValue" SG_ 283 ARS_RDI_Obj_ID_Clu_146 63;
BA_ "GenSigStartValue" SG_ 283 ARS_RDI_Obj_ID_Clu_147 63;
BA_ "GenSigStartValue" SG_ 283 ARS_RDI_Obj_ID_Clu_148 63;
BA_ "GenSigStartValue" SG_ 283 ARS_RDI_Obj_ID_Clu_149 63;
BA_ "GenSigStartValue" SG_ 283 ARS_RDI_Obj_ID_Clu_150 63;
BA_ "GenSigStartValue" SG_ 283 ARS_RDI_Obj_ID_Clu_151 63;
BA_ "GenSigStartValue" SG_ 283 ARS_RDI_Obj_ID_Clu_087 63;
BA_ "GenSigStartValue" SG_ 283 ARS_RDI_Obj_ID_Clu_152 63;
BA_ "GenSigStartValue" SG_ 283 ARS_RDI_Obj_ID_Clu_153 63;
BA_ "GenSigStartValue" SG_ 283 ARS_RDI_Obj_ID_Clu_154 63;
BA_ "GenSigStartValue" SG_ 283 ARS_RDI_Obj_ID_Clu_155 63;
BA_ "GenSigStartValue" SG_ 283 ARS_RDI_Obj_ID_Clu_156 63;
BA_ "GenSigStartValue" SG_ 283 ARS_RDI_Obj_ID_Clu_157 63;
BA_ "GenSigStartValue" SG_ 283 ARS_RDI_Obj_ID_Clu_158 63;
BA_ "GenSigStartValue" SG_ 283 ARS_RDI_Obj_ID_Clu_159 63;
BA_ "GenSigStartValue" SG_ 283 ARS_RDI_Obj_ID_Clu_088 63;
BA_ "GenSigStartValue" SG_ 283 ARS_RDI_Obj_ID_Clu_089 63;
BA_ "GenSigStartValue" SG_ 283 ARS_RDI_Obj_ID_Clu_090 63;
BA_ "GenSigStartValue" SG_ 283 ARS_RDI_Obj_ID_Clu_091 63;
BA_ "GenSigStartValue" SG_ 283 ARS_RDI_Obj_ID_Clu_092 63;
BA_ "GenSigStartValue" SG_ 283 ARS_RDI_Obj_ID_Clu_093 63;
BA_ "GenSigStartValue" SG_ 283 ARS_RDI_Obj_ID_Clu_094 63;
BA_ "GenSigStartValue" SG_ 283 ARS_RDI_Obj_ID_Clu_095 63;
BA_ "GenSigStartValue" SG_ 283 ARS_RDI_Obj_ID_Clu_096 63;
BA_ "GenSigStartValue" SG_ 284 ARS_RDI_Obj_ID_Clu_160 63;
BA_ "GenSigStartValue" SG_ 284 ARS_RDI_Obj_ID_Clu_161 63;
BA_ "GenSigStartValue" SG_ 284 ARS_RDI_Obj_ID_Clu_177 63;
BA_ "GenSigStartValue" SG_ 284 ARS_RDI_Obj_ID_Clu_178 63;
BA_ "GenSigStartValue" SG_ 284 ARS_RDI_Obj_ID_Clu_179 63;
BA_ "GenSigStartValue" SG_ 284 ARS_RDI_Obj_ID_Clu_180 63;
BA_ "GenSigStartValue" SG_ 284 ARS_RDI_Obj_ID_Clu_181 63;
BA_ "GenSigStartValue" SG_ 284 ARS_RDI_Obj_ID_Clu_162 63;
BA_ "GenSigStartValue" SG_ 284 ARS_RDI_Obj_ID_Clu_182 63;
BA_ "GenSigStartValue" SG_ 284 ARS_RDI_Obj_ID_Clu_183 63;
BA_ "GenSigStartValue" SG_ 284 ARS_RDI_Obj_ID_Clu_184 63;
BA_ "GenSigStartValue" SG_ 284 ARS_RDI_Obj_ID_Clu_185 63;
BA_ "GenSigStartValue" SG_ 284 ARS_RDI_Obj_ID_Clu_186 63;
BA_ "GenSigStartValue" SG_ 284 ARS_RDI_Obj_ID_Clu_187 63;
BA_ "GenSigStartValue" SG_ 284 ARS_RDI_Obj_ID_Clu_188 63;
BA_ "GenSigStartValue" SG_ 284 ARS_RDI_Obj_ID_Clu_189 63;
BA_ "GenSigStartValue" SG_ 284 ARS_RDI_Obj_ID_Clu_190 63;
BA_ "GenSigStartValue" SG_ 284 ARS_RDI_Obj_ID_Clu_191 63;
BA_ "GenSigStartValue" SG_ 284 ARS_RDI_Obj_ID_Clu_163 63;
BA_ "GenSigStartValue" SG_ 284 ARS_RDI_Obj_ID_Clu_192 63;
BA_ "GenSigStartValue" SG_ 284 ARS_RDI_Obj_ID_Clu_193 63;
BA_ "GenSigStartValue" SG_ 284 ARS_RDI_Obj_ID_Clu_194 63;
BA_ "GenSigStartValue" SG_ 284 ARS_RDI_Obj_ID_Clu_195 63;
BA_ "GenSigStartValue" SG_ 284 ARS_RDI_Obj_ID_Clu_196 63;
BA_ "GenSigStartValue" SG_ 284 ARS_RDI_Obj_ID_Clu_197 63;
BA_ "GenSigStartValue" SG_ 284 ARS_RDI_Obj_ID_Clu_198 63;
BA_ "GenSigStartValue" SG_ 284 ARS_RDI_Obj_ID_Clu_199 63;
BA_ "GenSigStartValue" SG_ 284 ARS_RDI_Obj_ID_Clu_164 63;
BA_ "GenSigStartValue" SG_ 284 ARS_RDI_Obj_ID_Clu_165 63;
BA_ "GenSigStartValue" SG_ 284 ARS_RDI_Obj_ID_Clu_166 63;
BA_ "GenSigStartValue" SG_ 284 ARS_RDI_Obj_ID_Clu_167 63;
BA_ "GenSigStartValue" SG_ 284 ARS_RDI_Obj_ID_Clu_168 63;
BA_ "GenSigStartValue" SG_ 284 ARS_RDI_Obj_ID_Clu_169 63;
BA_ "GenSigStartValue" SG_ 284 ARS_RDI_Obj_ID_Clu_170 63;
BA_ "GenSigStartValue" SG_ 284 ARS_RDI_Obj_ID_Clu_171 63;
BA_ "GenSigStartValue" SG_ 284 ARS_RDI_Obj_ID_Clu_172 63;
BA_ "GenSigStartValue" SG_ 284 ARS_RDI_Obj_ID_Clu_173 63;
BA_ "GenSigStartValue" SG_ 284 ARS_RDI_Obj_ID_Clu_174 63;
BA_ "GenSigStartValue" SG_ 284 ARS_RDI_Obj_ID_Clu_175 63;
BA_ "GenSigStartValue" SG_ 284 ARS_RDI_Obj_ID_Clu_176 63;
BA_ "GenSigStartValue" SG_ 285 ARS_RDI_Range_Clu_200 63;
BA_ "GenSigStartValue" SG_ 285 ARS_RDI_ElevationAng_Clu_201 63;
BA_ "GenSigStartValue" SG_ 285 ARS_RDI_VradRel_Clu_200 1200;
BA_ "GenSigStartValue" SG_ 285 ARS_RDI_VradRel_Clu_202 1200;
BA_ "GenSigStartValue" SG_ 285 ARS_RDI_RCS_Clu_202 256;
BA_ "GenSigStartValue" SG_ 285 ARS_RDI_AzimuthAng_Clu_202 511;
BA_ "GenSigStartValue" SG_ 285 ARS_RDI_ElevationAng_Clu_202 63;
BA_ "GenSigStartValue" SG_ 285 ARS_RDI_VradRel_Clu_203 1200;
BA_ "GenSigStartValue" SG_ 285 ARS_RDI_RCS_Clu_203 256;
BA_ "GenSigStartValue" SG_ 285 ARS_RDI_AzimuthAng_Clu_203 511;
BA_ "GenSigStartValue" SG_ 285 ARS_RDI_ElevationAng_Clu_203 63;
BA_ "GenSigStartValue" SG_ 285 ARS_RDI_RCS_Clu_200 256;
BA_ "GenSigStartValue" SG_ 285 ARS_RDI_VradRel_Clu_204 1200;
BA_ "GenSigStartValue" SG_ 285 ARS_RDI_RCS_Clu_204 256;
BA_ "GenSigStartValue" SG_ 285 ARS_RDI_AzimuthAng_Clu_204 511;
BA_ "GenSigStartValue" SG_ 285 ARS_RDI_ElevationAng_Clu_204 63;
BA_ "GenSigStartValue" SG_ 285 ARS_RDI_VradRel_Clu_205 1200;
BA_ "GenSigStartValue" SG_ 285 ARS_RDI_RCS_Clu_205 256;
BA_ "GenSigStartValue" SG_ 285 ARS_RDI_AzimuthAng_Clu_200 511;
BA_ "GenSigStartValue" SG_ 285 ARS_RDI_AzimuthAng_Clu_205 511;
BA_ "GenSigStartValue" SG_ 285 ARS_RDI_ElevationAng_Clu_205 63;
BA_ "GenSigStartValue" SG_ 285 ARS_RDI_VradRel_Clu_206 1200;
BA_ "GenSigStartValue" SG_ 285 ARS_RDI_RCS_Clu_206 256;
BA_ "GenSigStartValue" SG_ 285 ARS_RDI_AzimuthAng_Clu_206 511;
BA_ "GenSigStartValue" SG_ 285 ARS_RDI_ElevationAng_Clu_206 63;
BA_ "GenSigStartValue" SG_ 285 ARS_RDI_ElevationAng_Clu_200 63;
BA_ "GenSigStartValue" SG_ 285 ARS_RDI_VradRel_Clu_207 1200;
BA_ "GenSigStartValue" SG_ 285 ARS_RDI_RCS_Clu_207 256;
BA_ "GenSigStartValue" SG_ 285 ARS_RDI_AzimuthAng_Clu_207 511;
BA_ "GenSigStartValue" SG_ 285 ARS_RDI_ElevationAng_Clu_207 63;
BA_ "SystemSignalLongSymbol" SG_ 285 ARS_RDI_CRC16_Checksum_Clu_200_2 "ARS_RDI_CRC16_Checksum_Clu_200_207";
BA_ "GenSigStartValue" SG_ 285 ARS_RDI_VradRel_Clu_201 1200;
BA_ "GenSigStartValue" SG_ 285 ARS_RDI_RCS_Clu_201 256;
BA_ "GenSigStartValue" SG_ 285 ARS_RDI_AzimuthAng_Clu_201 511;
BA_ "GenSigStartValue" SG_ 286 ARS_RDI_ElevationAng_Clu_209 63;
BA_ "GenSigStartValue" SG_ 286 ARS_RDI_VradRel_Clu_208 1200;
BA_ "GenSigStartValue" SG_ 286 ARS_RDI_VradRel_Clu_210 1200;
BA_ "GenSigStartValue" SG_ 286 ARS_RDI_RCS_Clu_210 256;
BA_ "GenSigStartValue" SG_ 286 ARS_RDI_AzimuthAng_Clu_210 511;
BA_ "GenSigStartValue" SG_ 286 ARS_RDI_ElevationAng_Clu_210 63;
BA_ "GenSigStartValue" SG_ 286 ARS_RDI_VradRel_Clu_211 1200;
BA_ "GenSigStartValue" SG_ 286 ARS_RDI_RCS_Clu_211 256;
BA_ "GenSigStartValue" SG_ 286 ARS_RDI_AzimuthAng_Clu_211 511;
BA_ "GenSigStartValue" SG_ 286 ARS_RDI_ElevationAng_Clu_211 63;
BA_ "GenSigStartValue" SG_ 286 ARS_RDI_RCS_Clu_208 256;
BA_ "GenSigStartValue" SG_ 286 ARS_RDI_VradRel_Clu_212 1200;
BA_ "GenSigStartValue" SG_ 286 ARS_RDI_RCS_Clu_212 256;
BA_ "GenSigStartValue" SG_ 286 ARS_RDI_AzimuthAng_Clu_212 511;
BA_ "GenSigStartValue" SG_ 286 ARS_RDI_ElevationAng_Clu_212 63;
BA_ "GenSigStartValue" SG_ 286 ARS_RDI_VradRel_Clu_213 1200;
BA_ "GenSigStartValue" SG_ 286 ARS_RDI_RCS_Clu_213 256;
BA_ "GenSigStartValue" SG_ 286 ARS_RDI_AzimuthAng_Clu_208 511;
BA_ "GenSigStartValue" SG_ 286 ARS_RDI_AzimuthAng_Clu_213 511;
BA_ "GenSigStartValue" SG_ 286 ARS_RDI_ElevationAng_Clu_213 63;
BA_ "GenSigStartValue" SG_ 286 ARS_RDI_VradRel_Clu_214 1200;
BA_ "GenSigStartValue" SG_ 286 ARS_RDI_RCS_Clu_214 256;
BA_ "GenSigStartValue" SG_ 286 ARS_RDI_AzimuthAng_Clu_214 511;
BA_ "GenSigStartValue" SG_ 286 ARS_RDI_ElevationAng_Clu_214 63;
BA_ "GenSigStartValue" SG_ 286 ARS_RDI_ElevationAng_Clu_208 63;
BA_ "GenSigStartValue" SG_ 286 ARS_RDI_VradRel_Clu_215 1200;
BA_ "GenSigStartValue" SG_ 286 ARS_RDI_RCS_Clu_215 256;
BA_ "GenSigStartValue" SG_ 286 ARS_RDI_AzimuthAng_Clu_215 511;
BA_ "GenSigStartValue" SG_ 286 ARS_RDI_ElevationAng_Clu_215 63;
BA_ "SystemSignalLongSymbol" SG_ 286 ARS_RDI_CRC16_Checksum_Clu_208_2 "ARS_RDI_CRC16_Checksum_Clu_208_215";
BA_ "GenSigStartValue" SG_ 286 ARS_RDI_VradRel_Clu_209 1200;
BA_ "GenSigStartValue" SG_ 286 ARS_RDI_RCS_Clu_209 256;
BA_ "GenSigStartValue" SG_ 286 ARS_RDI_AzimuthAng_Clu_209 511;
BA_ "GenSigStartValue" SG_ 287 ARS_RDI_ElevationAng_Clu_217 63;
BA_ "GenSigStartValue" SG_ 287 ARS_RDI_VradRel_Clu_216 1200;
BA_ "GenSigStartValue" SG_ 287 ARS_RDI_VradRel_Clu_218 1200;
BA_ "GenSigStartValue" SG_ 287 ARS_RDI_RCS_Clu_218 256;
BA_ "GenSigStartValue" SG_ 287 ARS_RDI_AzimuthAng_Clu_218 511;
BA_ "GenSigStartValue" SG_ 287 ARS_RDI_ElevationAng_Clu_218 63;
BA_ "GenSigStartValue" SG_ 287 ARS_RDI_VradRel_Clu_219 1200;
BA_ "GenSigStartValue" SG_ 287 ARS_RDI_RCS_Clu_219 256;
BA_ "GenSigStartValue" SG_ 287 ARS_RDI_AzimuthAng_Clu_219 511;
BA_ "GenSigStartValue" SG_ 287 ARS_RDI_ElevationAng_Clu_219 63;
BA_ "GenSigStartValue" SG_ 287 ARS_RDI_RCS_Clu_216 256;
BA_ "GenSigStartValue" SG_ 287 ARS_RDI_VradRel_Clu_220 1200;
BA_ "GenSigStartValue" SG_ 287 ARS_RDI_RCS_Clu_220 256;
BA_ "GenSigStartValue" SG_ 287 ARS_RDI_AzimuthAng_Clu_220 511;
BA_ "GenSigStartValue" SG_ 287 ARS_RDI_ElevationAng_Clu_220 63;
BA_ "GenSigStartValue" SG_ 287 ARS_RDI_VradRel_Clu_221 1200;
BA_ "GenSigStartValue" SG_ 287 ARS_RDI_RCS_Clu_221 256;
BA_ "GenSigStartValue" SG_ 287 ARS_RDI_AzimuthAng_Clu_216 511;
BA_ "GenSigStartValue" SG_ 287 ARS_RDI_AzimuthAng_Clu_221 511;
BA_ "GenSigStartValue" SG_ 287 ARS_RDI_ElevationAng_Clu_221 63;
BA_ "GenSigStartValue" SG_ 287 ARS_RDI_VradRel_Clu_222 1200;
BA_ "GenSigStartValue" SG_ 287 ARS_RDI_RCS_Clu_222 256;
BA_ "GenSigStartValue" SG_ 287 ARS_RDI_AzimuthAng_Clu_222 511;
BA_ "GenSigStartValue" SG_ 287 ARS_RDI_ElevationAng_Clu_222 63;
BA_ "GenSigStartValue" SG_ 287 ARS_RDI_ElevationAng_Clu_216 63;
BA_ "GenSigStartValue" SG_ 287 ARS_RDI_VradRel_Clu_223 1200;
BA_ "GenSigStartValue" SG_ 287 ARS_RDI_RCS_Clu_223 256;
BA_ "GenSigStartValue" SG_ 287 ARS_RDI_AzimuthAng_Clu_223 511;
BA_ "GenSigStartValue" SG_ 287 ARS_RDI_ElevationAng_Clu_223 63;
BA_ "SystemSignalLongSymbol" SG_ 287 ARS_RDI_CRC16_Checksum_Clu_216_2 "ARS_RDI_CRC16_Checksum_Clu_216_223";
BA_ "GenSigStartValue" SG_ 287 ARS_RDI_VradRel_Clu_217 1200;
BA_ "GenSigStartValue" SG_ 287 ARS_RDI_RCS_Clu_217 256;
BA_ "GenSigStartValue" SG_ 287 ARS_RDI_AzimuthAng_Clu_217 511;
VAL_ 273 ARS_RDI_DynProp_Clu_130 0 "STATIONARY" 1 "MOVING" 2 "AMBIGUOUS" 3 "RESERVED" ;
VAL_ 273 ARS_RDI_Quality_Clu_130 0 "INVALID" 1 "LOW" 2 "MID" 3 "HIGH" ;
VAL_ 273 ARS_RDI_DynProp_Clu_131 0 "STATIONARY" 1 "MOVING" 2 "AMBIGUOUS" 3 "RESERVED" ;
VAL_ 273 ARS_RDI_Quality_Clu_131 0 "INVALID" 1 "LOW" 2 "MID" 3 "HIGH" ;
VAL_ 273 ARS_RDI_DynProp_Clu_132 0 "STATIONARY" 1 "MOVING" 2 "AMBIGUOUS" 3 "RESERVED" ;
VAL_ 273 ARS_RDI_Quality_Clu_132 0 "INVALID" 1 "LOW" 2 "MID" 3 "HIGH" ;
VAL_ 273 ARS_RDI_DynProp_Clu_133 0 "STATIONARY" 1 "MOVING" 2 "AMBIGUOUS" 3 "RESERVED" ;
VAL_ 273 ARS_RDI_Quality_Clu_133 0 "INVALID" 1 "LOW" 2 "MID" 3 "HIGH" ;
VAL_ 273 ARS_RDI_DynProp_Clu_134 0 "STATIONARY" 1 "MOVING" 2 "AMBIGUOUS" 3 "RESERVED" ;
VAL_ 273 ARS_RDI_Quality_Clu_134 0 "INVALID" 1 "LOW" 2 "MID" 3 "HIGH" ;
VAL_ 273 ARS_RDI_DynProp_Clu_135 0 "STATIONARY" 1 "MOVING" 2 "AMBIGUOUS" 3 "RESERVED" ;
VAL_ 273 ARS_RDI_Quality_Clu_135 0 "INVALID" 1 "LOW" 2 "MID" 3 "HIGH" ;
VAL_ 273 ARS_RDI_DynProp_Clu_128 0 "STATIONARY" 1 "MOVING" 2 "AMBIGUOUS" 3 "RESERVED" ;
VAL_ 273 ARS_RDI_Quality_Clu_128 0 "INVALID" 1 "LOW" 2 "MID" 3 "HIGH" ;
VAL_ 273 ARS_RDI_DynProp_Clu_129 0 "STATIONARY" 1 "MOVING" 2 "AMBIGUOUS" 3 "RESERVED" ;
VAL_ 273 ARS_RDI_Quality_Clu_129 0 "INVALID" 1 "LOW" 2 "MID" 3 "HIGH" ;
VAL_ 274 ARS_RDI_DynProp_Clu_138 0 "STATIONARY" 1 "MOVING" 2 "AMBIGUOUS" 3 "RESERVED" ;
VAL_ 274 ARS_RDI_Quality_Clu_138 0 "INVALID" 1 "LOW" 2 "MID" 3 "HIGH" ;
VAL_ 274 ARS_RDI_DynProp_Clu_139 0 "STATIONARY" 1 "MOVING" 2 "AMBIGUOUS" 3 "RESERVED" ;
VAL_ 274 ARS_RDI_Quality_Clu_139 0 "INVALID" 1 "LOW" 2 "MID" 3 "HIGH" ;
VAL_ 274 ARS_RDI_DynProp_Clu_140 0 "STATIONARY" 1 "MOVING" 2 "AMBIGUOUS" 3 "RESERVED" ;
VAL_ 274 ARS_RDI_Quality_Clu_140 0 "INVALID" 1 "LOW" 2 "MID" 3 "HIGH" ;
VAL_ 274 ARS_RDI_DynProp_Clu_141 0 "STATIONARY" 1 "MOVING" 2 "AMBIGUOUS" 3 "RESERVED" ;
VAL_ 274 ARS_RDI_Quality_Clu_141 0 "INVALID" 1 "LOW" 2 "MID" 3 "HIGH" ;
VAL_ 274 ARS_RDI_DynProp_Clu_142 0 "STATIONARY" 1 "MOVING" 2 "AMBIGUOUS" 3 "RESERVED" ;
VAL_ 274 ARS_RDI_Quality_Clu_142 0 "INVALID" 1 "LOW" 2 "MID" 3 "HIGH" ;
VAL_ 274 ARS_RDI_DynProp_Clu_143 0 "STATIONARY" 1 "MOVING" 2 "AMBIGUOUS" 3 "RESERVED" ;
VAL_ 274 ARS_RDI_Quality_Clu_143 0 "INVALID" 1 "LOW" 2 "MID" 3 "HIGH" ;
VAL_ 274 ARS_RDI_DynProp_Clu_136 0 "STATIONARY" 1 "MOVING" 2 "AMBIGUOUS" 3 "RESERVED" ;
VAL_ 274 ARS_RDI_Quality_Clu_136 0 "INVALID" 1 "LOW" 2 "MID" 3 "HIGH" ;
VAL_ 274 ARS_RDI_DynProp_Clu_137 0 "STATIONARY" 1 "MOVING" 2 "AMBIGUOUS" 3 "RESERVED" ;
VAL_ 274 ARS_RDI_Quality_Clu_137 0 "INVALID" 1 "LOW" 2 "MID" 3 "HIGH" ;
VAL_ 275 ARS_RDI_DynProp_Clu_146 0 "STATIONARY" 1 "MOVING" 2 "AMBIGUOUS" 3 "RESERVED" ;
VAL_ 275 ARS_RDI_Quality_Clu_146 0 "INVALID" 1 "LOW" 2 "MID" 3 "HIGH" ;
VAL_ 275 ARS_RDI_DynProp_Clu_147 0 "STATIONARY" 1 "MOVING" 2 "AMBIGUOUS" 3 "RESERVED" ;
VAL_ 275 ARS_RDI_Quality_Clu_147 0 "INVALID" 1 "LOW" 2 "MID" 3 "HIGH" ;
VAL_ 275 ARS_RDI_DynProp_Clu_148 0 "STATIONARY" 1 "MOVING" 2 "AMBIGUOUS" 3 "RESERVED" ;
VAL_ 275 ARS_RDI_Quality_Clu_148 0 "INVALID" 1 "LOW" 2 "MID" 3 "HIGH" ;
VAL_ 275 ARS_RDI_DynProp_Clu_149 0 "STATIONARY" 1 "MOVING" 2 "AMBIGUOUS" 3 "RESERVED" ;
VAL_ 275 ARS_RDI_Quality_Clu_149 0 "INVALID" 1 "LOW" 2 "MID" 3 "HIGH" ;
VAL_ 275 ARS_RDI_DynProp_Clu_150 0 "STATIONARY" 1 "MOVING" 2 "AMBIGUOUS" 3 "RESERVED" ;
VAL_ 275 ARS_RDI_Quality_Clu_150 0 "INVALID" 1 "LOW" 2 "MID" 3 "HIGH" ;
VAL_ 275 ARS_RDI_DynProp_Clu_151 0 "STATIONARY" 1 "MOVING" 2 "AMBIGUOUS" 3 "RESERVED" ;
VAL_ 275 ARS_RDI_Quality_Clu_151 0 "INVALID" 1 "LOW" 2 "MID" 3 "HIGH" ;
VAL_ 275 ARS_RDI_DynProp_Clu_144 0 "STATIONARY" 1 "MOVING" 2 "AMBIGUOUS" 3 "RESERVED" ;
VAL_ 275 ARS_RDI_Quality_Clu_144 0 "INVALID" 1 "LOW" 2 "MID" 3 "HIGH" ;
VAL_ 275 ARS_RDI_DynProp_Clu_145 0 "STATIONARY" 1 "MOVING" 2 "AMBIGUOUS" 3 "RESERVED" ;
VAL_ 275 ARS_RDI_Quality_Clu_145 0 "INVALID" 1 "LOW" 2 "MID" 3 "HIGH" ;
VAL_ 276 ARS_RDI_DynProp_Clu_154 0 "STATIONARY" 1 "MOVING" 2 "AMBIGUOUS" 3 "RESERVED" ;
VAL_ 276 ARS_RDI_Quality_Clu_154 0 "INVALID" 1 "LOW" 2 "MID" 3 "HIGH" ;
VAL_ 276 ARS_RDI_DynProp_Clu_155 0 "STATIONARY" 1 "MOVING" 2 "AMBIGUOUS" 3 "RESERVED" ;
VAL_ 276 ARS_RDI_Quality_Clu_155 0 "INVALID" 1 "LOW" 2 "MID" 3 "HIGH" ;
VAL_ 276 ARS_RDI_DynProp_Clu_156 0 "STATIONARY" 1 "MOVING" 2 "AMBIGUOUS" 3 "RESERVED" ;
VAL_ 276 ARS_RDI_Quality_Clu_156 0 "INVALID" 1 "LOW" 2 "MID" 3 "HIGH" ;
VAL_ 276 ARS_RDI_DynProp_Clu_157 0 "STATIONARY" 1 "MOVING" 2 "AMBIGUOUS" 3 "RESERVED" ;
VAL_ 276 ARS_RDI_Quality_Clu_157 0 "INVALID" 1 "LOW" 2 "MID" 3 "HIGH" ;
VAL_ 276 ARS_RDI_DynProp_Clu_158 0 "STATIONARY" 1 "MOVING" 2 "AMBIGUOUS" 3 "RESERVED" ;
VAL_ 276 ARS_RDI_Quality_Clu_158 0 "INVALID" 1 "LOW" 2 "MID" 3 "HIGH" ;
VAL_ 276 ARS_RDI_DynProp_Clu_159 0 "STATIONARY" 1 "MOVING" 2 "AMBIGUOUS" 3 "RESERVED" ;
VAL_ 276 ARS_RDI_Quality_Clu_159 0 "INVALID" 1 "LOW" 2 "MID" 3 "HIGH" ;
VAL_ 276 ARS_RDI_DynProp_Clu_152 0 "STATIONARY" 1 "MOVING" 2 "AMBIGUOUS" 3 "RESERVED" ;
VAL_ 276 ARS_RDI_Quality_Clu_152 0 "INVALID" 1 "LOW" 2 "MID" 3 "HIGH" ;
VAL_ 276 ARS_RDI_DynProp_Clu_153 0 "STATIONARY" 1 "MOVING" 2 "AMBIGUOUS" 3 "RESERVED" ;
VAL_ 276 ARS_RDI_Quality_Clu_153 0 "INVALID" 1 "LOW" 2 "MID" 3 "HIGH" ;
VAL_ 277 ARS_RDI_DynProp_Clu_162 0 "STATIONARY" 1 "MOVING" 2 "AMBIGUOUS" 3 "RESERVED" ;
VAL_ 277 ARS_RDI_Quality_Clu_162 0 "INVALID" 1 "LOW" 2 "MID" 3 "HIGH" ;
VAL_ 277 ARS_RDI_DynProp_Clu_163 0 "STATIONARY" 1 "MOVING" 2 "AMBIGUOUS" 3 "RESERVED" ;
VAL_ 277 ARS_RDI_Quality_Clu_163 0 "INVALID" 1 "LOW" 2 "MID" 3 "HIGH" ;
VAL_ 277 ARS_RDI_DynProp_Clu_164 0 "STATIONARY" 1 "MOVING" 2 "AMBIGUOUS" 3 "RESERVED" ;
VAL_ 277 ARS_RDI_Quality_Clu_164 0 "INVALID" 1 "LOW" 2 "MID" 3 "HIGH" ;
VAL_ 277 ARS_RDI_DynProp_Clu_165 0 "STATIONARY" 1 "MOVING" 2 "AMBIGUOUS" 3 "RESERVED" ;
VAL_ 277 ARS_RDI_Quality_Clu_165 0 "INVALID" 1 "LOW" 2 "MID" 3 "HIGH" ;
VAL_ 277 ARS_RDI_DynProp_Clu_166 0 "STATIONARY" 1 "MOVING" 2 "AMBIGUOUS" 3 "RESERVED" ;
VAL_ 277 ARS_RDI_Quality_Clu_166 0 "INVALID" 1 "LOW" 2 "MID" 3 "HIGH" ;
VAL_ 277 ARS_RDI_DynProp_Clu_167 0 "STATIONARY" 1 "MOVING" 2 "AMBIGUOUS" 3 "RESERVED" ;
VAL_ 277 ARS_RDI_Quality_Clu_167 0 "INVALID" 1 "LOW" 2 "MID" 3 "HIGH" ;
VAL_ 277 ARS_RDI_DynProp_Clu_160 0 "STATIONARY" 1 "MOVING" 2 "AMBIGUOUS" 3 "RESERVED" ;
VAL_ 277 ARS_RDI_Quality_Clu_160 0 "INVALID" 1 "LOW" 2 "MID" 3 "HIGH" ;
VAL_ 277 ARS_RDI_DynProp_Clu_161 0 "STATIONARY" 1 "MOVING" 2 "AMBIGUOUS" 3 "RESERVED" ;
VAL_ 277 ARS_RDI_Quality_Clu_161 0 "INVALID" 1 "LOW" 2 "MID" 3 "HIGH" ;
VAL_ 278 ARS_RDI_DynProp_Clu_170 0 "STATIONARY" 1 "MOVING" 2 "AMBIGUOUS" 3 "RESERVED" ;
VAL_ 278 ARS_RDI_Quality_Clu_170 0 "INVALID" 1 "LOW" 2 "MID" 3 "HIGH" ;
VAL_ 278 ARS_RDI_DynProp_Clu_171 0 "STATIONARY" 1 "MOVING" 2 "AMBIGUOUS" 3 "RESERVED" ;
VAL_ 278 ARS_RDI_Quality_Clu_171 0 "INVALID" 1 "LOW" 2 "MID" 3 "HIGH" ;
VAL_ 278 ARS_RDI_DynProp_Clu_172 0 "STATIONARY" 1 "MOVING" 2 "AMBIGUOUS" 3 "RESERVED" ;
VAL_ 278 ARS_RDI_Quality_Clu_172 0 "INVALID" 1 "LOW" 2 "MID" 3 "HIGH" ;
VAL_ 278 ARS_RDI_DynProp_Clu_173 0 "STATIONARY" 1 "MOVING" 2 "AMBIGUOUS" 3 "RESERVED" ;
VAL_ 278 ARS_RDI_Quality_Clu_173 0 "INVALID" 1 "LOW" 2 "MID" 3 "HIGH" ;
VAL_ 278 ARS_RDI_DynProp_Clu_174 0 "STATIONARY" 1 "MOVING" 2 "AMBIGUOUS" 3 "RESERVED" ;
VAL_ 278 ARS_RDI_Quality_Clu_174 0 "INVALID" 1 "LOW" 2 "MID" 3 "HIGH" ;
VAL_ 278 ARS_RDI_DynProp_Clu_175 0 "STATIONARY" 1 "MOVING" 2 "AMBIGUOUS" 3 "RESERVED" ;
VAL_ 278 ARS_RDI_Quality_Clu_175 0 "INVALID" 1 "LOW" 2 "MID" 3 "HIGH" ;
VAL_ 278 ARS_RDI_DynProp_Clu_168 0 "STATIONARY" 1 "MOVING" 2 "AMBIGUOUS" 3 "RESERVED" ;
VAL_ 278 ARS_RDI_Quality_Clu_168 0 "INVALID" 1 "LOW" 2 "MID" 3 "HIGH" ;
VAL_ 278 ARS_RDI_DynProp_Clu_169 0 "STATIONARY" 1 "MOVING" 2 "AMBIGUOUS" 3 "RESERVED" ;
VAL_ 278 ARS_RDI_Quality_Clu_169 0 "INVALID" 1 "LOW" 2 "MID" 3 "HIGH" ;
VAL_ 279 ARS_RDI_DynProp_Clu_178 0 "STATIONARY" 1 "MOVING" 2 "AMBIGUOUS" 3 "RESERVED" ;
VAL_ 279 ARS_RDI_Quality_Clu_178 0 "INVALID" 1 "LOW" 2 "MID" 3 "HIGH" ;
VAL_ 279 ARS_RDI_DynProp_Clu_179 0 "STATIONARY" 1 "MOVING" 2 "AMBIGUOUS" 3 "RESERVED" ;
VAL_ 279 ARS_RDI_Quality_Clu_179 0 "INVALID" 1 "LOW" 2 "MID" 3 "HIGH" ;
VAL_ 279 ARS_RDI_DynProp_Clu_180 0 "STATIONARY" 1 "MOVING" 2 "AMBIGUOUS" 3 "RESERVED" ;
VAL_ 279 ARS_RDI_Quality_Clu_180 0 "INVALID" 1 "LOW" 2 "MID" 3 "HIGH" ;
VAL_ 279 ARS_RDI_DynProp_Clu_181 0 "STATIONARY" 1 "MOVING" 2 "AMBIGUOUS" 3 "RESERVED" ;
VAL_ 279 ARS_RDI_Quality_Clu_181 0 "INVALID" 1 "LOW" 2 "MID" 3 "HIGH" ;
VAL_ 279 ARS_RDI_DynProp_Clu_182 0 "STATIONARY" 1 "MOVING" 2 "AMBIGUOUS" 3 "RESERVED" ;
VAL_ 279 ARS_RDI_Quality_Clu_182 0 "INVALID" 1 "LOW" 2 "MID" 3 "HIGH" ;
VAL_ 279 ARS_RDI_DynProp_Clu_183 0 "STATIONARY" 1 "MOVING" 2 "AMBIGUOUS" 3 "RESERVED" ;
VAL_ 279 ARS_RDI_Quality_Clu_183 0 "INVALID" 1 "LOW" 2 "MID" 3 "HIGH" ;
VAL_ 279 ARS_RDI_DynProp_Clu_176 0 "STATIONARY" 1 "MOVING" 2 "AMBIGUOUS" 3 "RESERVED" ;
VAL_ 279 ARS_RDI_Quality_Clu_176 0 "INVALID" 1 "LOW" 2 "MID" 3 "HIGH" ;
VAL_ 279 ARS_RDI_DynProp_Clu_177 0 "STATIONARY" 1 "MOVING" 2 "AMBIGUOUS" 3 "RESERVED" ;
VAL_ 279 ARS_RDI_Quality_Clu_177 0 "INVALID" 1 "LOW" 2 "MID" 3 "HIGH" ;
VAL_ 280 ARS_RDI_DynProp_Clu_186 0 "STATIONARY" 1 "MOVING" 2 "AMBIGUOUS" 3 "RESERVED" ;
VAL_ 280 ARS_RDI_Quality_Clu_186 0 "INVALID" 1 "LOW" 2 "MID" 3 "HIGH" ;
VAL_ 280 ARS_RDI_DynProp_Clu_187 0 "STATIONARY" 1 "MOVING" 2 "AMBIGUOUS" 3 "RESERVED" ;
VAL_ 280 ARS_RDI_Quality_Clu_187 0 "INVALID" 1 "LOW" 2 "MID" 3 "HIGH" ;
VAL_ 280 ARS_RDI_DynProp_Clu_188 0 "STATIONARY" 1 "MOVING" 2 "AMBIGUOUS" 3 "RESERVED" ;
VAL_ 280 ARS_RDI_Quality_Clu_188 0 "INVALID" 1 "LOW" 2 "MID" 3 "HIGH" ;
VAL_ 280 ARS_RDI_DynProp_Clu_189 0 "STATIONARY" 1 "MOVING" 2 "AMBIGUOUS" 3 "RESERVED" ;
VAL_ 280 ARS_RDI_Quality_Clu_189 0 "INVALID" 1 "LOW" 2 "MID" 3 "HIGH" ;
VAL_ 280 ARS_RDI_DynProp_Clu_190 0 "STATIONARY" 1 "MOVING" 2 "AMBIGUOUS" 3 "RESERVED" ;
VAL_ 280 ARS_RDI_Quality_Clu_190 0 "INVALID" 1 "LOW" 2 "MID" 3 "HIGH" ;
VAL_ 280 ARS_RDI_DynProp_Clu_191 0 "STATIONARY" 1 "MOVING" 2 "AMBIGUOUS" 3 "RESERVED" ;
VAL_ 280 ARS_RDI_Quality_Clu_191 0 "INVALID" 1 "LOW" 2 "MID" 3 "HIGH" ;
VAL_ 280 ARS_RDI_DynProp_Clu_184 0 "STATIONARY" 1 "MOVING" 2 "AMBIGUOUS" 3 "RESERVED" ;
VAL_ 280 ARS_RDI_Quality_Clu_184 0 "INVALID" 1 "LOW" 2 "MID" 3 "HIGH" ;
VAL_ 280 ARS_RDI_DynProp_Clu_185 0 "STATIONARY" 1 "MOVING" 2 "AMBIGUOUS" 3 "RESERVED" ;
VAL_ 280 ARS_RDI_Quality_Clu_185 0 "INVALID" 1 "LOW" 2 "MID" 3 "HIGH" ;
VAL_ 281 ARS_RDI_DynProp_Clu_194 0 "STATIONARY" 1 "MOVING" 2 "AMBIGUOUS" 3 "RESERVED" ;
VAL_ 281 ARS_RDI_Quality_Clu_194 0 "INVALID" 1 "LOW" 2 "MID" 3 "HIGH" ;
VAL_ 281 ARS_RDI_DynProp_Clu_195 0 "STATIONARY" 1 "MOVING" 2 "AMBIGUOUS" 3 "RESERVED" ;
VAL_ 281 ARS_RDI_Quality_Clu_195 0 "INVALID" 1 "LOW" 2 "MID" 3 "HIGH" ;
VAL_ 281 ARS_RDI_DynProp_Clu_196 0 "STATIONARY" 1 "MOVING" 2 "AMBIGUOUS" 3 "RESERVED" ;
VAL_ 281 ARS_RDI_Quality_Clu_196 0 "INVALID" 1 "LOW" 2 "MID" 3 "HIGH" ;
VAL_ 281 ARS_RDI_DynProp_Clu_197 0 "STATIONARY" 1 "MOVING" 2 "AMBIGUOUS" 3 "RESERVED" ;
VAL_ 281 ARS_RDI_Quality_Clu_197 0 "INVALID" 1 "LOW" 2 "MID" 3 "HIGH" ;
VAL_ 281 ARS_RDI_DynProp_Clu_198 0 "STATIONARY" 1 "MOVING" 2 "AMBIGUOUS" 3 "RESERVED" ;
VAL_ 281 ARS_RDI_Quality_Clu_198 0 "INVALID" 1 "LOW" 2 "MID" 3 "HIGH" ;
VAL_ 281 ARS_RDI_DynProp_Clu_199 0 "STATIONARY" 1 "MOVING" 2 "AMBIGUOUS" 3 "RESERVED" ;
VAL_ 281 ARS_RDI_Quality_Clu_199 0 "INVALID" 1 "LOW" 2 "MID" 3 "HIGH" ;
VAL_ 281 ARS_RDI_DynProp_Clu_192 0 "STATIONARY" 1 "MOVING" 2 "AMBIGUOUS" 3 "RESERVED" ;
VAL_ 281 ARS_RDI_Quality_Clu_192 0 "INVALID" 1 "LOW" 2 "MID" 3 "HIGH" ;
VAL_ 281 ARS_RDI_DynProp_Clu_193 0 "STATIONARY" 1 "MOVING" 2 "AMBIGUOUS" 3 "RESERVED" ;
VAL_ 281 ARS_RDI_Quality_Clu_193 0 "INVALID" 1 "LOW" 2 "MID" 3 "HIGH" ;
VAL_ 282 ARS_RDI_Obj_ID_Clu_000 62 "indicator that cluster is associated to an internal object" 63 "indicator that cluster is not associated to any object" ;
VAL_ 282 ARS_RDI_Obj_ID_Clu_001 62 "indicator that cluster is associated to an internal object" 63 "indicator that cluster is not associated to any object" ;
VAL_ 282 ARS_RDI_Obj_ID_Clu_017 62 "indicator that cluster is associated to an internal object" 63 "indicator that cluster is not associated to any object" ;
VAL_ 282 ARS_RDI_Obj_ID_Clu_018 62 "indicator that cluster is associated to an internal object" 63 "indicator that cluster is not associated to any object" ;
VAL_ 282 ARS_RDI_Obj_ID_Clu_019 62 "indicator that cluster is associated to an internal object" 63 "indicator that cluster is not associated to any object" ;
VAL_ 282 ARS_RDI_Obj_ID_Clu_020 62 "indicator that cluster is associated to an internal object" 63 "indicator that cluster is not associated to any object" ;
VAL_ 282 ARS_RDI_Obj_ID_Clu_021 62 "indicator that cluster is associated to an internal object" 63 "indicator that cluster is not associated to any object" ;
VAL_ 282 ARS_RDI_Obj_ID_Clu_002 62 "indicator that cluster is associated to an internal object" 63 "indicator that cluster is not associated to any object" ;
VAL_ 282 ARS_RDI_Obj_ID_Clu_022 62 "indicator that cluster is associated to an internal object" 63 "indicator that cluster is not associated to any object" ;
VAL_ 282 ARS_RDI_Obj_ID_Clu_023 62 "indicator that cluster is associated to an internal object" 63 "indicator that cluster is not associated to any object" ;
VAL_ 282 ARS_RDI_Obj_ID_Clu_024 62 "indicator that cluster is associated to an internal object" 63 "indicator that cluster is not associated to any object" ;
VAL_ 282 ARS_RDI_Obj_ID_Clu_025 62 "indicator that cluster is associated to an internal object" 63 "indicator that cluster is not associated to any object" ;
VAL_ 282 ARS_RDI_Obj_ID_Clu_026 62 "indicator that cluster is associated to an internal object" 63 "indicator that cluster is not associated to any object" ;
VAL_ 282 ARS_RDI_Obj_ID_Clu_027 62 "indicator that cluster is associated to an internal object" 63 "indicator that cluster is not associated to any object" ;
VAL_ 282 ARS_RDI_Obj_ID_Clu_028 62 "indicator that cluster is associated to an internal object" 63 "indicator that cluster is not associated to any object" ;
VAL_ 282 ARS_RDI_Obj_ID_Clu_029 62 "indicator that cluster is associated to an internal object" 63 "indicator that cluster is not associated to any object" ;
VAL_ 282 ARS_RDI_Obj_ID_Clu_030 62 "indicator that cluster is associated to an internal object" 63 "indicator that cluster is not associated to any object" ;
VAL_ 282 ARS_RDI_Obj_ID_Clu_031 62 "indicator that cluster is associated to an internal object" 63 "indicator that cluster is not associated to any object" ;
VAL_ 282 ARS_RDI_Obj_ID_Clu_003 62 "indicator that cluster is associated to an internal object" 63 "indicator that cluster is not associated to any object" ;
VAL_ 282 ARS_RDI_Obj_ID_Clu_032 62 "indicator that cluster is associated to an internal object" 63 "indicator that cluster is not associated to any object" ;
VAL_ 282 ARS_RDI_Obj_ID_Clu_033 62 "indicator that cluster is associated to an internal object" 63 "indicator that cluster is not associated to any object" ;
VAL_ 282 ARS_RDI_Obj_ID_Clu_034 62 "indicator that cluster is associated to an internal object" 63 "indicator that cluster is not associated to any object" ;
VAL_ 282 ARS_RDI_Obj_ID_Clu_035 62 "indicator that cluster is associated to an internal object" 63 "indicator that cluster is not associated to any object" ;
VAL_ 282 ARS_RDI_Obj_ID_Clu_036 62 "indicator that cluster is associated to an internal object" 63 "indicator that cluster is not associated to any object" ;
VAL_ 282 ARS_RDI_Obj_ID_Clu_037 62 "indicator that cluster is associated to an internal object" 63 "indicator that cluster is not associated to any object" ;
VAL_ 282 ARS_RDI_Obj_ID_Clu_038 62 "indicator that cluster is associated to an internal object" 63 "indicator that cluster is not associated to any object" ;
VAL_ 282 ARS_RDI_Obj_ID_Clu_039 62 "indicator that cluster is associated to an internal object" 63 "indicator that cluster is not associated to any object" ;
VAL_ 282 ARS_RDI_Obj_ID_Clu_040 62 "indicator that cluster is associated to an internal object" 63 "indicator that cluster is not associated to any object" ;
VAL_ 282 ARS_RDI_Obj_ID_Clu_041 62 "indicator that cluster is associated to an internal object" 63 "indicator that cluster is not associated to any object" ;
VAL_ 282 ARS_RDI_Obj_ID_Clu_004 62 "indicator that cluster is associated to an internal object" 63 "indicator that cluster is not associated to any object" ;
VAL_ 282 ARS_RDI_Obj_ID_Clu_042 62 "indicator that cluster is associated to an internal object" 63 "indicator that cluster is not associated to any object" ;
VAL_ 282 ARS_RDI_Obj_ID_Clu_043 62 "indicator that cluster is associated to an internal object" 63 "indicator that cluster is not associated to any object" ;
VAL_ 282 ARS_RDI_Obj_ID_Clu_044 62 "indicator that cluster is associated to an internal object" 63 "indicator that cluster is not associated to any object" ;
VAL_ 282 ARS_RDI_Obj_ID_Clu_045 62 "indicator that cluster is associated to an internal object" 63 "indicator that cluster is not associated to any object" ;
VAL_ 282 ARS_RDI_Obj_ID_Clu_046 62 "indicator that cluster is associated to an internal object" 63 "indicator that cluster is not associated to any object" ;
VAL_ 282 ARS_RDI_Obj_ID_Clu_047 62 "indicator that cluster is associated to an internal object" 63 "indicator that cluster is not associated to any object" ;
VAL_ 282 ARS_RDI_Obj_ID_Clu_048 62 "indicator that cluster is associated to an internal object" 63 "indicator that cluster is not associated to any object" ;
VAL_ 282 ARS_RDI_Obj_ID_Clu_049 62 "indicator that cluster is associated to an internal object" 63 "indicator that cluster is not associated to any object" ;
VAL_ 282 ARS_RDI_Obj_ID_Clu_050 62 "indicator that cluster is associated to an internal object" 63 "indicator that cluster is not associated to any object" ;
VAL_ 282 ARS_RDI_Obj_ID_Clu_051 62 "indicator that cluster is associated to an internal object" 63 "indicator that cluster is not associated to any object" ;
VAL_ 282 ARS_RDI_Obj_ID_Clu_005 62 "indicator that cluster is associated to an internal object" 63 "indicator that cluster is not associated to any object" ;
VAL_ 282 ARS_RDI_Obj_ID_Clu_052 62 "indicator that cluster is associated to an internal object" 63 "indicator that cluster is not associated to any object" ;
VAL_ 282 ARS_RDI_Obj_ID_Clu_053 62 "indicator that cluster is associated to an internal object" 63 "indicator that cluster is not associated to any object" ;
VAL_ 282 ARS_RDI_Obj_ID_Clu_054 62 "indicator that cluster is associated to an internal object" 63 "indicator that cluster is not associated to any object" ;
VAL_ 282 ARS_RDI_Obj_ID_Clu_055 62 "indicator that cluster is associated to an internal object" 63 "indicator that cluster is not associated to any object" ;
VAL_ 282 ARS_RDI_Obj_ID_Clu_056 62 "indicator that cluster is associated to an internal object" 63 "indicator that cluster is not associated to any object" ;
VAL_ 282 ARS_RDI_Obj_ID_Clu_057 62 "indicator that cluster is associated to an internal object" 63 "indicator that cluster is not associated to any object" ;
VAL_ 282 ARS_RDI_Obj_ID_Clu_058 62 "indicator that cluster is associated to an internal object" 63 "indicator that cluster is not associated to any object" ;
VAL_ 282 ARS_RDI_Obj_ID_Clu_059 62 "indicator that cluster is associated to an internal object" 63 "indicator that cluster is not associated to any object" ;
VAL_ 282 ARS_RDI_Obj_ID_Clu_060 62 "indicator that cluster is associated to an internal object" 63 "indicator that cluster is not associated to any object" ;
VAL_ 282 ARS_RDI_Obj_ID_Clu_061 62 "indicator that cluster is associated to an internal object" 63 "indicator that cluster is not associated to any object" ;
VAL_ 282 ARS_RDI_Obj_ID_Clu_006 62 "indicator that cluster is associated to an internal object" 63 "indicator that cluster is not associated to any object" ;
VAL_ 282 ARS_RDI_Obj_ID_Clu_062 62 "indicator that cluster is associated to an internal object" 63 "indicator that cluster is not associated to any object" ;
VAL_ 282 ARS_RDI_Obj_ID_Clu_063 62 "indicator that cluster is associated to an internal object" 63 "indicator that cluster is not associated to any object" ;
VAL_ 282 ARS_RDI_Obj_ID_Clu_064 62 "indicator that cluster is associated to an internal object" 63 "indicator that cluster is not associated to any object" ;
VAL_ 282 ARS_RDI_Obj_ID_Clu_065 62 "indicator that cluster is associated to an internal object" 63 "indicator that cluster is not associated to any object" ;
VAL_ 282 ARS_RDI_Obj_ID_Clu_066 62 "indicator that cluster is associated to an internal object" 63 "indicator that cluster is not associated to any object" ;
VAL_ 282 ARS_RDI_Obj_ID_Clu_067 62 "indicator that cluster is associated to an internal object" 63 "indicator that cluster is not associated to any object" ;
VAL_ 282 ARS_RDI_Obj_ID_Clu_068 62 "indicator that cluster is associated to an internal object" 63 "indicator that cluster is not associated to any object" ;
VAL_ 282 ARS_RDI_Obj_ID_Clu_069 62 "indicator that cluster is associated to an internal object" 63 "indicator that cluster is not associated to any object" ;
VAL_ 282 ARS_RDI_Obj_ID_Clu_070 62 "indicator that cluster is associated to an internal object" 63 "indicator that cluster is not associated to any object" ;
VAL_ 282 ARS_RDI_Obj_ID_Clu_071 62 "indicator that cluster is associated to an internal object" 63 "indicator that cluster is not associated to any object" ;
VAL_ 282 ARS_RDI_Obj_ID_Clu_007 62 "indicator that cluster is associated to an internal object" 63 "indicator that cluster is not associated to any object" ;
VAL_ 282 ARS_RDI_Obj_ID_Clu_072 62 "indicator that cluster is associated to an internal object" 63 "indicator that cluster is not associated to any object" ;
VAL_ 282 ARS_RDI_Obj_ID_Clu_073 62 "indicator that cluster is associated to an internal object" 63 "indicator that cluster is not associated to any object" ;
VAL_ 282 ARS_RDI_Obj_ID_Clu_074 62 "indicator that cluster is associated to an internal object" 63 "indicator that cluster is not associated to any object" ;
VAL_ 282 ARS_RDI_Obj_ID_Clu_075 62 "indicator that cluster is associated to an internal object" 63 "indicator that cluster is not associated to any object" ;
VAL_ 282 ARS_RDI_Obj_ID_Clu_076 62 "indicator that cluster is associated to an internal object" 63 "indicator that cluster is not associated to any object" ;
VAL_ 282 ARS_RDI_Obj_ID_Clu_077 62 "indicator that cluster is associated to an internal object" 63 "indicator that cluster is not associated to any object" ;
VAL_ 282 ARS_RDI_Obj_ID_Clu_078 62 "indicator that cluster is associated to an internal object" 63 "indicator that cluster is not associated to any object" ;
VAL_ 282 ARS_RDI_Obj_ID_Clu_079 62 "indicator that cluster is associated to an internal object" 63 "indicator that cluster is not associated to any object" ;
VAL_ 282 ARS_RDI_Obj_ID_Clu_008 62 "indicator that cluster is associated to an internal object" 63 "indicator that cluster is not associated to any object" ;
VAL_ 282 ARS_RDI_Obj_ID_Clu_009 62 "indicator that cluster is associated to an internal object" 63 "indicator that cluster is not associated to any object" ;
VAL_ 282 ARS_RDI_Obj_ID_Clu_010 62 "indicator that cluster is associated to an internal object" 63 "indicator that cluster is not associated to any object" ;
VAL_ 282 ARS_RDI_Obj_ID_Clu_011 62 "indicator that cluster is associated to an internal object" 63 "indicator that cluster is not associated to any object" ;
VAL_ 282 ARS_RDI_Obj_ID_Clu_012 62 "indicator that cluster is associated to an internal object" 63 "indicator that cluster is not associated to any object" ;
VAL_ 282 ARS_RDI_Obj_ID_Clu_013 62 "indicator that cluster is associated to an internal object" 63 "indicator that cluster is not associated to any object" ;
VAL_ 282 ARS_RDI_Obj_ID_Clu_014 62 "indicator that cluster is associated to an internal object" 63 "indicator that cluster is not associated to any object" ;
VAL_ 282 ARS_RDI_Obj_ID_Clu_015 62 "indicator that cluster is associated to an internal object" 63 "indicator that cluster is not associated to any object" ;
VAL_ 282 ARS_RDI_Obj_ID_Clu_016 62 "indicator that cluster is associated to an internal object" 63 "indicator that cluster is not associated to any object" ;
VAL_ 283 ARS_RDI_Obj_ID_Clu_080 62 "indicator that cluster is associated to an internal object" 63 "indicator that cluster is not associated to any object" ;
VAL_ 283 ARS_RDI_Obj_ID_Clu_081 62 "indicator that cluster is associated to an internal object" 63 "indicator that cluster is not associated to any object" ;
VAL_ 283 ARS_RDI_Obj_ID_Clu_097 62 "indicator that cluster is associated to an internal object" 63 "indicator that cluster is not associated to any object" ;
VAL_ 283 ARS_RDI_Obj_ID_Clu_098 62 "indicator that cluster is associated to an internal object" 63 "indicator that cluster is not associated to any object" ;
VAL_ 283 ARS_RDI_Obj_ID_Clu_099 62 "indicator that cluster is associated to an internal object" 63 "indicator that cluster is not associated to any object" ;
VAL_ 283 ARS_RDI_Obj_ID_Clu_100 62 "indicator that cluster is associated to an internal object" 63 "indicator that cluster is not associated to any object" ;
VAL_ 283 ARS_RDI_Obj_ID_Clu_101 62 "indicator that cluster is associated to an internal object" 63 "indicator that cluster is not associated to any object" ;
VAL_ 283 ARS_RDI_Obj_ID_Clu_082 62 "indicator that cluster is associated to an internal object" 63 "indicator that cluster is not associated to any object" ;
VAL_ 283 ARS_RDI_Obj_ID_Clu_102 62 "indicator that cluster is associated to an internal object" 63 "indicator that cluster is not associated to any object" ;
VAL_ 283 ARS_RDI_Obj_ID_Clu_103 62 "indicator that cluster is associated to an internal object" 63 "indicator that cluster is not associated to any object" ;
VAL_ 283 ARS_RDI_Obj_ID_Clu_104 62 "indicator that cluster is associated to an internal object" 63 "indicator that cluster is not associated to any object" ;
VAL_ 283 ARS_RDI_Obj_ID_Clu_105 62 "indicator that cluster is associated to an internal object" 63 "indicator that cluster is not associated to any object" ;
VAL_ 283 ARS_RDI_Obj_ID_Clu_106 62 "indicator that cluster is associated to an internal object" 63 "indicator that cluster is not associated to any object" ;
VAL_ 283 ARS_RDI_Obj_ID_Clu_107 62 "indicator that cluster is associated to an internal object" 63 "indicator that cluster is not associated to any object" ;
VAL_ 283 ARS_RDI_Obj_ID_Clu_108 62 "indicator that cluster is associated to an internal object" 63 "indicator that cluster is not associated to any object" ;
VAL_ 283 ARS_RDI_Obj_ID_Clu_109 62 "indicator that cluster is associated to an internal object" 63 "indicator that cluster is not associated to any object" ;
VAL_ 283 ARS_RDI_Obj_ID_Clu_110 62 "indicator that cluster is associated to an internal object" 63 "indicator that cluster is not associated to any object" ;
VAL_ 283 ARS_RDI_Obj_ID_Clu_111 62 "indicator that cluster is associated to an internal object" 63 "indicator that cluster is not associated to any object" ;
VAL_ 283 ARS_RDI_Obj_ID_Clu_083 62 "indicator that cluster is associated to an internal object" 63 "indicator that cluster is not associated to any object" ;
VAL_ 283 ARS_RDI_Obj_ID_Clu_112 62 "indicator that cluster is associated to an internal object" 63 "indicator that cluster is not associated to any object" ;
VAL_ 283 ARS_RDI_Obj_ID_Clu_113 62 "indicator that cluster is associated to an internal object" 63 "indicator that cluster is not associated to any object" ;
VAL_ 283 ARS_RDI_Obj_ID_Clu_114 62 "indicator that cluster is associated to an internal object" 63 "indicator that cluster is not associated to any object" ;
VAL_ 283 ARS_RDI_Obj_ID_Clu_115 62 "indicator that cluster is associated to an internal object" 63 "indicator that cluster is not associated to any object" ;
VAL_ 283 ARS_RDI_Obj_ID_Clu_116 62 "indicator that cluster is associated to an internal object" 63 "indicator that cluster is not associated to any object" ;
VAL_ 283 ARS_RDI_Obj_ID_Clu_117 62 "indicator that cluster is associated to an internal object" 63 "indicator that cluster is not associated to any object" ;
VAL_ 283 ARS_RDI_Obj_ID_Clu_118 62 "indicator that cluster is associated to an internal object" 63 "indicator that cluster is not associated to any object" ;
VAL_ 283 ARS_RDI_Obj_ID_Clu_119 62 "indicator that cluster is associated to an internal object" 63 "indicator that cluster is not associated to any object" ;
VAL_ 283 ARS_RDI_Obj_ID_Clu_120 62 "indicator that cluster is associated to an internal object" 63 "indicator that cluster is not associated to any object" ;
VAL_ 283 ARS_RDI_Obj_ID_Clu_121 62 "indicator that cluster is associated to an internal object" 63 "indicator that cluster is not associated to any object" ;
VAL_ 283 ARS_RDI_Obj_ID_Clu_084 62 "indicator that cluster is associated to an internal object" 63 "indicator that cluster is not associated to any object" ;
VAL_ 283 ARS_RDI_Obj_ID_Clu_122 62 "indicator that cluster is associated to an internal object" 63 "indicator that cluster is not associated to any object" ;
VAL_ 283 ARS_RDI_Obj_ID_Clu_123 62 "indicator that cluster is associated to an internal object" 63 "indicator that cluster is not associated to any object" ;
VAL_ 283 ARS_RDI_Obj_ID_Clu_124 62 "indicator that cluster is associated to an internal object" 63 "indicator that cluster is not associated to any object" ;
VAL_ 283 ARS_RDI_Obj_ID_Clu_125 62 "indicator that cluster is associated to an internal object" 63 "indicator that cluster is not associated to any object" ;
VAL_ 283 ARS_RDI_Obj_ID_Clu_126 62 "indicator that cluster is associated to an internal object" 63 "indicator that cluster is not associated to any object" ;
VAL_ 283 ARS_RDI_Obj_ID_Clu_127 62 "indicator that cluster is associated to an internal object" 63 "indicator that cluster is not associated to any object" ;
VAL_ 283 ARS_RDI_Obj_ID_Clu_128 62 "indicator that cluster is associated to an internal object" 63 "indicator that cluster is not associated to any object" ;
VAL_ 283 ARS_RDI_Obj_ID_Clu_129 62 "indicator that cluster is associated to an internal object" 63 "indicator that cluster is not associated to any object" ;
VAL_ 283 ARS_RDI_Obj_ID_Clu_130 62 "indicator that cluster is associated to an internal object" 63 "indicator that cluster is not associated to any object" ;
VAL_ 283 ARS_RDI_Obj_ID_Clu_131 62 "indicator that cluster is associated to an internal object" 63 "indicator that cluster is not associated to any object" ;
VAL_ 283 ARS_RDI_Obj_ID_Clu_085 62 "indicator that cluster is associated to an internal object" 63 "indicator that cluster is not associated to any object" ;
VAL_ 283 ARS_RDI_Obj_ID_Clu_132 62 "indicator that cluster is associated to an internal object" 63 "indicator that cluster is not associated to any object" ;
VAL_ 283 ARS_RDI_Obj_ID_Clu_133 62 "indicator that cluster is associated to an internal object" 63 "indicator that cluster is not associated to any object" ;
VAL_ 283 ARS_RDI_Obj_ID_Clu_134 62 "indicator that cluster is associated to an internal object" 63 "indicator that cluster is not associated to any object" ;
VAL_ 283 ARS_RDI_Obj_ID_Clu_135 62 "indicator that cluster is associated to an internal object" 63 "indicator that cluster is not associated to any object" ;
VAL_ 283 ARS_RDI_Obj_ID_Clu_136 62 "indicator that cluster is associated to an internal object" 63 "indicator that cluster is not associated to any object" ;
VAL_ 283 ARS_RDI_Obj_ID_Clu_137 62 "indicator that cluster is associated to an internal object" 63 "indicator that cluster is not associated to any object" ;
VAL_ 283 ARS_RDI_Obj_ID_Clu_138 62 "indicator that cluster is associated to an internal object" 63 "indicator that cluster is not associated to any object" ;
VAL_ 283 ARS_RDI_Obj_ID_Clu_139 62 "indicator that cluster is associated to an internal object" 63 "indicator that cluster is not associated to any object" ;
VAL_ 283 ARS_RDI_Obj_ID_Clu_140 62 "indicator that cluster is associated to an internal object" 63 "indicator that cluster is not associated to any object" ;
VAL_ 283 ARS_RDI_Obj_ID_Clu_141 62 "indicator that cluster is associated to an internal object" 63 "indicator that cluster is not associated to any object" ;
VAL_ 283 ARS_RDI_Obj_ID_Clu_086 62 "indicator that cluster is associated to an internal object" 63 "indicator that cluster is not associated to any object" ;
VAL_ 283 ARS_RDI_Obj_ID_Clu_142 62 "indicator that cluster is associated to an internal object" 63 "indicator that cluster is not associated to any object" ;
VAL_ 283 ARS_RDI_Obj_ID_Clu_143 62 "indicator that cluster is associated to an internal object" 63 "indicator that cluster is not associated to any object" ;
VAL_ 283 ARS_RDI_Obj_ID_Clu_144 62 "indicator that cluster is associated to an internal object" 63 "indicator that cluster is not associated to any object" ;
VAL_ 283 ARS_RDI_Obj_ID_Clu_145 62 "indicator that cluster is associated to an internal object" 63 "indicator that cluster is not associated to any object" ;
VAL_ 283 ARS_RDI_Obj_ID_Clu_146 62 "indicator that cluster is associated to an internal object" 63 "indicator that cluster is not associated to any object" ;
VAL_ 283 ARS_RDI_Obj_ID_Clu_147 62 "indicator that cluster is associated to an internal object" 63 "indicator that cluster is not associated to any object" ;
VAL_ 283 ARS_RDI_Obj_ID_Clu_148 62 "indicator that cluster is associated to an internal object" 63 "indicator that cluster is not associated to any object" ;
VAL_ 283 ARS_RDI_Obj_ID_Clu_149 62 "indicator that cluster is associated to an internal object" 63 "indicator that cluster is not associated to any object" ;
VAL_ 283 ARS_RDI_Obj_ID_Clu_150 62 "indicator that cluster is associated to an internal object" 63 "indicator that cluster is not associated to any object" ;
VAL_ 283 ARS_RDI_Obj_ID_Clu_151 62 "indicator that cluster is associated to an internal object" 63 "indicator that cluster is not associated to any object" ;
VAL_ 283 ARS_RDI_Obj_ID_Clu_087 62 "indicator that cluster is associated to an internal object" 63 "indicator that cluster is not associated to any object" ;
VAL_ 283 ARS_RDI_Obj_ID_Clu_152 62 "indicator that cluster is associated to an internal object" 63 "indicator that cluster is not associated to any object" ;
VAL_ 283 ARS_RDI_Obj_ID_Clu_153 62 "indicator that cluster is associated to an internal object" 63 "indicator that cluster is not associated to any object" ;
VAL_ 283 ARS_RDI_Obj_ID_Clu_154 62 "indicator that cluster is associated to an internal object" 63 "indicator that cluster is not associated to any object" ;
VAL_ 283 ARS_RDI_Obj_ID_Clu_155 62 "indicator that cluster is associated to an internal object" 63 "indicator that cluster is not associated to any object" ;
VAL_ 283 ARS_RDI_Obj_ID_Clu_156 62 "indicator that cluster is associated to an internal object" 63 "indicator that cluster is not associated to any object" ;
VAL_ 283 ARS_RDI_Obj_ID_Clu_157 62 "indicator that cluster is associated to an internal object" 63 "indicator that cluster is not associated to any object" ;
VAL_ 283 ARS_RDI_Obj_ID_Clu_158 62 "indicator that cluster is associated to an internal object" 63 "indicator that cluster is not associated to any object" ;
VAL_ 283 ARS_RDI_Obj_ID_Clu_159 62 "indicator that cluster is associated to an internal object" 63 "indicator that cluster is not associated to any object" ;
VAL_ 283 ARS_RDI_Obj_ID_Clu_088 62 "indicator that cluster is associated to an internal object" 63 "indicator that cluster is not associated to any object" ;
VAL_ 283 ARS_RDI_Obj_ID_Clu_089 62 "indicator that cluster is associated to an internal object" 63 "indicator that cluster is not associated to any object" ;
VAL_ 283 ARS_RDI_Obj_ID_Clu_090 62 "indicator that cluster is associated to an internal object" 63 "indicator that cluster is not associated to any object" ;
VAL_ 283 ARS_RDI_Obj_ID_Clu_091 62 "indicator that cluster is associated to an internal object" 63 "indicator that cluster is not associated to any object" ;
VAL_ 283 ARS_RDI_Obj_ID_Clu_092 62 "indicator that cluster is associated to an internal object" 63 "indicator that cluster is not associated to any object" ;
VAL_ 283 ARS_RDI_Obj_ID_Clu_093 62 "indicator that cluster is associated to an internal object" 63 "indicator that cluster is not associated to any object" ;
VAL_ 283 ARS_RDI_Obj_ID_Clu_094 62 "indicator that cluster is associated to an internal object" 63 "indicator that cluster is not associated to any object" ;
VAL_ 283 ARS_RDI_Obj_ID_Clu_095 62 "indicator that cluster is associated to an internal object" 63 "indicator that cluster is not associated to any object" ;
VAL_ 283 ARS_RDI_Obj_ID_Clu_096 62 "indicator that cluster is associated to an internal object" 63 "indicator that cluster is not associated to any object" ;
VAL_ 284 ARS_RDI_Obj_ID_Clu_160 62 "indicator that cluster is associated to an internal object" 63 "indicator that cluster is not associated to any object" ;
VAL_ 284 ARS_RDI_Obj_ID_Clu_161 62 "indicator that cluster is associated to an internal object" 63 "indicator that cluster is not associated to any object" ;
VAL_ 284 ARS_RDI_Obj_ID_Clu_177 62 "indicator that cluster is associated to an internal object" 63 "indicator that cluster is not associated to any object" ;
VAL_ 284 ARS_RDI_Obj_ID_Clu_178 62 "indicator that cluster is associated to an internal object" 63 "indicator that cluster is not associated to any object" ;
VAL_ 284 ARS_RDI_Obj_ID_Clu_179 62 "indicator that cluster is associated to an internal object" 63 "indicator that cluster is not associated to any object" ;
VAL_ 284 ARS_RDI_Obj_ID_Clu_180 62 "indicator that cluster is associated to an internal object" 63 "indicator that cluster is not associated to any object" ;
VAL_ 284 ARS_RDI_Obj_ID_Clu_181 62 "indicator that cluster is associated to an internal object" 63 "indicator that cluster is not associated to any object" ;
VAL_ 284 ARS_RDI_Obj_ID_Clu_162 62 "indicator that cluster is associated to an internal object" 63 "indicator that cluster is not associated to any object" ;
VAL_ 284 ARS_RDI_Obj_ID_Clu_182 62 "indicator that cluster is associated to an internal object" 63 "indicator that cluster is not associated to any object" ;
VAL_ 284 ARS_RDI_Obj_ID_Clu_183 62 "indicator that cluster is associated to an internal object" 63 "indicator that cluster is not associated to any object" ;
VAL_ 284 ARS_RDI_Obj_ID_Clu_184 62 "indicator that cluster is associated to an internal object" 63 "indicator that cluster is not associated to any object" ;
VAL_ 284 ARS_RDI_Obj_ID_Clu_185 62 "indicator that cluster is associated to an internal object" 63 "indicator that cluster is not associated to any object" ;
VAL_ 284 ARS_RDI_Obj_ID_Clu_186 62 "indicator that cluster is associated to an internal object" 63 "indicator that cluster is not associated to any object" ;
VAL_ 284 ARS_RDI_Obj_ID_Clu_187 62 "indicator that cluster is associated to an internal object" 63 "indicator that cluster is not associated to any object" ;
VAL_ 284 ARS_RDI_Obj_ID_Clu_188 62 "indicator that cluster is associated to an internal object" 63 "indicator that cluster is not associated to any object" ;
VAL_ 284 ARS_RDI_Obj_ID_Clu_189 62 "indicator that cluster is associated to an internal object" 63 "indicator that cluster is not associated to any object" ;
VAL_ 284 ARS_RDI_Obj_ID_Clu_190 62 "indicator that cluster is associated to an internal object" 63 "indicator that cluster is not associated to any object" ;
VAL_ 284 ARS_RDI_Obj_ID_Clu_191 62 "indicator that cluster is associated to an internal object" 63 "indicator that cluster is not associated to any object" ;
VAL_ 284 ARS_RDI_Obj_ID_Clu_163 62 "indicator that cluster is associated to an internal object" 63 "indicator that cluster is not associated to any object" ;
VAL_ 284 ARS_RDI_Obj_ID_Clu_192 62 "indicator that cluster is associated to an internal object" 63 "indicator that cluster is not associated to any object" ;
VAL_ 284 ARS_RDI_Obj_ID_Clu_193 62 "indicator that cluster is associated to an internal object" 63 "indicator that cluster is not associated to any object" ;
VAL_ 284 ARS_RDI_Obj_ID_Clu_194 62 "indicator that cluster is associated to an internal object" 63 "indicator that cluster is not associated to any object" ;
VAL_ 284 ARS_RDI_Obj_ID_Clu_195 62 "indicator that cluster is associated to an internal object" 63 "indicator that cluster is not associated to any object" ;
VAL_ 284 ARS_RDI_Obj_ID_Clu_196 62 "indicator that cluster is associated to an internal object" 63 "indicator that cluster is not associated to any object" ;
VAL_ 284 ARS_RDI_Obj_ID_Clu_197 62 "indicator that cluster is associated to an internal object" 63 "indicator that cluster is not associated to any object" ;
VAL_ 284 ARS_RDI_Obj_ID_Clu_198 62 "indicator that cluster is associated to an internal object" 63 "indicator that cluster is not associated to any object" ;
VAL_ 284 ARS_RDI_Obj_ID_Clu_199 62 "indicator that cluster is associated to an internal object" 63 "indicator that cluster is not associated to any object" ;
VAL_ 284 ARS_RDI_Obj_ID_Clu_164 62 "indicator that cluster is associated to an internal object" 63 "indicator that cluster is not associated to any object" ;
VAL_ 284 ARS_RDI_Obj_ID_Clu_165 62 "indicator that cluster is associated to an internal object" 63 "indicator that cluster is not associated to any object" ;
VAL_ 284 ARS_RDI_Obj_ID_Clu_166 62 "indicator that cluster is associated to an internal object" 63 "indicator that cluster is not associated to any object" ;
VAL_ 284 ARS_RDI_Obj_ID_Clu_167 62 "indicator that cluster is associated to an internal object" 63 "indicator that cluster is not associated to any object" ;
VAL_ 284 ARS_RDI_Obj_ID_Clu_168 62 "indicator that cluster is associated to an internal object" 63 "indicator that cluster is not associated to any object" ;
VAL_ 284 ARS_RDI_Obj_ID_Clu_169 62 "indicator that cluster is associated to an internal object" 63 "indicator that cluster is not associated to any object" ;
VAL_ 284 ARS_RDI_Obj_ID_Clu_170 62 "indicator that cluster is associated to an internal object" 63 "indicator that cluster is not associated to any object" ;
VAL_ 284 ARS_RDI_Obj_ID_Clu_171 62 "indicator that cluster is associated to an internal object" 63 "indicator that cluster is not associated to any object" ;
VAL_ 284 ARS_RDI_Obj_ID_Clu_172 62 "indicator that cluster is associated to an internal object" 63 "indicator that cluster is not associated to any object" ;
VAL_ 284 ARS_RDI_Obj_ID_Clu_173 62 "indicator that cluster is associated to an internal object" 63 "indicator that cluster is not associated to any object" ;
VAL_ 284 ARS_RDI_Obj_ID_Clu_174 62 "indicator that cluster is associated to an internal object" 63 "indicator that cluster is not associated to any object" ;
VAL_ 284 ARS_RDI_Obj_ID_Clu_175 62 "indicator that cluster is associated to an internal object" 63 "indicator that cluster is not associated to any object" ;
VAL_ 284 ARS_RDI_Obj_ID_Clu_176 62 "indicator that cluster is associated to an internal object" 63 "indicator that cluster is not associated to any object" ;
VAL_ 285 ARS_RDI_DynProp_Clu_202 0 "STATIONARY" 1 "MOVING" 2 "AMBIGUOUS" 3 "RESERVED" ;
VAL_ 285 ARS_RDI_Quality_Clu_202 0 "INVALID" 1 "LOW" 2 "MID" 3 "HIGH" ;
VAL_ 285 ARS_RDI_DynProp_Clu_203 0 "STATIONARY" 1 "MOVING" 2 "AMBIGUOUS" 3 "RESERVED" ;
VAL_ 285 ARS_RDI_Quality_Clu_203 0 "INVALID" 1 "LOW" 2 "MID" 3 "HIGH" ;
VAL_ 285 ARS_RDI_DynProp_Clu_204 0 "STATIONARY" 1 "MOVING" 2 "AMBIGUOUS" 3 "RESERVED" ;
VAL_ 285 ARS_RDI_Quality_Clu_204 0 "INVALID" 1 "LOW" 2 "MID" 3 "HIGH" ;
VAL_ 285 ARS_RDI_DynProp_Clu_205 0 "STATIONARY" 1 "MOVING" 2 "AMBIGUOUS" 3 "RESERVED" ;
VAL_ 285 ARS_RDI_Quality_Clu_205 0 "INVALID" 1 "LOW" 2 "MID" 3 "HIGH" ;
VAL_ 285 ARS_RDI_DynProp_Clu_206 0 "STATIONARY" 1 "MOVING" 2 "AMBIGUOUS" 3 "RESERVED" ;
VAL_ 285 ARS_RDI_Quality_Clu_206 0 "INVALID" 1 "LOW" 2 "MID" 3 "HIGH" ;
VAL_ 285 ARS_RDI_DynProp_Clu_207 0 "STATIONARY" 1 "MOVING" 2 "AMBIGUOUS" 3 "RESERVED" ;
VAL_ 285 ARS_RDI_Quality_Clu_207 0 "INVALID" 1 "LOW" 2 "MID" 3 "HIGH" ;
VAL_ 285 ARS_RDI_DynProp_Clu_200 0 "STATIONARY" 1 "MOVING" 2 "AMBIGUOUS" 3 "RESERVED" ;
VAL_ 285 ARS_RDI_Quality_Clu_200 0 "INVALID" 1 "LOW" 2 "MID" 3 "HIGH" ;
VAL_ 285 ARS_RDI_DynProp_Clu_201 0 "STATIONARY" 1 "MOVING" 2 "AMBIGUOUS" 3 "RESERVED" ;
VAL_ 285 ARS_RDI_Quality_Clu_201 0 "INVALID" 1 "LOW" 2 "MID" 3 "HIGH" ;
VAL_ 286 ARS_RDI_DynProp_Clu_210 0 "STATIONARY" 1 "MOVING" 2 "AMBIGUOUS" 3 "RESERVED" ;
VAL_ 286 ARS_RDI_Quality_Clu_210 0 "INVALID" 1 "LOW" 2 "MID" 3 "HIGH" ;
VAL_ 286 ARS_RDI_DynProp_Clu_211 0 "STATIONARY" 1 "MOVING" 2 "AMBIGUOUS" 3 "RESERVED" ;
VAL_ 286 ARS_RDI_Quality_Clu_211 0 "INVALID" 1 "LOW" 2 "MID" 3 "HIGH" ;
VAL_ 286 ARS_RDI_DynProp_Clu_212 0 "STATIONARY" 1 "MOVING" 2 "AMBIGUOUS" 3 "RESERVED" ;
VAL_ 286 ARS_RDI_Quality_Clu_212 0 "INVALID" 1 "LOW" 2 "MID" 3 "HIGH" ;
VAL_ 286 ARS_RDI_DynProp_Clu_213 0 "STATIONARY" 1 "MOVING" 2 "AMBIGUOUS" 3 "RESERVED" ;
VAL_ 286 ARS_RDI_Quality_Clu_213 0 "INVALID" 1 "LOW" 2 "MID" 3 "HIGH" ;
VAL_ 286 ARS_RDI_DynProp_Clu_214 0 "STATIONARY" 1 "MOVING" 2 "AMBIGUOUS" 3 "RESERVED" ;
VAL_ 286 ARS_RDI_Quality_Clu_214 0 "INVALID" 1 "LOW" 2 "MID" 3 "HIGH" ;
VAL_ 286 ARS_RDI_DynProp_Clu_215 0 "STATIONARY" 1 "MOVING" 2 "AMBIGUOUS" 3 "RESERVED" ;
VAL_ 286 ARS_RDI_Quality_Clu_215 0 "INVALID" 1 "LOW" 2 "MID" 3 "HIGH" ;
VAL_ 286 ARS_RDI_DynProp_Clu_208 0 "STATIONARY" 1 "MOVING" 2 "AMBIGUOUS" 3 "RESERVED" ;
VAL_ 286 ARS_RDI_Quality_Clu_208 0 "INVALID" 1 "LOW" 2 "MID" 3 "HIGH" ;
VAL_ 286 ARS_RDI_DynProp_Clu_209 0 "STATIONARY" 1 "MOVING" 2 "AMBIGUOUS" 3 "RESERVED" ;
VAL_ 286 ARS_RDI_Quality_Clu_209 0 "INVALID" 1 "LOW" 2 "MID" 3 "HIGH" ;
VAL_ 287 ARS_RDI_DynProp_Clu_218 0 "STATIONARY" 1 "MOVING" 2 "AMBIGUOUS" 3 "RESERVED" ;
VAL_ 287 ARS_RDI_Quality_Clu_218 0 "INVALID" 1 "LOW" 2 "MID" 3 "HIGH" ;
VAL_ 287 ARS_RDI_DynProp_Clu_219 0 "STATIONARY" 1 "MOVING" 2 "AMBIGUOUS" 3 "RESERVED" ;
VAL_ 287 ARS_RDI_Quality_Clu_219 0 "INVALID" 1 "LOW" 2 "MID" 3 "HIGH" ;
VAL_ 287 ARS_RDI_DynProp_Clu_220 0 "STATIONARY" 1 "MOVING" 2 "AMBIGUOUS" 3 "RESERVED" ;
VAL_ 287 ARS_RDI_Quality_Clu_220 0 "INVALID" 1 "LOW" 2 "MID" 3 "HIGH" ;
VAL_ 287 ARS_RDI_DynProp_Clu_221 0 "STATIONARY" 1 "MOVING" 2 "AMBIGUOUS" 3 "RESERVED" ;
VAL_ 287 ARS_RDI_Quality_Clu_221 0 "INVALID" 1 "LOW" 2 "MID" 3 "HIGH" ;
VAL_ 287 ARS_RDI_DynProp_Clu_222 0 "STATIONARY" 1 "MOVING" 2 "AMBIGUOUS" 3 "RESERVED" ;
VAL_ 287 ARS_RDI_Quality_Clu_222 0 "INVALID" 1 "LOW" 2 "MID" 3 "HIGH" ;
VAL_ 287 ARS_RDI_DynProp_Clu_223 0 "STATIONARY" 1 "MOVING" 2 "AMBIGUOUS" 3 "RESERVED" ;
VAL_ 287 ARS_RDI_Quality_Clu_223 0 "INVALID" 1 "LOW" 2 "MID" 3 "HIGH" ;
VAL_ 287 ARS_RDI_DynProp_Clu_216 0 "STATIONARY" 1 "MOVING" 2 "AMBIGUOUS" 3 "RESERVED" ;
VAL_ 287 ARS_RDI_Quality_Clu_216 0 "INVALID" 1 "LOW" 2 "MID" 3 "HIGH" ;
VAL_ 287 ARS_RDI_DynProp_Clu_217 0 "STATIONARY" 1 "MOVING" 2 "AMBIGUOUS" 3 "RESERVED" ;
VAL_ 287 ARS_RDI_Quality_Clu_217 0 "INVALID" 1 "LOW" 2 "MID" 3 "HIGH" ;
SIG_GROUP_ 273 Signal_Group_ARS_RDI_128_135 1 : ARS_RDI_Range_Clu_128 ARS_RDI_ElevationAng_Clu_129 ARS_RDI_SNR_Clu_129 ARS_RDI_Range_Clu_130 ARS_RDI_VradRel_Clu_128 ARS_RDI_VradRel_Clu_130 ARS_RDI_RCS_Clu_130 ARS_RDI_AzimuthAng_Clu_130 ARS_RDI_ElevationAng_Clu_130 ARS_RDI_SNR_Clu_130 ARS_RDI_DynProp_Clu_130 ARS_RDI_Quality_Clu_130 ARS_RDI_DynProp_Clu_131 ARS_RDI_Quality_Clu_131 ARS_RDI_Range_Clu_131 ARS_RDI_VradRel_Clu_131 ARS_RDI_RCS_Clu_131 ARS_RDI_AzimuthAng_Clu_131 ARS_RDI_ElevationAng_Clu_131 ARS_RDI_SNR_Clu_131 ARS_RDI_RCS_Clu_128 ARS_RDI_Range_Clu_132 ARS_RDI_VradRel_Clu_132 ARS_RDI_RCS_Clu_132 ARS_RDI_AzimuthAng_Clu_132 ARS_RDI_ElevationAng_Clu_132 ARS_RDI_SNR_Clu_132 ARS_RDI_DynProp_Clu_132 ARS_RDI_Quality_Clu_132 ARS_RDI_DynProp_Clu_133 ARS_RDI_Quality_Clu_133 ARS_RDI_Range_Clu_133 ARS_RDI_VradRel_Clu_133 ARS_RDI_RCS_Clu_133 ARS_RDI_AzimuthAng_Clu_128 ARS_RDI_AzimuthAng_Clu_133 ARS_RDI_ElevationAng_Clu_133 ARS_RDI_SNR_Clu_133 ARS_RDI_Range_Clu_134 ARS_RDI_VradRel_Clu_134 ARS_RDI_RCS_Clu_134 ARS_RDI_AzimuthAng_Clu_134 ARS_RDI_ElevationAng_Clu_134 ARS_RDI_SNR_Clu_134 ARS_RDI_DynProp_Clu_134 ARS_RDI_Quality_Clu_134 ARS_RDI_DynProp_Clu_135 ARS_RDI_Quality_Clu_135 ARS_RDI_Range_Clu_135 ARS_RDI_ElevationAng_Clu_128 ARS_RDI_VradRel_Clu_135 ARS_RDI_RCS_Clu_135 ARS_RDI_AzimuthAng_Clu_135 ARS_RDI_ElevationAng_Clu_135 ARS_RDI_SNR_Clu_135 ARS_RDI_MsgCounter_Clu_128_135 ARS_RDI_CRC16_Checksum_Clu_128_1 ARS_RDI_SNR_Clu_128 ARS_RDI_DynProp_Clu_128 ARS_RDI_Quality_Clu_128 ARS_RDI_DynProp_Clu_129 ARS_RDI_Quality_Clu_129 ARS_RDI_Range_Clu_129 ARS_RDI_VradRel_Clu_129 ARS_RDI_RCS_Clu_129 ARS_RDI_AzimuthAng_Clu_129;
SIG_GROUP_ 274 Signal_Group_ARS_RDI_136_143 1 : ARS_RDI_Range_Clu_136 ARS_RDI_ElevationAng_Clu_137 ARS_RDI_SNR_Clu_137 ARS_RDI_Range_Clu_138 ARS_RDI_VradRel_Clu_136 ARS_RDI_VradRel_Clu_138 ARS_RDI_RCS_Clu_138 ARS_RDI_AzimuthAng_Clu_138 ARS_RDI_ElevationAng_Clu_138 ARS_RDI_SNR_Clu_138 ARS_RDI_DynProp_Clu_138 ARS_RDI_Quality_Clu_138 ARS_RDI_DynProp_Clu_139 ARS_RDI_Quality_Clu_139 ARS_RDI_Range_Clu_139 ARS_RDI_VradRel_Clu_139 ARS_RDI_RCS_Clu_139 ARS_RDI_AzimuthAng_Clu_139 ARS_RDI_ElevationAng_Clu_139 ARS_RDI_SNR_Clu_139 ARS_RDI_RCS_Clu_136 ARS_RDI_Range_Clu_140 ARS_RDI_VradRel_Clu_140 ARS_RDI_RCS_Clu_140 ARS_RDI_AzimuthAng_Clu_140 ARS_RDI_ElevationAng_Clu_140 ARS_RDI_SNR_Clu_140 ARS_RDI_DynProp_Clu_140 ARS_RDI_Quality_Clu_140 ARS_RDI_DynProp_Clu_141 ARS_RDI_Quality_Clu_141 ARS_RDI_Range_Clu_141 ARS_RDI_VradRel_Clu_141 ARS_RDI_RCS_Clu_141 ARS_RDI_AzimuthAng_Clu_136 ARS_RDI_AzimuthAng_Clu_141 ARS_RDI_ElevationAng_Clu_141 ARS_RDI_SNR_Clu_141 ARS_RDI_Range_Clu_142 ARS_RDI_VradRel_Clu_142 ARS_RDI_RCS_Clu_142 ARS_RDI_AzimuthAng_Clu_142 ARS_RDI_ElevationAng_Clu_142 ARS_RDI_SNR_Clu_142 ARS_RDI_DynProp_Clu_142 ARS_RDI_Quality_Clu_142 ARS_RDI_DynProp_Clu_143 ARS_RDI_Quality_Clu_143 ARS_RDI_Range_Clu_143 ARS_RDI_ElevationAng_Clu_136 ARS_RDI_VradRel_Clu_143 ARS_RDI_RCS_Clu_143 ARS_RDI_AzimuthAng_Clu_143 ARS_RDI_ElevationAng_Clu_143 ARS_RDI_SNR_Clu_143 ARS_RDI_MsgCounter_Clu_136_143 ARS_RDI_CRC16_Checksum_Clu_136_1 ARS_RDI_SNR_Clu_136 ARS_RDI_DynProp_Clu_136 ARS_RDI_Quality_Clu_136 ARS_RDI_DynProp_Clu_137 ARS_RDI_Quality_Clu_137 ARS_RDI_Range_Clu_137 ARS_RDI_VradRel_Clu_137 ARS_RDI_RCS_Clu_137 ARS_RDI_AzimuthAng_Clu_137;
SIG_GROUP_ 275 Signal_Group_ARS_RDI_144_151 1 : ARS_RDI_Range_Clu_144 ARS_RDI_ElevationAng_Clu_145 ARS_RDI_SNR_Clu_145 ARS_RDI_Range_Clu_146 ARS_RDI_VradRel_Clu_144 ARS_RDI_VradRel_Clu_146 ARS_RDI_RCS_Clu_146 ARS_RDI_AzimuthAng_Clu_146 ARS_RDI_ElevationAng_Clu_146 ARS_RDI_SNR_Clu_146 ARS_RDI_DynProp_Clu_146 ARS_RDI_Quality_Clu_146 ARS_RDI_DynProp_Clu_147 ARS_RDI_Quality_Clu_147 ARS_RDI_Range_Clu_147 ARS_RDI_VradRel_Clu_147 ARS_RDI_RCS_Clu_147 ARS_RDI_AzimuthAng_Clu_147 ARS_RDI_ElevationAng_Clu_147 ARS_RDI_SNR_Clu_147 ARS_RDI_RCS_Clu_144 ARS_RDI_Range_Clu_148 ARS_RDI_VradRel_Clu_148 ARS_RDI_RCS_Clu_148 ARS_RDI_AzimuthAng_Clu_148 ARS_RDI_ElevationAng_Clu_148 ARS_RDI_SNR_Clu_148 ARS_RDI_DynProp_Clu_148 ARS_RDI_Quality_Clu_148 ARS_RDI_DynProp_Clu_149 ARS_RDI_Quality_Clu_149 ARS_RDI_Range_Clu_149 ARS_RDI_VradRel_Clu_149 ARS_RDI_RCS_Clu_149 ARS_RDI_AzimuthAng_Clu_144 ARS_RDI_AzimuthAng_Clu_149 ARS_RDI_ElevationAng_Clu_149 ARS_RDI_SNR_Clu_149 ARS_RDI_Range_Clu_150 ARS_RDI_VradRel_Clu_150 ARS_RDI_RCS_Clu_150 ARS_RDI_AzimuthAng_Clu_150 ARS_RDI_ElevationAng_Clu_150 ARS_RDI_SNR_Clu_150 ARS_RDI_DynProp_Clu_150 ARS_RDI_Quality_Clu_150 ARS_RDI_DynProp_Clu_151 ARS_RDI_Quality_Clu_151 ARS_RDI_Range_Clu_151 ARS_RDI_ElevationAng_Clu_144 ARS_RDI_VradRel_Clu_151 ARS_RDI_RCS_Clu_151 ARS_RDI_AzimuthAng_Clu_151 ARS_RDI_ElevationAng_Clu_151 ARS_RDI_SNR_Clu_151 ARS_RDI_MsgCounter_Clu_144_151 ARS_RDI_CRC16_Checksum_Clu_144_1 ARS_RDI_SNR_Clu_144 ARS_RDI_DynProp_Clu_144 ARS_RDI_Quality_Clu_144 ARS_RDI_DynProp_Clu_145 ARS_RDI_Quality_Clu_145 ARS_RDI_Range_Clu_145 ARS_RDI_VradRel_Clu_145 ARS_RDI_RCS_Clu_145 ARS_RDI_AzimuthAng_Clu_145;
SIG_GROUP_ 276 Signal_Group_ARS_RDI_152_159 1 : ARS_RDI_Range_Clu_152 ARS_RDI_ElevationAng_Clu_153 ARS_RDI_SNR_Clu_153 ARS_RDI_Range_Clu_154 ARS_RDI_VradRel_Clu_152 ARS_RDI_VradRel_Clu_154 ARS_RDI_RCS_Clu_154 ARS_RDI_AzimuthAng_Clu_154 ARS_RDI_ElevationAng_Clu_154 ARS_RDI_SNR_Clu_154 ARS_RDI_DynProp_Clu_154 ARS_RDI_Quality_Clu_154 ARS_RDI_DynProp_Clu_155 ARS_RDI_Quality_Clu_155 ARS_RDI_Range_Clu_155 ARS_RDI_VradRel_Clu_155 ARS_RDI_RCS_Clu_155 ARS_RDI_AzimuthAng_Clu_155 ARS_RDI_ElevationAng_Clu_155 ARS_RDI_SNR_Clu_155 ARS_RDI_RCS_Clu_152 ARS_RDI_Range_Clu_156 ARS_RDI_VradRel_Clu_156 ARS_RDI_RCS_Clu_156 ARS_RDI_AzimuthAng_Clu_156 ARS_RDI_ElevationAng_Clu_156 ARS_RDI_SNR_Clu_156 ARS_RDI_DynProp_Clu_156 ARS_RDI_Quality_Clu_156 ARS_RDI_DynProp_Clu_157 ARS_RDI_Quality_Clu_157 ARS_RDI_Range_Clu_157 ARS_RDI_VradRel_Clu_157 ARS_RDI_RCS_Clu_157 ARS_RDI_AzimuthAng_Clu_152 ARS_RDI_AzimuthAng_Clu_157 ARS_RDI_ElevationAng_Clu_157 ARS_RDI_SNR_Clu_157 ARS_RDI_Range_Clu_158 ARS_RDI_VradRel_Clu_158 ARS_RDI_RCS_Clu_158 ARS_RDI_AzimuthAng_Clu_158 ARS_RDI_ElevationAng_Clu_158 ARS_RDI_SNR_Clu_158 ARS_RDI_DynProp_Clu_158 ARS_RDI_Quality_Clu_158 ARS_RDI_DynProp_Clu_159 ARS_RDI_Quality_Clu_159 ARS_RDI_Range_Clu_159 ARS_RDI_ElevationAng_Clu_152 ARS_RDI_VradRel_Clu_159 ARS_RDI_RCS_Clu_159 ARS_RDI_AzimuthAng_Clu_159 ARS_RDI_ElevationAng_Clu_159 ARS_RDI_SNR_Clu_159 ARS_RDI_MsgCounter_Clu_152_159 ARS_RDI_CRC16_Checksum_Clu_152_1 ARS_RDI_SNR_Clu_152 ARS_RDI_DynProp_Clu_152 ARS_RDI_Quality_Clu_152 ARS_RDI_DynProp_Clu_153 ARS_RDI_Quality_Clu_153 ARS_RDI_Range_Clu_153 ARS_RDI_VradRel_Clu_153 ARS_RDI_RCS_Clu_153 ARS_RDI_AzimuthAng_Clu_153;
SIG_GROUP_ 277 Signal_Group_ARS_RDI_160_167 1 : ARS_RDI_Range_Clu_160 ARS_RDI_ElevationAng_Clu_161 ARS_RDI_SNR_Clu_161 ARS_RDI_Range_Clu_162 ARS_RDI_VradRel_Clu_160 ARS_RDI_VradRel_Clu_162 ARS_RDI_RCS_Clu_162 ARS_RDI_AzimuthAng_Clu_162 ARS_RDI_ElevationAng_Clu_162 ARS_RDI_SNR_Clu_162 ARS_RDI_DynProp_Clu_162 ARS_RDI_Quality_Clu_162 ARS_RDI_DynProp_Clu_163 ARS_RDI_Quality_Clu_163 ARS_RDI_Range_Clu_163 ARS_RDI_VradRel_Clu_163 ARS_RDI_RCS_Clu_163 ARS_RDI_AzimuthAng_Clu_163 ARS_RDI_ElevationAng_Clu_163 ARS_RDI_SNR_Clu_163 ARS_RDI_RCS_Clu_160 ARS_RDI_Range_Clu_164 ARS_RDI_VradRel_Clu_164 ARS_RDI_RCS_Clu_164 ARS_RDI_AzimuthAng_Clu_164 ARS_RDI_ElevationAng_Clu_164 ARS_RDI_SNR_Clu_164 ARS_RDI_DynProp_Clu_164 ARS_RDI_Quality_Clu_164 ARS_RDI_DynProp_Clu_165 ARS_RDI_Quality_Clu_165 ARS_RDI_Range_Clu_165 ARS_RDI_VradRel_Clu_165 ARS_RDI_RCS_Clu_165 ARS_RDI_AzimuthAng_Clu_160 ARS_RDI_AzimuthAng_Clu_165 ARS_RDI_ElevationAng_Clu_165 ARS_RDI_SNR_Clu_165 ARS_RDI_Range_Clu_166 ARS_RDI_VradRel_Clu_166 ARS_RDI_RCS_Clu_166 ARS_RDI_AzimuthAng_Clu_166 ARS_RDI_ElevationAng_Clu_166 ARS_RDI_SNR_Clu_166 ARS_RDI_DynProp_Clu_166 ARS_RDI_Quality_Clu_166 ARS_RDI_DynProp_Clu_167 ARS_RDI_Quality_Clu_167 ARS_RDI_Range_Clu_167 ARS_RDI_ElevationAng_Clu_160 ARS_RDI_VradRel_Clu_167 ARS_RDI_RCS_Clu_167 ARS_RDI_AzimuthAng_Clu_167 ARS_RDI_ElevationAng_Clu_167 ARS_RDI_SNR_Clu_167 ARS_RDI_MsgCounter_Clu_160_167 ARS_RDI_CRC16_Checksum_Clu_160_1 ARS_RDI_SNR_Clu_160 ARS_RDI_DynProp_Clu_160 ARS_RDI_Quality_Clu_160 ARS_RDI_DynProp_Clu_161 ARS_RDI_Quality_Clu_161 ARS_RDI_Range_Clu_161 ARS_RDI_VradRel_Clu_161 ARS_RDI_RCS_Clu_161 ARS_RDI_AzimuthAng_Clu_161;
SIG_GROUP_ 278 Signal_Group_ARS_RDI_168_175 1 : ARS_RDI_Range_Clu_168 ARS_RDI_ElevationAng_Clu_169 ARS_RDI_SNR_Clu_169 ARS_RDI_Range_Clu_170 ARS_RDI_VradRel_Clu_168 ARS_RDI_VradRel_Clu_170 ARS_RDI_RCS_Clu_170 ARS_RDI_AzimuthAng_Clu_170 ARS_RDI_ElevationAng_Clu_170 ARS_RDI_SNR_Clu_170 ARS_RDI_DynProp_Clu_170 ARS_RDI_Quality_Clu_170 ARS_RDI_DynProp_Clu_171 ARS_RDI_Quality_Clu_171 ARS_RDI_Range_Clu_171 ARS_RDI_VradRel_Clu_171 ARS_RDI_RCS_Clu_171 ARS_RDI_AzimuthAng_Clu_171 ARS_RDI_ElevationAng_Clu_171 ARS_RDI_SNR_Clu_171 ARS_RDI_RCS_Clu_168 ARS_RDI_Range_Clu_172 ARS_RDI_VradRel_Clu_172 ARS_RDI_RCS_Clu_172 ARS_RDI_AzimuthAng_Clu_172 ARS_RDI_ElevationAng_Clu_172 ARS_RDI_SNR_Clu_172 ARS_RDI_DynProp_Clu_172 ARS_RDI_Quality_Clu_172 ARS_RDI_DynProp_Clu_173 ARS_RDI_Quality_Clu_173 ARS_RDI_Range_Clu_173 ARS_RDI_VradRel_Clu_173 ARS_RDI_RCS_Clu_173 ARS_RDI_AzimuthAng_Clu_168 ARS_RDI_AzimuthAng_Clu_173 ARS_RDI_ElevationAng_Clu_173 ARS_RDI_SNR_Clu_173 ARS_RDI_Range_Clu_174 ARS_RDI_VradRel_Clu_174 ARS_RDI_RCS_Clu_174 ARS_RDI_AzimuthAng_Clu_174 ARS_RDI_ElevationAng_Clu_174 ARS_RDI_SNR_Clu_174 ARS_RDI_DynProp_Clu_174 ARS_RDI_Quality_Clu_174 ARS_RDI_DynProp_Clu_175 ARS_RDI_Quality_Clu_175 ARS_RDI_Range_Clu_175 ARS_RDI_ElevationAng_Clu_168 ARS_RDI_VradRel_Clu_175 ARS_RDI_RCS_Clu_175 ARS_RDI_AzimuthAng_Clu_175 ARS_RDI_ElevationAng_Clu_175 ARS_RDI_SNR_Clu_175 ARS_RDI_MsgCounter_Clu_168_175 ARS_RDI_CRC16_Checksum_Clu_168_1 ARS_RDI_SNR_Clu_168 ARS_RDI_DynProp_Clu_168 ARS_RDI_Quality_Clu_168 ARS_RDI_DynProp_Clu_169 ARS_RDI_Quality_Clu_169 ARS_RDI_Range_Clu_169 ARS_RDI_VradRel_Clu_169 ARS_RDI_RCS_Clu_169 ARS_RDI_AzimuthAng_Clu_169;
SIG_GROUP_ 279 Signal_Group_ARS_RDI_176_183 1 : ARS_RDI_Range_Clu_176 ARS_RDI_ElevationAng_Clu_177 ARS_RDI_SNR_Clu_177 ARS_RDI_Range_Clu_178 ARS_RDI_VradRel_Clu_176 ARS_RDI_VradRel_Clu_178 ARS_RDI_RCS_Clu_178 ARS_RDI_AzimuthAng_Clu_178 ARS_RDI_ElevationAng_Clu_178 ARS_RDI_SNR_Clu_178 ARS_RDI_DynProp_Clu_178 ARS_RDI_Quality_Clu_178 ARS_RDI_DynProp_Clu_179 ARS_RDI_Quality_Clu_179 ARS_RDI_Range_Clu_179 ARS_RDI_VradRel_Clu_179 ARS_RDI_RCS_Clu_179 ARS_RDI_AzimuthAng_Clu_179 ARS_RDI_ElevationAng_Clu_179 ARS_RDI_SNR_Clu_179 ARS_RDI_RCS_Clu_176 ARS_RDI_Range_Clu_180 ARS_RDI_VradRel_Clu_180 ARS_RDI_RCS_Clu_180 ARS_RDI_AzimuthAng_Clu_180 ARS_RDI_ElevationAng_Clu_180 ARS_RDI_SNR_Clu_180 ARS_RDI_DynProp_Clu_180 ARS_RDI_Quality_Clu_180 ARS_RDI_DynProp_Clu_181 ARS_RDI_Quality_Clu_181 ARS_RDI_Range_Clu_181 ARS_RDI_VradRel_Clu_181 ARS_RDI_RCS_Clu_181 ARS_RDI_AzimuthAng_Clu_176 ARS_RDI_AzimuthAng_Clu_181 ARS_RDI_ElevationAng_Clu_181 ARS_RDI_SNR_Clu_181 ARS_RDI_Range_Clu_182 ARS_RDI_VradRel_Clu_182 ARS_RDI_RCS_Clu_182 ARS_RDI_AzimuthAng_Clu_182 ARS_RDI_ElevationAng_Clu_182 ARS_RDI_SNR_Clu_182 ARS_RDI_DynProp_Clu_182 ARS_RDI_Quality_Clu_182 ARS_RDI_DynProp_Clu_183 ARS_RDI_Quality_Clu_183 ARS_RDI_Range_Clu_183 ARS_RDI_ElevationAng_Clu_176 ARS_RDI_VradRel_Clu_183 ARS_RDI_RCS_Clu_183 ARS_RDI_AzimuthAng_Clu_183 ARS_RDI_ElevationAng_Clu_183 ARS_RDI_SNR_Clu_183 ARS_RDI_MsgCounter_Clu_176_183 ARS_RDI_CRC16_Checksum_Clu_176_1 ARS_RDI_SNR_Clu_176 ARS_RDI_DynProp_Clu_176 ARS_RDI_Quality_Clu_176 ARS_RDI_DynProp_Clu_177 ARS_RDI_Quality_Clu_177 ARS_RDI_Range_Clu_177 ARS_RDI_VradRel_Clu_177 ARS_RDI_RCS_Clu_177 ARS_RDI_AzimuthAng_Clu_177;
SIG_GROUP_ 280 Signal_Group_ARS_RDI_184_191 1 : ARS_RDI_Range_Clu_184 ARS_RDI_ElevationAng_Clu_185 ARS_RDI_SNR_Clu_185 ARS_RDI_Range_Clu_186 ARS_RDI_VradRel_Clu_184 ARS_RDI_VradRel_Clu_186 ARS_RDI_RCS_Clu_186 ARS_RDI_AzimuthAng_Clu_186 ARS_RDI_ElevationAng_Clu_186 ARS_RDI_SNR_Clu_186 ARS_RDI_DynProp_Clu_186 ARS_RDI_Quality_Clu_186 ARS_RDI_DynProp_Clu_187 ARS_RDI_Quality_Clu_187 ARS_RDI_Range_Clu_187 ARS_RDI_VradRel_Clu_187 ARS_RDI_RCS_Clu_187 ARS_RDI_AzimuthAng_Clu_187 ARS_RDI_ElevationAng_Clu_187 ARS_RDI_SNR_Clu_187 ARS_RDI_RCS_Clu_184 ARS_RDI_Range_Clu_188 ARS_RDI_VradRel_Clu_188 ARS_RDI_RCS_Clu_188 ARS_RDI_AzimuthAng_Clu_188 ARS_RDI_ElevationAng_Clu_188 ARS_RDI_SNR_Clu_188 ARS_RDI_DynProp_Clu_188 ARS_RDI_Quality_Clu_188 ARS_RDI_DynProp_Clu_189 ARS_RDI_Quality_Clu_189 ARS_RDI_Range_Clu_189 ARS_RDI_VradRel_Clu_189 ARS_RDI_RCS_Clu_189 ARS_RDI_AzimuthAng_Clu_184 ARS_RDI_AzimuthAng_Clu_189 ARS_RDI_ElevationAng_Clu_189 ARS_RDI_SNR_Clu_189 ARS_RDI_Range_Clu_190 ARS_RDI_VradRel_Clu_190 ARS_RDI_RCS_Clu_190 ARS_RDI_AzimuthAng_Clu_190 ARS_RDI_ElevationAng_Clu_190 ARS_RDI_SNR_Clu_190 ARS_RDI_DynProp_Clu_190 ARS_RDI_Quality_Clu_190 ARS_RDI_DynProp_Clu_191 ARS_RDI_Quality_Clu_191 ARS_RDI_Range_Clu_191 ARS_RDI_ElevationAng_Clu_184 ARS_RDI_VradRel_Clu_191 ARS_RDI_RCS_Clu_191 ARS_RDI_AzimuthAng_Clu_191 ARS_RDI_ElevationAng_Clu_191 ARS_RDI_SNR_Clu_191 ARS_RDI_MsgCounter_Clu_184_191 ARS_RDI_CRC16_Checksum_Clu_184_1 ARS_RDI_SNR_Clu_184 ARS_RDI_DynProp_Clu_184 ARS_RDI_Quality_Clu_184 ARS_RDI_DynProp_Clu_185 ARS_RDI_Quality_Clu_185 ARS_RDI_Range_Clu_185 ARS_RDI_VradRel_Clu_185 ARS_RDI_RCS_Clu_185 ARS_RDI_AzimuthAng_Clu_185;
SIG_GROUP_ 281 Signal_Group_ARS_RDI_192_199 1 : ARS_RDI_Range_Clu_192 ARS_RDI_ElevationAng_Clu_193 ARS_RDI_SNR_Clu_193 ARS_RDI_Range_Clu_194 ARS_RDI_VradRel_Clu_192 ARS_RDI_VradRel_Clu_194 ARS_RDI_RCS_Clu_194 ARS_RDI_AzimuthAng_Clu_194 ARS_RDI_ElevationAng_Clu_194 ARS_RDI_SNR_Clu_194 ARS_RDI_DynProp_Clu_194 ARS_RDI_Quality_Clu_194 ARS_RDI_DynProp_Clu_195 ARS_RDI_Quality_Clu_195 ARS_RDI_Range_Clu_195 ARS_RDI_VradRel_Clu_195 ARS_RDI_RCS_Clu_195 ARS_RDI_AzimuthAng_Clu_195 ARS_RDI_ElevationAng_Clu_195 ARS_RDI_SNR_Clu_195 ARS_RDI_RCS_Clu_192 ARS_RDI_Range_Clu_196 ARS_RDI_VradRel_Clu_196 ARS_RDI_RCS_Clu_196 ARS_RDI_AzimuthAng_Clu_196 ARS_RDI_ElevationAng_Clu_196 ARS_RDI_SNR_Clu_196 ARS_RDI_DynProp_Clu_196 ARS_RDI_Quality_Clu_196 ARS_RDI_DynProp_Clu_197 ARS_RDI_Quality_Clu_197 ARS_RDI_Range_Clu_197 ARS_RDI_VradRel_Clu_197 ARS_RDI_RCS_Clu_197 ARS_RDI_AzimuthAng_Clu_192 ARS_RDI_AzimuthAng_Clu_197 ARS_RDI_ElevationAng_Clu_197 ARS_RDI_SNR_Clu_197 ARS_RDI_Range_Clu_198 ARS_RDI_VradRel_Clu_198 ARS_RDI_RCS_Clu_198 ARS_RDI_AzimuthAng_Clu_198 ARS_RDI_ElevationAng_Clu_198 ARS_RDI_SNR_Clu_198 ARS_RDI_DynProp_Clu_198 ARS_RDI_Quality_Clu_198 ARS_RDI_DynProp_Clu_199 ARS_RDI_Quality_Clu_199 ARS_RDI_Range_Clu_199 ARS_RDI_ElevationAng_Clu_192 ARS_RDI_VradRel_Clu_199 ARS_RDI_RCS_Clu_199 ARS_RDI_AzimuthAng_Clu_199 ARS_RDI_ElevationAng_Clu_199 ARS_RDI_SNR_Clu_199 ARS_RDI_MsgCounter_Clu_192_199 ARS_RDI_CRC16_Checksum_Clu_192_1 ARS_RDI_SNR_Clu_192 ARS_RDI_DynProp_Clu_192 ARS_RDI_Quality_Clu_192 ARS_RDI_DynProp_Clu_193 ARS_RDI_Quality_Clu_193 ARS_RDI_Range_Clu_193 ARS_RDI_VradRel_Clu_193 ARS_RDI_RCS_Clu_193 ARS_RDI_AzimuthAng_Clu_193;
SIG_GROUP_ 282 Signal_Group_ARS_RDI_ExtensionLi 1 : ARS_RDI_Obj_ID_Clu_000 ARS_RDI_Obj_ID_Clu_001 ARS_RDI_Obj_ID_Clu_017 ARS_RDI_Obj_ID_Clu_018 ARS_RDI_Obj_ID_Clu_019 ARS_RDI_Obj_ID_Clu_020 ARS_RDI_Obj_ID_Clu_021 ARS_RDI_Obj_ID_Clu_002 ARS_RDI_Obj_ID_Clu_022 ARS_RDI_Obj_ID_Clu_023 ARS_RDI_Obj_ID_Clu_024 ARS_RDI_Obj_ID_Clu_025 ARS_RDI_Obj_ID_Clu_026 ARS_RDI_Obj_ID_Clu_027 ARS_RDI_Obj_ID_Clu_028 ARS_RDI_Obj_ID_Clu_029 ARS_RDI_Obj_ID_Clu_030 ARS_RDI_Obj_ID_Clu_031 ARS_RDI_Obj_ID_Clu_003 ARS_RDI_Obj_ID_Clu_032 ARS_RDI_Obj_ID_Clu_033 ARS_RDI_Obj_ID_Clu_034 ARS_RDI_Obj_ID_Clu_035 ARS_RDI_Obj_ID_Clu_036 ARS_RDI_Obj_ID_Clu_037 ARS_RDI_Obj_ID_Clu_038 ARS_RDI_Obj_ID_Clu_039 ARS_RDI_Obj_ID_Clu_040 ARS_RDI_Obj_ID_Clu_041 ARS_RDI_Obj_ID_Clu_004 ARS_RDI_Obj_ID_Clu_042 ARS_RDI_Obj_ID_Clu_043 ARS_RDI_Obj_ID_Clu_044 ARS_RDI_Obj_ID_Clu_045 ARS_RDI_Obj_ID_Clu_046 ARS_RDI_Obj_ID_Clu_047 ARS_RDI_Obj_ID_Clu_048 ARS_RDI_Obj_ID_Clu_049 ARS_RDI_Obj_ID_Clu_050 ARS_RDI_Obj_ID_Clu_051 ARS_RDI_Obj_ID_Clu_005 ARS_RDI_Obj_ID_Clu_052 ARS_RDI_Obj_ID_Clu_053 ARS_RDI_Obj_ID_Clu_054 ARS_RDI_Obj_ID_Clu_055 ARS_RDI_Obj_ID_Clu_056 ARS_RDI_Obj_ID_Clu_057 ARS_RDI_Obj_ID_Clu_058 ARS_RDI_Obj_ID_Clu_059 ARS_RDI_Obj_ID_Clu_060 ARS_RDI_Obj_ID_Clu_061 ARS_RDI_Obj_ID_Clu_006 ARS_RDI_Obj_ID_Clu_062 ARS_RDI_Obj_ID_Clu_063 ARS_RDI_Obj_ID_Clu_064 ARS_RDI_Obj_ID_Clu_065 ARS_RDI_Obj_ID_Clu_066 ARS_RDI_Obj_ID_Clu_067 ARS_RDI_Obj_ID_Clu_068 ARS_RDI_Obj_ID_Clu_069 ARS_RDI_Obj_ID_Clu_070 ARS_RDI_Obj_ID_Clu_071 ARS_RDI_Obj_ID_Clu_007 ARS_RDI_Obj_ID_Clu_072 ARS_RDI_Obj_ID_Clu_073 ARS_RDI_Obj_ID_Clu_074 ARS_RDI_Obj_ID_Clu_075 ARS_RDI_Obj_ID_Clu_076 ARS_RDI_Obj_ID_Clu_077 ARS_RDI_Obj_ID_Clu_078 ARS_RDI_Obj_ID_Clu_079 ARS_RDI_MsgCounter_ExtList_0 ARS_RDI_Obj_ID_Clu_008 ARS_RDI_CRC16_Checksum_ExtList_0 ARS_RDI_Obj_ID_Clu_009 ARS_RDI_Obj_ID_Clu_010 ARS_RDI_Obj_ID_Clu_011 ARS_RDI_Obj_ID_Clu_012 ARS_RDI_Obj_ID_Clu_013 ARS_RDI_Obj_ID_Clu_014 ARS_RDI_Obj_ID_Clu_015 ARS_RDI_Obj_ID_Clu_016;
SIG_GROUP_ 283 Signal_Group_ARS_RDI_ExtensionLi 1 : ARS_RDI_Obj_ID_Clu_080 ARS_RDI_Obj_ID_Clu_081 ARS_RDI_Obj_ID_Clu_097 ARS_RDI_Obj_ID_Clu_098 ARS_RDI_Obj_ID_Clu_099 ARS_RDI_Obj_ID_Clu_100 ARS_RDI_Obj_ID_Clu_101 ARS_RDI_Obj_ID_Clu_082 ARS_RDI_Obj_ID_Clu_102 ARS_RDI_Obj_ID_Clu_103 ARS_RDI_Obj_ID_Clu_104 ARS_RDI_Obj_ID_Clu_105 ARS_RDI_Obj_ID_Clu_106 ARS_RDI_Obj_ID_Clu_107 ARS_RDI_Obj_ID_Clu_108 ARS_RDI_Obj_ID_Clu_109 ARS_RDI_Obj_ID_Clu_110 ARS_RDI_Obj_ID_Clu_111 ARS_RDI_Obj_ID_Clu_083 ARS_RDI_Obj_ID_Clu_112 ARS_RDI_Obj_ID_Clu_113 ARS_RDI_Obj_ID_Clu_114 ARS_RDI_Obj_ID_Clu_115 ARS_RDI_Obj_ID_Clu_116 ARS_RDI_Obj_ID_Clu_117 ARS_RDI_Obj_ID_Clu_118 ARS_RDI_Obj_ID_Clu_119 ARS_RDI_Obj_ID_Clu_120 ARS_RDI_Obj_ID_Clu_121 ARS_RDI_Obj_ID_Clu_084 ARS_RDI_Obj_ID_Clu_122 ARS_RDI_Obj_ID_Clu_123 ARS_RDI_Obj_ID_Clu_124 ARS_RDI_Obj_ID_Clu_125 ARS_RDI_Obj_ID_Clu_126 ARS_RDI_Obj_ID_Clu_127 ARS_RDI_Obj_ID_Clu_128 ARS_RDI_Obj_ID_Clu_129 ARS_RDI_Obj_ID_Clu_130 ARS_RDI_Obj_ID_Clu_131 ARS_RDI_Obj_ID_Clu_085 ARS_RDI_Obj_ID_Clu_132 ARS_RDI_Obj_ID_Clu_133 ARS_RDI_Obj_ID_Clu_134 ARS_RDI_Obj_ID_Clu_135 ARS_RDI_Obj_ID_Clu_136 ARS_RDI_Obj_ID_Clu_137 ARS_RDI_Obj_ID_Clu_138 ARS_RDI_Obj_ID_Clu_139 ARS_RDI_Obj_ID_Clu_140 ARS_RDI_Obj_ID_Clu_141 ARS_RDI_Obj_ID_Clu_086 ARS_RDI_Obj_ID_Clu_142 ARS_RDI_Obj_ID_Clu_143 ARS_RDI_Obj_ID_Clu_144 ARS_RDI_Obj_ID_Clu_145 ARS_RDI_Obj_ID_Clu_146 ARS_RDI_Obj_ID_Clu_147 ARS_RDI_Obj_ID_Clu_148 ARS_RDI_Obj_ID_Clu_149 ARS_RDI_Obj_ID_Clu_150 ARS_RDI_Obj_ID_Clu_151 ARS_RDI_Obj_ID_Clu_087 ARS_RDI_Obj_ID_Clu_152 ARS_RDI_Obj_ID_Clu_153 ARS_RDI_Obj_ID_Clu_154 ARS_RDI_Obj_ID_Clu_155 ARS_RDI_Obj_ID_Clu_156 ARS_RDI_Obj_ID_Clu_157 ARS_RDI_Obj_ID_Clu_158 ARS_RDI_Obj_ID_Clu_159 ARS_RDI_MsgCounter_ExtList_1 ARS_RDI_Obj_ID_Clu_088 ARS_RDI_CRC16_Checksum_ExtList_1 ARS_RDI_Obj_ID_Clu_089 ARS_RDI_Obj_ID_Clu_090 ARS_RDI_Obj_ID_Clu_091 ARS_RDI_Obj_ID_Clu_092 ARS_RDI_Obj_ID_Clu_093 ARS_RDI_Obj_ID_Clu_094 ARS_RDI_Obj_ID_Clu_095 ARS_RDI_Obj_ID_Clu_096;
SIG_GROUP_ 284 Signal_Group_ARS_RDI_ExtensionLi 1 : ARS_RDI_Obj_ID_Clu_160 ARS_RDI_Obj_ID_Clu_161 ARS_RDI_Obj_ID_Clu_177 ARS_RDI_Obj_ID_Clu_178 ARS_RDI_Obj_ID_Clu_179 ARS_RDI_Obj_ID_Clu_180 ARS_RDI_Obj_ID_Clu_181 ARS_RDI_Obj_ID_Clu_162 ARS_RDI_Obj_ID_Clu_182 ARS_RDI_Obj_ID_Clu_183 ARS_RDI_Obj_ID_Clu_184 ARS_RDI_Obj_ID_Clu_185 ARS_RDI_Obj_ID_Clu_186 ARS_RDI_Obj_ID_Clu_187 ARS_RDI_Obj_ID_Clu_188 ARS_RDI_Obj_ID_Clu_189 ARS_RDI_Obj_ID_Clu_190 ARS_RDI_Obj_ID_Clu_191 ARS_RDI_Obj_ID_Clu_163 ARS_RDI_Obj_ID_Clu_192 ARS_RDI_Obj_ID_Clu_193 ARS_RDI_Obj_ID_Clu_194 ARS_RDI_Obj_ID_Clu_195 ARS_RDI_Obj_ID_Clu_196 ARS_RDI_Obj_ID_Clu_197 ARS_RDI_Obj_ID_Clu_198 ARS_RDI_Obj_ID_Clu_199 ARS_RDI_Obj_ID_Clu_164 ARS_RDI_Obj_ID_Clu_165 ARS_RDI_Obj_ID_Clu_166 ARS_RDI_Obj_ID_Clu_167 ARS_RDI_MsgCounter_ExtList_2 ARS_RDI_Obj_ID_Clu_168 ARS_RDI_CRC16_Checksum_ExtList_2 ARS_RDI_Obj_ID_Clu_169 ARS_RDI_Obj_ID_Clu_170 ARS_RDI_Obj_ID_Clu_171 ARS_RDI_Obj_ID_Clu_172 ARS_RDI_Obj_ID_Clu_173 ARS_RDI_Obj_ID_Clu_174 ARS_RDI_Obj_ID_Clu_175 ARS_RDI_Obj_ID_Clu_176;
SIG_GROUP_ 285 Signal_Group_ARS_RDI_200_207 1 : ARS_RDI_Range_Clu_200 ARS_RDI_ElevationAng_Clu_201 ARS_RDI_SNR_Clu_201 ARS_RDI_Range_Clu_202 ARS_RDI_VradRel_Clu_200 ARS_RDI_VradRel_Clu_202 ARS_RDI_RCS_Clu_202 ARS_RDI_AzimuthAng_Clu_202 ARS_RDI_ElevationAng_Clu_202 ARS_RDI_SNR_Clu_202 ARS_RDI_DynProp_Clu_202 ARS_RDI_Quality_Clu_202 ARS_RDI_DynProp_Clu_203 ARS_RDI_Quality_Clu_203 ARS_RDI_Range_Clu_203 ARS_RDI_VradRel_Clu_203 ARS_RDI_RCS_Clu_203 ARS_RDI_AzimuthAng_Clu_203 ARS_RDI_ElevationAng_Clu_203 ARS_RDI_SNR_Clu_203 ARS_RDI_RCS_Clu_200 ARS_RDI_Range_Clu_204 ARS_RDI_VradRel_Clu_204 ARS_RDI_RCS_Clu_204 ARS_RDI_AzimuthAng_Clu_204 ARS_RDI_ElevationAng_Clu_204 ARS_RDI_SNR_Clu_204 ARS_RDI_DynProp_Clu_204 ARS_RDI_Quality_Clu_204 ARS_RDI_DynProp_Clu_205 ARS_RDI_Quality_Clu_205 ARS_RDI_Range_Clu_205 ARS_RDI_VradRel_Clu_205 ARS_RDI_RCS_Clu_205 ARS_RDI_AzimuthAng_Clu_200 ARS_RDI_AzimuthAng_Clu_205 ARS_RDI_ElevationAng_Clu_205 ARS_RDI_SNR_Clu_205 ARS_RDI_Range_Clu_206 ARS_RDI_VradRel_Clu_206 ARS_RDI_RCS_Clu_206 ARS_RDI_AzimuthAng_Clu_206 ARS_RDI_ElevationAng_Clu_206 ARS_RDI_SNR_Clu_206 ARS_RDI_DynProp_Clu_206 ARS_RDI_Quality_Clu_206 ARS_RDI_DynProp_Clu_207 ARS_RDI_Quality_Clu_207 ARS_RDI_Range_Clu_207 ARS_RDI_ElevationAng_Clu_200 ARS_RDI_VradRel_Clu_207 ARS_RDI_RCS_Clu_207 ARS_RDI_AzimuthAng_Clu_207 ARS_RDI_ElevationAng_Clu_207 ARS_RDI_SNR_Clu_207 ARS_RDI_MsgCounter_Clu_200_207 ARS_RDI_CRC16_Checksum_Clu_200_2 ARS_RDI_SNR_Clu_200 ARS_RDI_DynProp_Clu_200 ARS_RDI_Quality_Clu_200 ARS_RDI_DynProp_Clu_201 ARS_RDI_Quality_Clu_201 ARS_RDI_Range_Clu_201 ARS_RDI_VradRel_Clu_201 ARS_RDI_RCS_Clu_201 ARS_RDI_AzimuthAng_Clu_201;
SIG_GROUP_ 286 Signal_Group_ARS_RDI_208_215 1 : ARS_RDI_Range_Clu_208 ARS_RDI_ElevationAng_Clu_209 ARS_RDI_SNR_Clu_209 ARS_RDI_Range_Clu_210 ARS_RDI_VradRel_Clu_208 ARS_RDI_VradRel_Clu_210 ARS_RDI_RCS_Clu_210 ARS_RDI_AzimuthAng_Clu_210 ARS_RDI_ElevationAng_Clu_210 ARS_RDI_SNR_Clu_210 ARS_RDI_DynProp_Clu_210 ARS_RDI_Quality_Clu_210 ARS_RDI_DynProp_Clu_211 ARS_RDI_Quality_Clu_211 ARS_RDI_Range_Clu_211 ARS_RDI_VradRel_Clu_211 ARS_RDI_RCS_Clu_211 ARS_RDI_AzimuthAng_Clu_211 ARS_RDI_ElevationAng_Clu_211 ARS_RDI_SNR_Clu_211 ARS_RDI_RCS_Clu_208 ARS_RDI_Range_Clu_212 ARS_RDI_VradRel_Clu_212 ARS_RDI_RCS_Clu_212 ARS_RDI_AzimuthAng_Clu_212 ARS_RDI_ElevationAng_Clu_212 ARS_RDI_SNR_Clu_212 ARS_RDI_DynProp_Clu_212 ARS_RDI_Quality_Clu_212 ARS_RDI_DynProp_Clu_213 ARS_RDI_Quality_Clu_213 ARS_RDI_Range_Clu_213 ARS_RDI_VradRel_Clu_213 ARS_RDI_RCS_Clu_213 ARS_RDI_AzimuthAng_Clu_208 ARS_RDI_AzimuthAng_Clu_213 ARS_RDI_ElevationAng_Clu_213 ARS_RDI_SNR_Clu_213 ARS_RDI_Range_Clu_214 ARS_RDI_VradRel_Clu_214 ARS_RDI_RCS_Clu_214 ARS_RDI_AzimuthAng_Clu_214 ARS_RDI_ElevationAng_Clu_214 ARS_RDI_SNR_Clu_214 ARS_RDI_DynProp_Clu_214 ARS_RDI_Quality_Clu_214 ARS_RDI_DynProp_Clu_215 ARS_RDI_Quality_Clu_215 ARS_RDI_Range_Clu_215 ARS_RDI_ElevationAng_Clu_208 ARS_RDI_VradRel_Clu_215 ARS_RDI_RCS_Clu_215 ARS_RDI_AzimuthAng_Clu_215 ARS_RDI_ElevationAng_Clu_215 ARS_RDI_SNR_Clu_215 ARS_RDI_MsgCounter_Clu_208_215 ARS_RDI_CRC16_Checksum_Clu_208_2 ARS_RDI_SNR_Clu_208 ARS_RDI_DynProp_Clu_208 ARS_RDI_Quality_Clu_208 ARS_RDI_DynProp_Clu_209 ARS_RDI_Quality_Clu_209 ARS_RDI_Range_Clu_209 ARS_RDI_VradRel_Clu_209 ARS_RDI_RCS_Clu_209 ARS_RDI_AzimuthAng_Clu_209;
SIG_GROUP_ 287 Signal_Group_ARS_RDI_216_223 1 : ARS_RDI_Range_Clu_216 ARS_RDI_ElevationAng_Clu_217 ARS_RDI_SNR_Clu_217 ARS_RDI_Range_Clu_218 ARS_RDI_VradRel_Clu_216 ARS_RDI_VradRel_Clu_218 ARS_RDI_RCS_Clu_218 ARS_RDI_AzimuthAng_Clu_218 ARS_RDI_ElevationAng_Clu_218 ARS_RDI_SNR_Clu_218 ARS_RDI_DynProp_Clu_218 ARS_RDI_Quality_Clu_218 ARS_RDI_DynProp_Clu_219 ARS_RDI_Quality_Clu_219 ARS_RDI_Range_Clu_219 ARS_RDI_VradRel_Clu_219 ARS_RDI_RCS_Clu_219 ARS_RDI_AzimuthAng_Clu_219 ARS_RDI_ElevationAng_Clu_219 ARS_RDI_SNR_Clu_219 ARS_RDI_RCS_Clu_216 ARS_RDI_Range_Clu_220 ARS_RDI_VradRel_Clu_220 ARS_RDI_RCS_Clu_220 ARS_RDI_AzimuthAng_Clu_220 ARS_RDI_ElevationAng_Clu_220 ARS_RDI_SNR_Clu_220 ARS_RDI_DynProp_Clu_220 ARS_RDI_Quality_Clu_220 ARS_RDI_DynProp_Clu_221 ARS_RDI_Quality_Clu_221 ARS_RDI_Range_Clu_221 ARS_RDI_VradRel_Clu_221 ARS_RDI_RCS_Clu_221 ARS_RDI_AzimuthAng_Clu_216 ARS_RDI_AzimuthAng_Clu_221 ARS_RDI_ElevationAng_Clu_221 ARS_RDI_SNR_Clu_221 ARS_RDI_Range_Clu_222 ARS_RDI_VradRel_Clu_222 ARS_RDI_RCS_Clu_222 ARS_RDI_AzimuthAng_Clu_222 ARS_RDI_ElevationAng_Clu_222 ARS_RDI_SNR_Clu_222 ARS_RDI_DynProp_Clu_222 ARS_RDI_Quality_Clu_222 ARS_RDI_DynProp_Clu_223 ARS_RDI_Quality_Clu_223 ARS_RDI_Range_Clu_223 ARS_RDI_ElevationAng_Clu_216 ARS_RDI_VradRel_Clu_223 ARS_RDI_RCS_Clu_223 ARS_RDI_AzimuthAng_Clu_223 ARS_RDI_ElevationAng_Clu_223 ARS_RDI_SNR_Clu_223 ARS_RDI_MsgCounter_Clu_216_223 ARS_RDI_CRC16_Checksum_Clu_216_2 ARS_RDI_SNR_Clu_216 ARS_RDI_DynProp_Clu_216 ARS_RDI_Quality_Clu_216 ARS_RDI_DynProp_Clu_217 ARS_RDI_Quality_Clu_217 ARS_RDI_Range_Clu_217 ARS_RDI_VradRel_Clu_217 ARS_RDI_RCS_Clu_217 ARS_RDI_AzimuthAng_Clu_217;
